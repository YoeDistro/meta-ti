## conf/machine/am64xx-sk-k3r5.conf
```bitbake
#@TYPE: Machine
#@NAME: AM64xx SK (R5F)
#@DESCRIPTION: Machine configuration for the TI AM64xx SK (R5F core)

require conf/machine/include/k3r5.inc

SYSFW_SOC = "am64x"
SYSFW_CONFIG = "evm"
SYSFW_SUFFIX = "gp"

UBOOT_MACHINE = "am64x_sk_r5_defconfig"
UBOOT_BINARY = "tiboot3.${UBOOT_SUFFIX}"
UBOOT_IMAGE = "tiboot3-${MAINMACHINE}-${PV}-${PR}.${UBOOT_SUFFIX}"
UBOOT_SYMLINK = "tiboot3-${MAINMACHINE}.${UBOOT_SUFFIX}"
```

## conf/machine/am64xx-sk.conf
```bitbake
#@TYPE: Machine
#@NAME: AM64xx SK
#@DESCRIPTION: Machine configuration for the TI AM64xx SK board

require conf/machine/include/am64xx.inc

UBOOT_MACHINE = "am64x_sk_a53_defconfig"

KERNEL_DEVICETREE = " \
    ti/k3-am642-sk.dtb \
"
```
