## conf/layer.conf
```bitbake
# We have a conf and classes directory, append to BBPATH
BBPATH .= ":${LAYERDIR}"

# We have a recipes directory, add to BBFILES
BBFILES += "${LAYERDIR}/recipes*/*/*.bb ${LAYERDIR}/recipes*/*/*.bbappend"

BBFILE_COLLECTIONS += "meta-ti"
BBFILE_PATTERN_meta-ti := "^${LAYERDIR}/"
BBFILE_PRIORITY_meta-ti = "6"

LAYERSERIES_COMPAT_meta-ti = "sumo thud"

LICENSE_PATH += "${LAYERDIR}/licenses"

LAYERDEPENDS_meta-ti = "core"

SIGGEN_EXCLUDERECIPES_ABISAFE += " \
    ti-sgx-ddk-km \
    ti-sgx-ddk-um \
    ti-ipc \
    ti-ipc-rtos \
    cmem-mod \
    hplib-mod \
    gdbserverproxy-module-drv \
    debugss-module-drv \
    uio-module-drv \
    mpm-transport \
    cppi-lld \
    qmss-lld \
    multiprocmgr \
"

HOSTTOOLS_NONFATAL += "truncate xxd comm"
```

## conf/machine/am180x-evm.conf
```bitbake
#@TYPE: Machine
#@NAME: AM180x CPUs on an AM180x EVM board
#@DESCRIPTION: Machine configuration for the TI AM180x EVM board

require conf/machine/include/davinci.inc
require conf/machine/include/omapl138.inc

UBOOT_MACHINE = "da850_am18xxevm_config"
UBOOT_SUFFIX = "ais"

UBOOT_ENTRYPOINT = "0xc0008000"
UBOOT_LOADADDRESS = "0xc0008000"

IMAGE_FSTYPES += "tar.gz"

SERIAL_CONSOLE = "115200 ttyS2"
```

## conf/machine/am335x-evm.conf
```bitbake
#@TYPE: Machine
#@NAME: AM335x EVM
#@DESCRIPTION: Machine configuration for the TI AM335x EVM

require conf/machine/include/ti33x.inc

MACHINE_GUI_CLASS = "smallscreen"
MACHINE_FEATURES += "touchscreen"

IMAGE_FSTYPES += "ubifs ubi tar.xz"

# Normally AM335 boards use ttyS0, but ICE uses ttyS3, so try both
SERIAL_CONSOLE = ""
SERIAL_CONSOLES = "115200;ttyS0 115200;ttyS3"
SERIAL_CONSOLES_CHECK = "${SERIAL_CONSOLES}"

# UBI information.  Note that this is board and kernel specific.  Changes
# in your kernel port may require changes in these variables.  For more
# details about this board please see
# http://processors.wiki.ti.com/index.php/UBIFS_Support

# do ubiattach /dev/ubi_ctrl -m 7 -O 2048
# From dmesg:
# UBI: smallest flash I/O unit:    2048
# UBI: logical eraseblock size:    126976 bytes
# from ubiattach stdout:
# UBI device number 0, total 1988 LEBs
MKUBIFS_ARGS = "-F -m 2048 -e 126976 -c 8300"

# do ubiattach /dev/ubi_ctrl -m 7 -O 2048
# from dmesg:
# UBI: smallest flash I/O unit:    2048
# UBI: physical eraseblock size:   131072 bytes (128 KiB)
# UBI: sub-page size:              512
# UBI: VID header offset:          2048 (aligned 2048)
UBINIZE_ARGS = "-m 2048 -p 128KiB -s 512 -O 2048"
```

## conf/machine/am335x-hs-evm.conf
```bitbake
#@TYPE: Machine
#@NAME: AM335x HS EVM
#@DESCRIPTION: Machine configuration for the TI AM335x HS EVM

require conf/machine/am335x-evm.conf

UBOOT_MACHINE = ""
# Last config in the list is default
UBOOT_CONFIG ??= "uart mmc"
UBOOT_CONFIG[uart] = "am335x_hs_evm_uart_config"
UBOOT_CONFIG[mmc] = "am335x_hs_evm_config"

UBOOT_ENTRYPOINT = "0x82000000"
UBOOT_LOADADDRESS = "0x82000000"
UBOOT_RD_LOADADDRESS = "0x84000000"
UBOOT_RD_ENTRYPOINT = "0x84000000"

TI_SECURE_DEV_PKG = "${TI_SECURE_DEV_PKG_CAT}/am3x"
```

## conf/machine/am37x-evm.conf
```bitbake
#@TYPE: Machine
#@NAME: AM37x EVM
#@DESCRIPTION: Machine configuration for the TI AM37x EVM

require conf/machine/include/omap3.inc

MACHINE_GUI_CLASS = "smallscreen"
MACHINE_FEATURES += "touchscreen ethernet"

IMAGE_FSTYPES += "ubi tar.xz"
EXTRA_IMAGECMD_jffs2 = "-lnp -e 0x20000 -s 2048"

KERNEL_DEVICETREE = "omap3-evm-37xx.dtb"

SERIAL_CONSOLES = "115200;ttyS0"

# NOTE: there are NAND and OneNAND versions of this board...
# do ubiattach /dev/ubi_ctrl -m 4
# From dmesg:
# UBI: smallest flash I/O unit:    2048
# UBI: logical eraseblock size:    129024 bytes
# from ubiattach stdout:
# UBI device number 0, total 1996 LEBs
MKUBIFS_ARGS = "-m 2048 -e 129024 -c 1996"

# do ubiattach /dev/ubi_ctrl -m 4
# from dmesg:
# UBI: smallest flash I/O unit:    2048
# UBI: physical eraseblock size:   131072 bytes (128 KiB)
# UBI: sub-page size:              512
UBINIZE_ARGS = "-m 2048 -p 128KiB -s 512"
```

## conf/machine/am437x-hs-evm.conf
```bitbake
#@TYPE: Machine
#@NAME: AM437x HS EVM
#@DESCRIPTION: Machine configuration for the TI AM437x HS EVM

require conf/machine/am437x-evm.conf

UBOOT_MACHINE = "am43xx_hs_evm_config"

UBOOT_ENTRYPOINT = "0x82000000"
UBOOT_LOADADDRESS = "0x82000000"
UBOOT_RD_LOADADDRESS = "0x84000000"
UBOOT_RD_ENTRYPOINT = "0x84000000"

TI_SECURE_DEV_PKG = "${TI_SECURE_DEV_PKG_CAT}/am4x"

OPTEEMACHINE = "ti"
OPTEEFLAVOR = "am43xx"
OPTEEOUTPUTMACHINE = "ti"
```

## conf/machine/am57xx-evm.conf
```bitbake
#@TYPE: Machine
#@NAME: AM57xx EVM
#@DESCRIPTION: Machine configuration for the TI AM57xx EVM

require conf/machine/include/dra7xx.inc

MACHINE_FEATURES += "touchscreen"

SERIAL_CONSOLES = "115200;ttyS2"

KERNEL_DEVICETREE = " \
    am57xx-beagle-x15.dtb \
    am57xx-beagle-x15-revb1.dtb \
    am57xx-beagle-x15-revc.dtb \
    am5729-beagleboneai.dtb \
    ${@oe.utils.conditional('ARAGO_BRAND', 'mainline', '', 'am57xx-evm.dtb', d)} \
    ti/am57xx-evm-common.dtbo \
    ${@oe.utils.conditional('ARAGO_BRAND', 'mainline', '', 'am57xx-evm-reva3.dtb', d)} \
    ti/am57xx-evm-reva3.dtbo \
    am571x-idk.dtb \
    ti/am571x-idk-touchscreen.dtbo \
    am572x-idk.dtb \
    am574x-idk.dtb \
    ti/am57xx-idk-osd-lcd-common.dtbo \
    ti/am572x-idk-touchscreen.dtbo \
    ti/lcd-osd101t2587.dtbo \
    ti/lcd-osd101t2045.dtbo \
    ${@oe.utils.conditional('ARAGO_BRAND', 'mainline', '', 'ti/ov10635.dtbo', d)} \
"

KERNEL_DEVICETREE += "${@oe.utils.conditional('ENABLE_TI_UIO_DEVICES', '1', 'am574x-idk-pru-excl-uio.dtb am572x-idk-pru-excl-uio.dtb am571x-idk-pru-excl-uio.dtb', '', d)}"

UBOOT_MACHINE = "am57xx_evm_config"

# UBI information.  Note that this is board and kernel specific.  Changes
# in your kernel port may require changes in these variables.  For more
# details about this board please see
# http://processors.wiki.ti.com/index.php/UBIFS_Support

# do ubiattach /dev/ubi_ctrl -m 7 -O 2048
# From dmesg:
# UBI: smallest flash I/O unit:    2048
# UBI: logical eraseblock size:    126976 bytes
# from ubiattach stdout:
# UBI device number 0, total 1988 LEBs
MKUBIFS_ARGS = "-F -m 2048 -e 126976 -c 8192"

# do ubiattach /dev/ubi_ctrl -m 7 -O 2048
# from dmesg:
# UBI: smallest flash I/O unit:    2048
# UBI: physical eraseblock size:   131072 bytes (128 KiB)
# UBI: sub-page size:              512
# UBI: VID header offset:          2048 (aligned 2048)
UBINIZE_ARGS = "-m 2048 -p 128KiB -s 512 -O 2048"

# Set the list of device targets for ti-pdk class recipes
TI_PDK_LIMIT_SOCS = "am571x am572x am574x"
TI_PDK_LIMIT_BOARDS = "evmAM571x evmAM572x idkAM571x idkAM572x idkAM574x"
```

## conf/machine/am57xx-hs-evm.conf
```bitbake
#@TYPE: Machine
#@NAME: AM57xx HS EVM
#@DESCRIPTION: Machine configuration for the TI AM57xx HS EVM

require conf/machine/am57xx-evm.conf

UBOOT_MACHINE = "am57xx_hs_evm_config"

UBOOT_ENTRYPOINT = "0x82000000"
UBOOT_LOADADDRESS = "0x82000000"
UBOOT_RD_LOADADDRESS = "0x84000000"
UBOOT_RD_ENTRYPOINT = "0x84000000"

TI_SECURE_DEV_PKG = "${TI_SECURE_DEV_PKG_AUTO}/am5x"

OPTEEMACHINE = "ti-am57xx"
OPTEEFLAVOR = "am57xx"
OPTEEOUTPUTMACHINE = "ti"
OPTEEPAGER = "y"
```

## conf/machine/am62axx-evm-k3r5-hs-se.conf
```bitbake
#@TYPE: Machine
#@NAME: AM62A HS-SE EVM (R5F)
#@DESCRIPTION: Machine configuration for the TI AM62A HS-SE EVM (R5F core)

# Booting HS-SE requires different SYSFW, the rest is handled at runtime

require conf/machine/include/k3r5.inc
SOC_FAMILY_append = ":k3r5-hs-se"

SYSFW_SOC = "am62ax"
SYSFW_CONFIG = "evm"
SYSFW_SUFFIX = "hs"

SYSFW_TIBOOT3_SYMLINK = ""
SYSFW_SYMLINK = ""

UBOOT_MACHINE = "am62ax_evm_r5_defconfig"

SPL_BINARY = ""
UBOOT_BINARY = "u-boot-spl.${UBOOT_SUFFIX}"
UBOOT_IMAGE = "u-boot-r5spl-hs-se-${MAINMACHINE}-${PV}-${PR}.${UBOOT_SUFFIX}"
UBOOT_SYMLINK = "u-boot-r5spl-hs-se.${UBOOT_SUFFIX}"
```

## conf/machine/am62axx-evm-k3r5.conf
```bitbake
#@TYPE: Machine
#@NAME: AM62AXX EVM (R5F)
#@DESCRIPTION: Machine configuration for the TI AM62Axx EVM (R5F core)

require conf/machine/include/k3r5.inc

SYSFW_SOC = "am62ax"
SYSFW_CONFIG = "evm"
SYSFW_SUFFIX = "gp"

UBOOT_MACHINE = "am62ax_evm_r5_defconfig"
```

## conf/machine/am62axx-evm.conf
```bitbake
#@TYPE: Machine
#@NAME: AM62AXX EVM
#@DESCRIPTION: Machine configuration for the TI AM62AXX EVM

require conf/machine/include/am62axx.inc

KERNEL_DEVICETREE = " \
    ti/k3-am62a7-sk.dtb \
    ti/k3-am62a7-fpdlink-ov2312-0-0.dtbo \
    ti/k3-am62a7-fpdlink-ov2312-0-1.dtbo \
    ti/k3-am62a7-fpdlink-ov2312-0-2.dtbo \
    ti/k3-am62a7-fpdlink-ov2312-0-3.dtbo \
    ti/k3-am62a7-fpdlink-sk-fusion.dtbo \
    ti/k3-am62a7-sk-csi2-imx219.dtbo \
    ti/k3-am62a7-sk-ethernet-dc01.dtbo \
    ti/k3-j721e-fpdlink-imx390-cm-0-0.dtbo \
    ti/k3-j721e-fpdlink-imx390-cm-0-1.dtbo \
    ti/k3-j721e-fpdlink-imx390-cm-0-2.dtbo \
    ti/k3-j721e-fpdlink-imx390-cm-0-3.dtbo \
    ti/k3-j721e-fpdlink-imx390-rcm-0-0.dtbo \
    ti/k3-j721e-fpdlink-imx390-rcm-0-1.dtbo \
    ti/k3-j721e-fpdlink-imx390-rcm-0-2.dtbo \
    ti/k3-j721e-fpdlink-imx390-rcm-0-3.dtbo \
"

UBOOT_MACHINE = "am62ax_evm_a53_defconfig"

SPL_BINARY = "tispl.bin_HS"
UBOOT_BINARY = "u-boot.img_HS"
UBOOT_SYMLINK = "u-boot.img"
```

## conf/machine/am62xx-evm-k3r5-hs-fs.conf
```bitbake
#@TYPE: Machine
#@NAME: AM62xx HS-FS EVM (R5F)
#@DESCRIPTION: Machine configuration for the TI AM62xx HS-FS EVM (R5F core)

# Booting HS-FS requires different SYSFW, the rest is handled at runtime

require conf/machine/include/k3r5.inc
SOC_FAMILY_append = ":k3r5-hs-fs"

SYSFW_SOC = "am62x"
SYSFW_CONFIG = "evm"
SYSFW_SUFFIX = "hs-fs"

UBOOT_MACHINE = "am62x_evm_r5_defconfig"
```

## conf/machine/am62xx-evm.conf
```bitbake
#@TYPE: Machine
#@NAME: AM62XX EVM
#@DESCRIPTION: Machine configuration for the TI AM62XX EVM

require conf/machine/include/am62xx.inc

MACHINE_FEATURES += "gpu"

KERNEL_DEVICETREE = " \
    ti/k3-am625-sk.dtb \
    ti/k3-am625-skeleton.dtb \
    ti/k3-am625-sk-lpmdemo.dtb \
    ti/k3-am625-sk-csi2-ov5640.dtbo \
    ti/k3-am625-sk-csi2-tevi-ov5640.dtbo \
    ti/k3-am625-sk-ecap-capture.dtbo \
    ti/k3-am625-sk-hdmi-audio.dtbo \
    ti/k3-am625-sk-mcan.dtbo \
    ti/k3-am625-sk-oldi-panel.dtbo \
"

UBOOT_MACHINE = "am62x_evm_a53_defconfig"

SPL_BINARY = "tispl.bin_HS"
UBOOT_BINARY = "u-boot.img_HS"
UBOOT_SYMLINK = "u-boot.img"
```

## conf/machine/am62xx-lp-evm-k3r5-hs-fs.conf
```bitbake
#@TYPE: Machine
#@NAME: AM62xx LPSK HS-FS EVM (R5F)
#@DESCRIPTION: Machine configuration for the TI AM62xx LP HS-FS EVM (R5F core)

# Booting HS-FS requires different SYSFW, the rest is handled at runtime

require conf/machine/include/k3r5.inc
SOC_FAMILY_append = ":k3r5-hs-fs"

SYSFW_SOC = "am62x"
SYSFW_CONFIG = "evm"
SYSFW_SUFFIX = "hs-fs"

UBOOT_MACHINE = "am62x_lpsk_r5_defconfig"
```

## conf/machine/am62xx-lp-evm-k3r5-hs-se.conf
```bitbake
#@TYPE: Machine
#@NAME: AM62xx LPSK HS-SE EVM (R5F)
#@DESCRIPTION: Machine configuration for the TI AM62xx LP HS-SE EVM (R5F core)

# Booting HS-SE requires different SYSFW, the rest is handled at runtime

require conf/machine/include/k3r5.inc
SOC_FAMILY_append = ":k3r5-hs-se"

SYSFW_SOC = "am62x"
SYSFW_CONFIG = "evm"
SYSFW_SUFFIX = "hs"

SYSFW_TIBOOT3_SYMLINK = ""

UBOOT_MACHINE = "am62x_lpsk_r5_defconfig"

SPL_BINARY = ""
UBOOT_BINARY = "u-boot-spl.${UBOOT_SUFFIX}"
UBOOT_IMAGE = "u-boot-r5spl-hs-se-${MAINMACHINE}-${PV}-${PR}.${UBOOT_SUFFIX}"
UBOOT_SYMLINK = "u-boot-r5spl-hs-se.${UBOOT_SUFFIX}"
```

## conf/machine/am62xx-lp-evm-k3r5.conf
```bitbake
#@TYPE: Machine
#@NAME: AM62XX LP GP EVM (R5F)
#@DESCRIPTION: Machine configuration for the TI AM62xx LP GP EVM (R5F core)

require conf/machine/include/k3r5.inc
SOC_FAMILY_append = ":k3r5-gp"

SYSFW_SOC = "am62x"
SYSFW_CONFIG = "evm"
SYSFW_SUFFIX = "gp"

SYSFW_TIBOOT3_SYMLINK = ""

UBOOT_MACHINE = "am62x_lpsk_r5_defconfig"

SPL_BINARY = ""
UBOOT_BINARY = "u-boot-spl.${UBOOT_SUFFIX}"
UBOOT_IMAGE = "u-boot-r5spl-gp-${MAINMACHINE}-${PV}-${PR}.${UBOOT_SUFFIX}"
UBOOT_SYMLINK = "u-boot-r5spl-gp.${UBOOT_SUFFIX}"
```

## conf/machine/am62xx-lp-evm.conf
```bitbake
#@TYPE: Machine
#@NAME: AM62XX LP EVM
#@DESCRIPTION: Machine configuration for the TI AM62XX LP EVM

require conf/machine/include/am62xx-lp.inc

MACHINE_FEATURES += "gpu"

KERNEL_DEVICETREE = " \
    ti/k3-am62x-lp-sk.dtb \
    ti/k3-am625-skeleton.dtb \
    ti/k3-am625-sk-lpmdemo.dtb \
    ti/k3-am625-sk-csi2-ov5640.dtbo \
    ti/k3-am62x-lp-sk-oldi-panel.dtbo \
"

SPL_BINARY = "tispl.bin_HS"	
UBOOT_BINARY = "u-boot.img_HS"
UBOOT_SYMLINK = "u-boot.img"

UBOOT_MACHINE = "am62x_lpsk_a53_defconfig"
```

## conf/machine/am64xx-evm-k3r5-gp.conf
```bitbake
#@TYPE: Machine
#@NAME: AM64xx GP EVM (R5F)
#@DESCRIPTION: Machine configuration for the TI AM64xx GP EVM (R5F core)

# Booting GP requires different SYSFW, the rest is handled at runtime

require conf/machine/include/k3r5.inc
SOC_FAMILY_append = ":k3r5-gp"

SYSFW_SOC = "am64x"
SYSFW_CONFIG = "evm"
SYSFW_SUFFIX = "gp"
SYSFW_TIBOOT3_SYMLINK = ""

UBOOT_MACHINE = "am64x_evm_r5_defconfig"

SPL_BINARY = ""
UBOOT_BINARY = "u-boot-spl.${UBOOT_SUFFIX}"
UBOOT_IMAGE = "u-boot-r5spl-gp-${MAINMACHINE}-${PV}-${PR}.${UBOOT_SUFFIX}"
UBOOT_SYMLINK = "u-boot-r5spl-gp.${UBOOT_SUFFIX}"
```

## conf/machine/am64xx-evm-k3r5-hs-se.conf
```bitbake
#@TYPE: Machine
#@NAME: AM64xx HS-SE EVM (R5F)
#@DESCRIPTION: Machine configuration for the TI AM64xx HS-SE EVM (R5F core)

# Booting HS-SE requires different SYSFW, the rest is handled at runtime

require conf/machine/include/k3r5.inc
SOC_FAMILY_append = ":k3r5-hs-se"

SYSFW_SOC = "am64x"
SYSFW_CONFIG = "evm"
SYSFW_SUFFIX = "hs"

UBOOT_MACHINE = "am64x_evm_r5_defconfig"
```

## conf/machine/am64xx-evm-k3r5-sr2-hs-fs.conf
```bitbake
#@TYPE: Machine
#@NAME: AM64xx SR2.0 HS-FS EVM (R5F)
#@DESCRIPTION: Machine configuration for the TI AM64xx SR2.0 HS-FS EVM (R5F core)

# Booting SR2.0 HS-FS requires different SYSFW, the rest is handled at runtime

require conf/machine/include/k3r5.inc
SOC_FAMILY_append = ":k3r5-sr2-hs-fs"

SYSFW_SOC = "am64x_sr2"
SYSFW_CONFIG = "evm"
SYSFW_SUFFIX = "hs-fs"

UBOOT_MACHINE = "am64x_evm_r5_defconfig"
```

## conf/machine/am64xx-evm-k3r5-sr2-hs-se.conf
```bitbake
#@TYPE: Machine
#@NAME: AM64xx SR2.0 HS-SE EVM (R5F)
#@DESCRIPTION: Machine configuration for the TI AM64xx SR2.0 HS-SE EVM (R5F core)

# Booting SR2.0 HS-SE requires different SYSFW, the rest is handled at runtime

require conf/machine/include/k3r5.inc
SOC_FAMILY_append = ":k3r5-sr2-hs-se"

SYSFW_SOC = "am64x_sr2"
SYSFW_CONFIG = "evm"
SYSFW_SUFFIX = "hs"
SYSFW_TIBOOT3_SYMLINK = ""

UBOOT_MACHINE = "am64x_evm_r5_defconfig"

SPL_BINARY = ""
UBOOT_BINARY = "u-boot-spl.${UBOOT_SUFFIX}"
UBOOT_IMAGE = "u-boot-r5spl-sr2-hs-se-${MAINMACHINE}-${PV}-${PR}.${UBOOT_SUFFIX}"
UBOOT_SYMLINK = "u-boot-r5spl-sr2-hs-se.${UBOOT_SUFFIX}"
```

## conf/machine/am64xx-evm-k3r5.conf
```bitbake
#@TYPE: Machine
#@NAME: AM64xx EVM (R5F)
#@DESCRIPTION: Machine configuration for the TI AM64xx EVM (R5F core)

require conf/machine/include/k3r5.inc

# UPdate for am64
SYSFW_SOC = "am65x"
SYSFW_CONFIG = "evm"
SYSFW_SUFFIX = "gp"
SYSFW_SYMLINK = "sysfw.itb"

UBOOT_MACHINE = "am64x_evm_r5_defconfig"
```

## conf/machine/am64xx-evm.conf
```bitbake
#@TYPE: Machine
#@NAME: AM64xx EVM
#@DESCRIPTION: Machine configuration for the TI AM64xx EVM

require conf/machine/include/am64xx.inc

UBOOT_MACHINE = "am64x_evm_a53_defconfig"

SPL_BINARY = "tispl.bin_HS"
UBOOT_BINARY = "u-boot.img_HS"
UBOOT_SYMLINK = "u-boot.img"

# Since default tiboot3.bin on AM64x is for HS-SE, add a version for GP
BBMULTICONFIG += "k3r5-gp"
IMAGE_BOOT_FILES += " tiboot3-am64x-gp-evm.bin"
do_image_wic[mcdepends] += "mc::k3r5-gp:ti-sci-fw:do_deploy"
do_image_tar[mcdepends] += "mc::k3r5-gp:ti-sci-fw:do_deploy"
```
