## conf/machine/include/omap3.inc
```bitbake
require conf/machine/include/ti-soc.inc
SOC_FAMILY_append = ":omap3"

DEFAULTTUNE ?= "armv7athf-neon"
require conf/machine/include/tune-cortexa8.inc

PREFERRED_PROVIDER_virtual/xserver = "xserver-xorg"

# For built-in LCD, add xf86-input-tslib
XSERVER = "xserver-xorg \
           xf86-input-evdev \
           xf86-input-mouse \
           xf86-video-fbdev \
           xf86-input-keyboard"

# Default to external video, change to smallscreen for built-in LCD
MACHINE_GUI_CLASS = "bigscreen"

# Increase this everytime you change something in the kernel
MACHINE_KERNEL_PR = "r127"

KERNEL_IMAGETYPE = "zImage"

# Default providers, may need to override for specific machines
PREFERRED_PROVIDER_virtual/kernel = "linux-ti-staging"
PREFERRED_PROVIDER_virtual/bootloader = "u-boot-ti-staging"
PREFERRED_PROVIDER_u-boot = "u-boot-ti-staging"

KERNEL_DEVICETREE = "omap3-beagle.dtb omap3-beagle-xm.dtb omap3-beagle-xm-ab.dtb omap3-evm.dtb omap3-evm-37xx.dtb am3517-evm.dtb"

UBOOT_ARCH = "arm"
UBOOT_MACHINE = "omap3_evm_config"
XLOAD_MACHINE = "omap3evm_config"

UBOOT_ENTRYPOINT = "0x80008000"
UBOOT_LOADADDRESS = "0x80008000"

# If SPL is not used, may need to add x-load
EXTRA_IMAGEDEPENDS += "u-boot"

# List common SoC features, may need to add touchscreen/ethernet for specific machines
MACHINE_FEATURES = "kernel26 apm usbgadget usbhost vfat ext2 screen alsa sgx"
```

## conf/machine/include/omap4.inc
```bitbake
require conf/machine/include/ti-soc.inc
SOC_FAMILY_append = ":omap4"

DEFAULTTUNE ?= "armv7athf-neon"
require conf/machine/include/tune-cortexa9.inc

PREFERRED_PROVIDER_virtual/kernel ?= "linux-ti-staging"
PREFERRED_PROVIDER_virtual/bootloader = "u-boot-ti-staging"
PREFERRED_PROVIDER_u-boot = "u-boot-ti-staging"

PREFERRED_PROVIDER_virtual/xserver = "xserver-xorg"
XSERVER = "xserver-xorg \
           xf86-input-evdev \
           xf86-video-fbdev"

# Increase this everytime you change something in the kernel
MACHINE_KERNEL_PR = "r4"

KERNEL_IMAGETYPE = "zImage"

UBOOT_MACHINE = "omap4_panda_config"

UBOOT_ENTRYPOINT = "0x80008000"
UBOOT_LOADADDRESS = "0x80008000"

EXTRA_IMAGEDEPENDS += "u-boot"
```

## conf/machine/include/omapl137.inc
```bitbake
require conf/machine/include/omapl1.inc
SOC_FAMILY_append = ":omapl137"

# Set the list of device targets for ti-pdk class recipes
TI_PDK_LIMIT_SOCS = "omapl137"
```

## conf/machine/include/ti-soc.inc
```bitbake
# This is a generic TI SOC family. It is a superset of all other SOCs
# and platforms defined in meta-ti to allow BSP-level overrides.
SOC_FAMILY = "ti-soc"
KERNEL_DTB_OVERLAY_SUPPORT ?= "1"
require conf/machine/include/soc-family.inc
```

## conf/machine/include/ti33x.inc
```bitbake
require conf/machine/include/ti-soc.inc
SOC_FAMILY_append = ":ti33x"

DEFAULTTUNE ?= "armv7athf-neon"
require conf/machine/include/tune-cortexa8.inc

PREFERRED_PROVIDER_virtual/xserver = "xserver-xorg"

# For built-in LCD, add xf86-input-tslib
XSERVER = "xserver-xorg \
           xf86-input-evdev \
           xf86-input-mouse \
           xf86-video-fbdev \
           xf86-input-keyboard"

# Default to external video, change to smallscreen for built-in LCD
MACHINE_GUI_CLASS = "bigscreen"

# Increase this everytime you change something in the kernel
MACHINE_KERNEL_PR = "r22"

# Default providers, may need to override for specific machines
PREFERRED_PROVIDER_virtual/kernel = "linux-ti-staging"
PREFERRED_PROVIDER_virtual/bootloader = "u-boot-ti-staging"
PREFERRED_PROVIDER_u-boot = "u-boot-ti-staging"

KERNEL_IMAGETYPE = "zImage"

KERNEL_DEVICETREE = "am335x-evm.dtb am335x-evmsk.dtb am335x-icev2.dtb \
                    am335x-bone.dtb am335x-boneblue.dtb \
                    am335x-boneblack.dtb am335x-boneblack-wireless.dtb \
                    am335x-bonegreen.dtb am335x-bonegreen-wireless.dtb"

KERNEL_DEVICETREE += "${@oe.utils.conditional('ENABLE_TI_UIO_DEVICES', '1', 'am335x-icev2-pru-excl-uio.dtb', '', d)}"

UBOOT_ARCH = "arm"
UBOOT_MACHINE = "am335x_evm_config"

UBOOT_ENTRYPOINT = "0x80008000"
UBOOT_LOADADDRESS = "0x80008000"

# Use the expected value of the ubifs filesystem's volume name in the kernel
# and u-boot.
UBI_VOLNAME = "rootfs"

EXTRA_IMAGEDEPENDS += "u-boot"

# List common SoC features, may need to add touchscreen for specific machines
MACHINE_FEATURES = "kernel26 apm usbgadget usbhost vfat ext2 screen alsa ethernet sgx"

# Set the list of device targets for ti-pdk class recipes
TI_PDK_LIMIT_SOCS = "am335x"
TI_PDK_LIMIT_BOARDS = "evmAM335x icev2AM335x iceAMIC110 bbbAM335x skAM335x"
```

## conf/machine/include/ti43x.inc
```bitbake
require conf/machine/include/ti-soc.inc
SOC_FAMILY_append = ":ti43x"

DEFAULTTUNE ?= "armv7athf-neon"
require conf/machine/include/tune-cortexa9.inc

PREFERRED_PROVIDER_virtual/xserver = "xserver-xorg"

# For built-in LCD, add xf86-input-tslib
XSERVER = "xserver-xorg \
           xf86-input-evdev \
           xf86-input-mouse \
           xf86-video-fbdev \
           xf86-input-keyboard"

# Default to external video, change to smallscreen for built-in LCD
MACHINE_GUI_CLASS = "bigscreen"

# Increase this everytime you change something in the kernel
MACHINE_KERNEL_PR = "r3"

# Default providers, may need to override for specific machines
PREFERRED_PROVIDER_virtual/kernel ?= "linux-ti-staging"
PREFERRED_PROVIDER_virtual/bootloader = "u-boot-ti-staging"
PREFERRED_PROVIDER_u-boot = "u-boot-ti-staging"

KERNEL_IMAGETYPE = "zImage"

KERNEL_DEVICETREE = " \
    am437x-gp-evm.dtb \
    ${@oe.utils.conditional('ARAGO_BRAND', 'mainline', '', 'am437x-gp-evm-hdmi.dtb', d)} \
    am437x-sk-evm.dtb am437x-idk-evm.dtb \
    am43x-epos-evm.dtb \
    ${@oe.utils.conditional('ARAGO_BRAND', 'mainline', '', 'am43x-epos-evm-hdmi.dtb', d)} \
"

KERNEL_DEVICETREE += "${@oe.utils.conditional('ENABLE_TI_UIO_DEVICES', '1', 'am437x-idk-pru-excl-uio.dtb', '', d)}"

UBOOT_ARCH = "arm"
UBOOT_MACHINE = "am43xx_evm_config"

UBOOT_ENTRYPOINT = "0x80008000"
UBOOT_LOADADDRESS = "0x80008000"

# Generate an extlinux.conf file
UBOOT_EXTLINUX = "1"
UBOOT_EXTLINUX_ROOT = "root=PARTUUID=${uuid}"
UBOOT_EXTLINUX_BOOT_FILES = " \
    extlinux.conf;extlinux/extlinux.conf \
    ${KERNEL_IMAGETYPE} \
    ${KERNEL_DEVICETREE} \
"

SPL_BINARY = "MLO"
UBOOT_SUFFIX = "img"

# Use the expected value of the ubifs filesystem's volume name in the kernel
# and u-boot.
UBI_VOLNAME = "rootfs"

EXTRA_IMAGEDEPENDS += "u-boot"

# List common SoC features, may need to add touchscreen for specific machines
MACHINE_FEATURES = "kernel26 apm usbgadget usbhost vfat ext2 screen alsa ethernet gpu"

# Set the list of device targets for ti-pdk class recipes
TI_PDK_LIMIT_SOCS = "am437x"
TI_PDK_LIMIT_BOARDS = "evmAM437x idkAM437x skAM437x"

IMAGE_FSTYPES += "tar.xz wic.xz wic.bmap"
WKS_FILE ?= "sdimage-2part.wks"
IMAGE_BOOT_FILES ?= "${SPL_BINARY} u-boot.${UBOOT_SUFFIX} ${UBOOT_EXTLINUX_BOOT_FILES}"
do_image_wic[depends] += "u-boot:do_deploy"
```

## conf/machine/j7-evm.conf
```bitbake
#@TYPE: Machine
#@NAME: J7 EVM
#@DESCRIPTION: Machine configuration for the TI J7 EVM

require conf/machine/include/j7.inc

MACHINE_FEATURES += "gpu"

SERIAL_CONSOLES = "115200;ttyS2 115200;ttyS3"
SERIAL_CONSOLES_CHECK = "${SERIAL_CONSOLES}"

# Since J721e does not support multi-cert tiboot3.bin add standalone sysfw.itb
IMAGE_BOOT_FILES += "sysfw.itb"

KERNEL_DEVICETREE = " \
    ti/k3-j721e-common-proc-board.dtb \
    ti/k3-j721e-proc-board-tps65917.dtb \
    ti/k3-j721e-common-proc-board-infotainment.dtbo \
    ti/k3-j721e-cpb-csi2-ov5640.dtbo \
    ti/k3-j721e-fpdlink-cpb-fusion.dtbo \
    ti/k3-j721e-fpdlink-imx390-cm-0-0.dtbo \
    ti/k3-j721e-fpdlink-imx390-cm-0-1.dtbo \
    ti/k3-j721e-fpdlink-imx390-cm-0-2.dtbo \
    ti/k3-j721e-fpdlink-imx390-cm-0-3.dtbo \
    ti/k3-j721e-fpdlink-imx390-cm-1-0.dtbo \
    ti/k3-j721e-fpdlink-imx390-cm-1-1.dtbo \
    ti/k3-j721e-fpdlink-imx390-cm-1-2.dtbo \
    ti/k3-j721e-fpdlink-imx390-cm-1-3.dtbo \
    ti/k3-j721e-fpdlink-imx390-rcm-0-0.dtbo \
    ti/k3-j721e-fpdlink-imx390-rcm-0-1.dtbo \
    ti/k3-j721e-fpdlink-imx390-rcm-0-2.dtbo \
    ti/k3-j721e-fpdlink-imx390-rcm-0-3.dtbo \
    ti/k3-j721e-fpdlink-imx390-rcm-1-0.dtbo \
    ti/k3-j721e-fpdlink-imx390-rcm-1-1.dtbo \
    ti/k3-j721e-fpdlink-imx390-rcm-1-2.dtbo \
    ti/k3-j721e-fpdlink-imx390-rcm-1-3.dtbo \
    ti/k3-j721e-sk.dtb \
    ti/k3-j721e-fpdlink-sk-fusion.dtbo \
    ti/k3-j721e-sk-csi2-ov5640.dtbo \
    ti/k3-j721e-sk-rpi-cam-imx219.dtbo \
    ti/k3-j721e-common-proc-board-uarts.dtbo \
    ti/k3-j7200-mcspi-loopback.dtbo \
"

UBOOT_MACHINE = "j721e_evm_a72_config"
```

## conf/machine/j7-hs-evm-k3r5-sr1-1.conf
```bitbake
#@TYPE: Machine
#@NAME: J7 SR1.1 HS EVM (R5F)
#@DESCRIPTION: Machine configuration for the TI J7 SR1.1 HS EVM (R5F core)

# Booting SR1.1 requires different SYSFW, the rest is handled at runtime

require conf/machine/j7-hs-evm-k3r5.conf
SOC_FAMILY_append = ":k3r5-sr1-1"

SYSFW_SOC = "j721e_sr1_1"
SYSFW_SYMLINK = "sysfw.itb"
```

## conf/machine/j7-hs-evm-k3r5.conf
```bitbake
#@TYPE: Machine
#@NAME: J7 HS EVM (R5F)
#@DESCRIPTION: Machine configuration for the TI J7 HS EVM (R5F core)

require conf/machine/include/k3r5.inc

SYSFW_SOC = "j721e"
SYSFW_CONFIG = "evm"
SYSFW_SUFFIX = "hs"
SYSFW_SYMLINK = ""

SPL_BINARY = "spl/u-boot-spl.${UBOOT_SUFFIX}"
SPL_SYMLINK = "u-boot-r5spl.${UBOOT_SUFFIX}"
UBOOT_BINARY = "tiboot3.${UBOOT_SUFFIX}"
UBOOT_IMAGE = "tiboot3-${MAINMACHINE}-${PV}-${PR}.${UBOOT_SUFFIX}"
UBOOT_SYMLINK = "tiboot3-${MAINMACHINE}.${UBOOT_SUFFIX}"

UBOOT_MACHINE = "j721e_hs_evm_r5_defconfig"
```

## conf/machine/j7-hs-evm.conf
```bitbake
#@TYPE: Machine
#@NAME: J7 HS EVM
#@DESCRIPTION: Machine configuration for the TI J7 HS EVM

require conf/machine/j7-evm.conf

UBOOT_MACHINE = "j721e_hs_evm_a72_defconfig"

SPL_BINARY = "tispl.bin_HS"
UBOOT_BINARY = "u-boot.img_HS"
UBOOT_SYMLINK = "u-boot.img"
SYSFW_SYMLINK = ""

BBMULTICONFIG += "k3r5-sr1-1"

# Since default sysfw.itb on J7 is for SR1.1, add a version for SR1.0
IMAGE_BOOT_FILES += "sysfw-j721e-evm.itb"
do_image_wic[mcdepends] += "mc::k3r5-sr1-1:ti-sci-fw:do_deploy"
do_image_tar[mcdepends] += "mc::k3r5-sr1-1:ti-sci-fw:do_deploy"
```

## conf/machine/j7200-evm-k3r5.conf
```bitbake
#@TYPE: Machine
#@NAME: J7200 EVM (R5F)
#@DESCRIPTION: Machine configuration for the TI J7200 EVM (R5F core)

require conf/machine/include/k3r5.inc

SYSFW_SOC = "j7200"
SYSFW_CONFIG = "evm"
SYSFW_SUFFIX = "gp"

UBOOT_MACHINE = "j7200_evm_r5_defconfig"
UBOOT_BINARY = "tiboot3.${UBOOT_SUFFIX}"
UBOOT_IMAGE = "tiboot3-${MAINMACHINE}-${PV}-${PR}.${UBOOT_SUFFIX}"
UBOOT_SYMLINK = "tiboot3-${MAINMACHINE}.${UBOOT_SUFFIX}"
```

## conf/machine/j7200-evm.conf
```bitbake
#@TYPE: Machine
#@NAME: J7200 EVM
#@DESCRIPTION: Machine configuration for the TI J7200 EVM

require conf/machine/include/j7.inc

SERIAL_CONSOLES = "115200;ttyS2 115200;ttyS3"
SERIAL_CONSOLES_CHECK = "${SERIAL_CONSOLES}"

KERNEL_DEVICETREE = " \
    ti/k3-j7200-common-proc-board.dtb \
    ti/k3-j7200-mcspi-loopback.dtbo \
    ti/k3-j7200-common-proc-board-uarts.dtbo \
"

UBOOT_MACHINE = "j7200_evm_a72_config"

do_image_wic[mcdepends] = "mc::k3r5:ti-sci-fw:do_deploy"
do_image_tar[mcdepends] = "mc::k3r5:ti-sci-fw:do_deploy"
```

## conf/machine/j7200-hs-evm.conf
```bitbake
#@TYPE: Machine
#@NAME: J7200 HS EVM
#@DESCRIPTION: Machine configuration for the TI J7200 HS EVM

require conf/machine/j7200-evm.conf

UBOOT_MACHINE = "j7200_hs_evm_a72_defconfig"

SPL_BINARY = "tispl.bin_HS"
UBOOT_BINARY = "u-boot.img_HS"
UBOOT_SYMLINK = "u-boot.img"
```

## conf/machine/j721s2-evm-k3r5-sr1-hs-fs.conf
```bitbake
#@TYPE: Machine
#@NAME: J721S2 HS-FS EVM (R5F)
#@DESCRIPTION: Machine configuration for the TI J721S2 HS-FS EVM (R5F core)

# Booting HS-FS requires different SYSFW, the rest is handled at runtime

require conf/machine/include/k3r5.inc
SOC_FAMILY_append = ":k3r5-sr1-hs-fs"

SYSFW_SOC = "j721s2"
SYSFW_CONFIG = "evm"
SYSFW_SUFFIX = "hs-fs"
SYSFW_TIBOOT3_SYMLINK = ""

UBOOT_MACHINE = "j721s2_evm_r5_defconfig"
```

## conf/machine/j721s2-evm.conf
```bitbake
#@TYPE: Machine
#@NAME: J721S2 EVM
#@DESCRIPTION: Machine configuration for the TI J721S2 EVM

require conf/machine/include/j7.inc

MACHINE_FEATURES += "gpu"

SERIAL_CONSOLES = "115200;ttyS2"
SERIAL_CONSOLES_CHECK = "${SERIAL_CONSOLES}"
TFA_K3_USART = "0x8"
OPTEEMACHINE = "k3-j784s4"
OPTEE_K3_USART = "0x8"

KERNEL_DEVICETREE = " \
    ti/k3-am68-sk-base-board.dtb \
    ti/k3-am68-sk-bb-csi2-ov5640.dtbo \
    ti/k3-am68-sk-bb-rpi-cam-imx219.dtbo \
    ti/k3-am68-sk-fpdlink-fusion.dtbo \
    ti/k3-am68-sk-rpi-hdr-ehrpwm.dtbo \
    ti/k3-am68-sk-som-ddr_mem_carveout.dtbo \
    ti/k3-j721e-fpdlink-imx390-cm-0-0.dtbo \
    ti/k3-j721e-fpdlink-imx390-cm-0-1.dtbo \
    ti/k3-j721e-fpdlink-imx390-cm-0-2.dtbo \
    ti/k3-j721e-fpdlink-imx390-cm-0-3.dtbo \
    ti/k3-j721e-fpdlink-imx390-cm-1-0.dtbo \
    ti/k3-j721e-fpdlink-imx390-cm-1-1.dtbo \
    ti/k3-j721e-fpdlink-imx390-cm-1-2.dtbo \
    ti/k3-j721e-fpdlink-imx390-cm-1-3.dtbo \
    ti/k3-j721e-fpdlink-imx390-rcm-0-0.dtbo \
    ti/k3-j721e-fpdlink-imx390-rcm-0-1.dtbo \
    ti/k3-j721e-fpdlink-imx390-rcm-0-2.dtbo \
    ti/k3-j721e-fpdlink-imx390-rcm-0-3.dtbo \
    ti/k3-j721e-fpdlink-imx390-rcm-1-0.dtbo \
    ti/k3-j721e-fpdlink-imx390-rcm-1-1.dtbo \
    ti/k3-j721e-fpdlink-imx390-rcm-1-2.dtbo \
    ti/k3-j721e-fpdlink-imx390-rcm-1-3.dtbo \
    ti/k3-j721s2-common-proc-board.dtb \
    ti/k3-j721s2-cpb-csi2-ov5640.dtbo \
    ti/k3-j721s2-fpdlink-cpb-fusion.dtbo \
    ti/k3-j721s2-gesi-exp-board.dtbo \
    ti/k3-j721s2-common-proc-board-uarts.dtbo \
    ti/k3-j7200-mcspi-loopback.dtbo \
"

UBOOT_MACHINE = "j721s2_evm_a72_defconfig"

# Default tiboot3.bin on J721S2 is for GP
BBMULTICONFIG = "k3r5-gp"
do_image_wic[mcdepends] = "mc::k3r5-gp:ti-sci-fw:do_deploy"
do_image_tar[mcdepends] = "mc::k3r5-gp:ti-sci-fw:do_deploy"

# Since default tiboot3.bin on J721S2 is for GP, add a version for SR1.0 HS-FS
BBMULTICONFIG += "k3r5-sr1-hs-fs"
IMAGE_BOOT_FILES += " tiboot3-j721s2-hs-fs-evm.bin"
do_image_wic[mcdepends] += "mc::k3r5-sr1-hs-fs:ti-sci-fw:do_deploy"
do_image_tar[mcdepends] += "mc::k3r5-sr1-hs-fs:ti-sci-fw:do_deploy"
```

## conf/machine/j721s2-hs-evm.conf
```bitbake
#@TYPE: Machine
#@NAME: J721S2 HS EVM
#@DESCRIPTION: Machine configuration for the TI J721S2 HS EVM

require conf/machine/include/j7.inc

MACHINE_FEATURES += "gpu"

SERIAL_CONSOLES = "115200;ttyS2"
SERIAL_CONSOLES_CHECK = "${SERIAL_CONSOLES}"
TFA_K3_USART = "0x8"
OPTEEMACHINE = "k3-j784s4"
OPTEE_K3_USART = "0x8"

KERNEL_DEVICETREE = " \
    ti/k3-j721s2-common-proc-board.dtb \
    ti/k3-j721s2-gesi-exp-board.dtbo \
"

UBOOT_MACHINE = "j721s2_hs_evm_a72_defconfig"

do_image_wic[mcdepends] = "mc::k3r5:ti-sci-fw:do_deploy"
do_image_tar[mcdepends] = "mc::k3r5:ti-sci-fw:do_deploy"

SPL_BINARY = "tispl.bin_HS"
UBOOT_BINARY = "u-boot.img_HS"
UBOOT_SYMLINK = "u-boot.img"
```

## conf/machine/j784s4-evm-k3r5-gp.conf
```bitbake
#@TYPE: Machine
#@NAME: J784S4 GP EVM (R5F)
#@DESCRIPTION: Machine configuration for the TI J784S4 GP EVM (R5F core)

# Booting GP requires different SYSFW, the rest is handled at runtime

require conf/machine/include/k3r5.inc
SOC_FAMILY_append = ":k3r5-gp"

SYSFW_SOC = "j784s4"
SYSFW_CONFIG = "evm"
SYSFW_SUFFIX = "gp"
SYSFW_TIBOOT3_SYMLINK = "tiboot3.bin"

UBOOT_MACHINE = "j784s4_evm_r5_defconfig"

SPL_BINARY = ""
UBOOT_BINARY = "u-boot-spl.${UBOOT_SUFFIX}"
UBOOT_IMAGE = "u-boot-r5spl-gp-${MAINMACHINE}-${PV}-${PR}.${UBOOT_SUFFIX}"
UBOOT_SYMLINK = "u-boot-r5spl-gp.${UBOOT_SUFFIX}"
```

## conf/machine/j784s4-evm-k3r5-sr1-hs-fs.conf
```bitbake
#@TYPE: Machine
#@NAME: J784S4 HS-FS EVM (R5F)
#@DESCRIPTION: Machine configuration for the TI J784S4 HS-FS EVM (R5F core)

# Booting HS-FS requires different SYSFW, the rest is handled at runtime

require conf/machine/include/k3r5.inc
SOC_FAMILY_append = ":k3r5-sr1-hs-fs"

SYSFW_SOC = "j784s4"
SYSFW_CONFIG = "evm"
SYSFW_SUFFIX = "hs-fs"
SYSFW_TIBOOT3_SYMLINK = ""
SYSFW_SYMLINK = ""

UBOOT_MACHINE = "j784s4_evm_r5_defconfig"
```
