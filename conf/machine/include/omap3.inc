## conf/machine/j784s4-evm.conf
```bitbake
#@TYPE: Machine
#@NAME: J784S4 EVM
#@DESCRIPTION: Machine configuration for the TI J784S4 EVM

require conf/machine/include/j7.inc

MACHINE_FEATURES += "gpu"

SERIAL_CONSOLES = "115200;ttyS2"
SERIAL_CONSOLES_CHECK = "${SERIAL_CONSOLES}"
TFA_K3_USART = "0x8"
OPTEEMACHINE = "k3-j784s4"
OPTEE_K3_USART = "0x8"

KERNEL_DEVICETREE = " \
    ti/k3-am69-sk.dtb \
    ti/k3-am69-sk-csi2-ov5640.dtbo \
    ti/k3-am69-sk-ddr-mem-carveout.dtbo \
    ti/k3-am69-sk-fpdlink-fusion.dtbo \
    ti/k3-am69-sk-rpi-hdr-ehrpwm.dtbo \
    ti/k3-am69-sk-rpi-cam-imx219.dtbo \
    ti/k3-j721e-fpdlink-imx390-cm-0-0.dtbo \
    ti/k3-j721e-fpdlink-imx390-cm-0-1.dtbo \
    ti/k3-j721e-fpdlink-imx390-cm-0-2.dtbo \
    ti/k3-j721e-fpdlink-imx390-cm-0-3.dtbo \
    ti/k3-j721e-fpdlink-imx390-cm-1-0.dtbo \
    ti/k3-j721e-fpdlink-imx390-cm-1-1.dtbo \
    ti/k3-j721e-fpdlink-imx390-cm-1-2.dtbo \
    ti/k3-j721e-fpdlink-imx390-cm-1-3.dtbo \
    ti/k3-j721e-fpdlink-imx390-rcm-0-0.dtbo \
    ti/k3-j721e-fpdlink-imx390-rcm-0-1.dtbo \
    ti/k3-j721e-fpdlink-imx390-rcm-0-2.dtbo \
    ti/k3-j721e-fpdlink-imx390-rcm-0-3.dtbo \
    ti/k3-j721e-fpdlink-imx390-rcm-1-0.dtbo \
    ti/k3-j721e-fpdlink-imx390-rcm-1-1.dtbo \
    ti/k3-j721e-fpdlink-imx390-rcm-1-2.dtbo \
    ti/k3-j721e-fpdlink-imx390-rcm-1-3.dtbo \
    ti/k3-j784s4-evm.dtb \
    ti/k3-j784s4-evm-csi2-ov5640.dtbo \
    ti/k3-j784s4-fpdlink-fusion.dtbo \
    ti/k3-j784s4-evm-uarts.dtbo \
    ti/k3-j7200-mcspi-loopback.dtbo \
"

UBOOT_MACHINE = "j784s4_evm_a72_defconfig"

# Default tiboot3.bin on J784S4 is for GP
BBMULTICONFIG = "k3r5-gp"
do_image_wic[mcdepends] = "mc::k3r5-gp:ti-sci-fw:do_deploy"
do_image_tar[mcdepends] = "mc::k3r5-gp:ti-sci-fw:do_deploy"

# Since default tiboot3.bin on J784S4 is for GP, add a version for SR1.0 HS-FS
BBMULTICONFIG += "k3r5-sr1-hs-fs"
IMAGE_BOOT_FILES += " tiboot3-j784s4-hs-fs-evm.bin"
do_image_wic[mcdepends] += "mc::k3r5-sr1-hs-fs:ti-sci-fw:do_deploy"
do_image_tar[mcdepends] += "mc::k3r5-sr1-hs-fs:ti-sci-fw:do_deploy"

TFA_BOARD = "j784s4"
```

## conf/machine/j784s4-hs-evm.conf
```bitbake
#@TYPE: Machine
#@NAME: J784S4 HS EVM
#@DESCRIPTION: Machine configuration for the TI J784S4 HS EVM

require conf/machine/include/j7.inc

MACHINE_FEATURES += "gpu"

SERIAL_CONSOLES = "115200;ttyS2"
SERIAL_CONSOLES_CHECK = "${SERIAL_CONSOLES}"
TFA_K3_USART = "0x8"
OPTEEMACHINE = "k3-j784s4"
OPTEE_K3_USART = "0x8"

KERNEL_DEVICETREE = " \
    ti/k3-j784s4-evm.dtb \
"

UBOOT_MACHINE = "j784s4_evm_a72_defconfig"

do_image_wic[mcdepends] = "mc::k3r5:ti-sci-fw:do_deploy"
do_image_tar[mcdepends] = "mc::k3r5:ti-sci-fw:do_deploy"

TFA_BOARD = "j784s4"

SPL_BINARY = "tispl.bin_HS"
UBOOT_BINARY = "u-boot.img_HS"
UBOOT_SYMLINK = "u-boot.img"
```

## conf/machine/k2e-hs-evm.conf
```bitbake
#@TYPE: Machine
#@NAME: Keystone 2 K2E HS EVM
#@DESCRIPTION: Machine configuration for the TI Keystone 2 K2E HS EVM

require conf/machine/k2e-evm.conf

UBOOT_MACHINE = "k2e_hs_evm_config"
SPL_BINARY = ""

UBOOT_ENTRYPOINT = "0x82000000"
UBOOT_LOADADDRESS = "0x82000000"
UBOOT_RD_LOADADDRESS = "0x84000000"
UBOOT_RD_ENTRYPOINT = "0x84000000"

TI_SECURE_DEV_PKG = "${TI_SECURE_DEV_PKG_CAT}/k2e"
```

## conf/machine/k2g-evm.conf
```bitbake
#@TYPE: Machine
#@NAME: Keystone 2 K2G machine
#@DESCRIPTION: Machine configuration for the TI Keystone 2 K2G EVM

require conf/machine/include/k2g.inc

MACHINE_FEATURES += "alsa"

KERNEL_DEVICETREE = "keystone-k2g-evm.dtb keystone-k2g-ice.dtb \
                     ${@oe.utils.conditional('ENABLE_TI_UIO_DEVICES', '1', 'keystone-k2g-ice-pru-excl-uio.dtb', '', d)}"

UBOOT_MACHINE = "k2g_evm_config"

BOOT_MONITOR_MAKE_TARGET = "k2g"

IMAGE_FSTYPES += "ubifs ubi tar.xz"

SERIAL_CONSOLES = "115200;ttyS0"

SYSVINIT_ENABLED_GETTYS = ""

# do ubiattach /dev/ubi_ctrl -m 4
# From dmesg:
# UBI: smallest flash I/O unit:    4096
# UBI: logical eraseblock size:    253952 bytes
# from ubiattach stdout:
# UBI device number 0, total 1926 LEBs
MKUBIFS_ARGS = "-F -m 4096 -e 253952 -c 1926"

# do ubiattach /dev/ubi_ctrl -m 4
# from dmesg:
# UBI: smallest flash I/O unit:    4096
# UBI: physical eraseblock size:   256 KiB
# UBI: sub-page size:              4096
UBINIZE_ARGS = "-m 4096 -p 256KiB -s 4096 -O 4096"
```

## conf/machine/k2g-ice.conf
```bitbake
#@TYPE: Machine
#@NAME: Keystone 2 K2G ICE machine
#@DESCRIPTION: Machine configuration for the TI Keystone 2 K2G ICE

require conf/machine/k2g-evm.conf

UBOOT_MACHINE = "k2g_ice_config"
```
