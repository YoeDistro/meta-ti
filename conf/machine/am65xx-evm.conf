## conf/machine/am65xx-evm.conf
```bitbake
#@TYPE: Machine
#@NAME: AM65xx EVM
#@DESCRIPTION: Machine configuration for the TI AM65xx EVM

require conf/machine/include/am65xx.inc

BBMULTICONFIG += "k3r5-sr2"

UBOOT_MACHINE = "am65x_evm_a53_defconfig"

IMAGE_BOOT_FILES += "sysfw-am65x-evm.itb"
do_image_wic[mcdepends] += "mc::k3r5-sr2:ti-sci-fw:do_deploy"
do_image_tar[mcdepends] += "mc::k3r5-sr2:ti-sci-fw:do_deploy"
```

## conf/machine/am65xx-hs-evm-k3r5-sr2.conf
```bitbake
#@TYPE: Machine
#@NAME: AM65xx SR2.0 HS EVM (R5F)
#@DESCRIPTION: Machine configuration for the TI AM65xx SR2.0 HS EVM (R5F core)

# Booting SR2 requires different SYSFW, the rest is handled at runtime

require conf/machine/am65xx-hs-evm-k3r5.conf
SOC_FAMILY_append = ":k3r5-sr2"

SYSFW_SOC = "am65x_sr2"
SYSFW_SYMLINK = "sysfw.itb"
```

## conf/machine/am65xx-hs-evm.conf
```bitbake
#@TYPE: Machine
#@NAME: AM65xx HS EVM
#@DESCRIPTION: Machine configuration for the TI AM65xx HS EVM

require conf/machine/include/am65xx.inc

UBOOT_MACHINE = "am65x_hs_evm_a53_defconfig"

SPL_BINARY = "tispl.bin_HS"
UBOOT_BINARY = "u-boot.img_HS"
UBOOT_SYMLINK = "u-boot.img"
```

## conf/machine/beagle-x15.conf
```bitbake
#@TYPE: Machine
#@NAME: BeagleBoard X15
#@DESCRIPTION: Machine configuration for the BeagleBoard X15

require conf/machine/include/dra7xx.inc

KERNEL_DEVICETREE = "am57xx-beagle-x15.dtb am57xx-beagle-x15-revb1.dtb am57xx-beagle-x15-revc.dtb"

MACHINE_GUI_CLASS = "bigscreen"

SERIAL_CONSOLES = "115200;ttyS2"

UBOOT_MACHINE = "am57xx_evm_config"
```

## conf/machine/beaglebone.conf
```bitbake
#@TYPE: Machine
#@NAME: BeagleBone machine
#@DESCRIPTION: Machine configuration for the http://beagleboard.org/bone board

require conf/machine/include/ti33x.inc

KERNEL_DEVICETREE = "am335x-bone.dtb am335x-boneblue.dtb \
                    am335x-boneblack.dtb am335x-boneblack-wireless.dtb \
                    am335x-bonegreen.dtb am335x-bonegreen-wireless.dtb"

# Only has DVI connector for external screen
MACHINE_GUI_CLASS = "bigscreen"

SERIAL_CONSOLES = "115200;ttyS0"

IMAGE_INSTALL_append = " kernel-devicetree kernel-image-zimage"

# Refine the list of device targets for ti-pdk class recipes
TI_PDK_LIMIT_BOARDS = "bbbAM335x"
```

## conf/machine/c665x-evm.conf
```bitbake
#@TYPE: Machine
#@NAME: Keystone 1 c665x machine
#@DESCRIPTION: Machine configuration for the TI Keystone 1 c665x EVM

require conf/machine/include/c66x.inc

# Set the list of device targets for ti-pdk class recipes
TI_PDK_LIMIT_SOCS = "c6657"
TI_PDK_LIMIT_BOARDS = "evmC6657"
```

## conf/machine/c667x-evm.conf
```bitbake
#@TYPE: Machine
#@NAME: Keystone 1 c667x machine
#@DESCRIPTION: Machine configuration for the TI Keystone 1 c667x EVM

require conf/machine/include/c66x.inc

# Set the list of device targets for ti-pdk class recipes
TI_PDK_LIMIT_SOCS = "c6678"
TI_PDK_LIMIT_BOARDS = "evmC6678"
```

## conf/machine/dra7xx-evm.conf
```bitbake
#@TYPE: Machine
#@NAME: DRA7xx EVM
#@DESCRIPTION: Machine configuration for the TI DRA7xx EVM

require conf/machine/include/dra7xx.inc

MACHINE_FEATURES += "touchscreen"

SERIAL_CONSOLES = "115200;ttyS0"

KERNEL_DEVICETREE = " \
    dra7-evm.dtb \
    ti/dra7x-evm-osd-lcd-common.dtbo \
    dra71-evm.dtb \
    ${@oe.utils.conditional('ARAGO_BRAND', 'mainline', '', 'dra71-evm-nand.dtb', d)} \
    ti/dra71-evm-lcd-auo-g101evn01.0.dtbo \
    dra72-evm.dtb \
    dra72-evm-revc.dtb \
    ti/dra72-evm-touchscreen.dtbo \
    ti/dra74-evm-touchscreen.dtbo \
    dra76-evm.dtb \
    ti/dra76-evm-tfp410.dtbo \
    ti/lcd-osd101t2045.dtbo \
    ti/lcd-osd101t2587.dtbo \
"

UBOOT_MACHINE = "dra7xx_evm_config"

# UBI information.  Note that this is board and kernel specific.  Changes
# in your kernel port may require changes in these variables.  For more
# details about this board please see
# http://processors.wiki.ti.com/index.php/UBIFS_Support

# do ubiattach /dev/ubi_ctrl -m 7 -O 2048
# From dmesg:
# UBI: smallest flash I/O unit:    2048
# UBI: logical eraseblock size:    126976 bytes
# from ubiattach stdout:
# UBI device number 0, total 1988 LEBs
MKUBIFS_ARGS = "-F -m 2048 -e 126976 -c 8192"

# do ubiattach /dev/ubi_ctrl -m 7 -O 2048
# from dmesg:
# UBI: smallest flash I/O unit:    2048
# UBI: physical eraseblock size:   131072 bytes (128 KiB)
# UBI: sub-page size:              512
# UBI: VID header offset:          2048 (aligned 2048)
UBINIZE_ARGS = "-m 2048 -p 128KiB -s 512 -O 2048"

# Set the list of device targets for ti-pdk class recipes
TI_PDK_LIMIT_BOARDS = "evmDRA72x evmDRA75x evmDRA78x"
TI_PDK_LIMIT_SOCS = "dra72x dra75x dra78x"
```

## conf/machine/dra7xx-hs-evm.conf
```bitbake
#@TYPE: Machine
#@NAME: DRA7xx HS EVM
#@DESCRIPTION: Machine configuration for the TI DRA7xx HS EVM

require conf/machine/dra7xx-evm.conf

UBOOT_MACHINE = "dra7xx_hs_evm_config"

UBOOT_ENTRYPOINT = "0x82000000"
UBOOT_LOADADDRESS = "0x82000000"
UBOOT_RD_LOADADDRESS = "0x84000000"
UBOOT_RD_ENTRYPOINT = "0x84000000"

TI_SECURE_DEV_PKG = "${TI_SECURE_DEV_PKG_AUTO}/dra7"

OPTEEMACHINE = "ti-dra7xx"
OPTEEFLAVOR = "dra7xx"
OPTEEOUTPUTMACHINE = "ti"
OPTEEPAGER = "y"
```

## conf/machine/include/am62axx.inc
```bitbake
require conf/machine/include/k3.inc
SOC_FAMILY_append = ":am62axx"

MACHINE_FEATURES += "screen touchscreen"

SERIAL_CONSOLES = "115200;ttyS0 115200;ttyS2"
SERIAL_CONSOLES_CHECK = "${SERIAL_CONSOLES}"

TFA_K3_SYSTEM_SUSPEND = "1"

# Default tiboot3.bin on AM62A is for HS-FS
BBMULTICONFIG = "k3r5-hs-fs"
do_image_wic[mcdepends] = "mc::k3r5-hs-fs:ti-sci-fw:do_deploy"
do_image_tar[mcdepends] = "mc::k3r5-hs-fs:ti-sci-fw:do_deploy"

# Since default tiboot3.bin on AM62A is for HS-FS, add a version for GP
BBMULTICONFIG += "k3r5-gp"
IMAGE_BOOT_FILES += " tiboot3-am62ax-gp-evm.bin"
do_image_wic[mcdepends] += "mc::k3r5-gp:ti-sci-fw:do_deploy"
do_image_tar[mcdepends] += "mc::k3r5-gp:ti-sci-fw:do_deploy"

# Since default tiboot3.bin on AM62A is for HS-FS, add a version for HS-SE
BBMULTICONFIG += "k3r5-hs-se"
IMAGE_BOOT_FILES += " tiboot3-am62ax-hs-evm.bin"
do_image_wic[mcdepends] += "mc::k3r5-hs-se:ti-sci-fw:do_deploy"
do_image_tar[mcdepends] += "mc::k3r5-hs-se:ti-sci-fw:do_deploy"

TFA_BOARD = "lite"
OPTEEMACHINE = "k3-am62x"
OPTEEOUTPUTMACHINE = "k3"
```

## conf/machine/include/am62xx.inc
```bitbake
require conf/machine/include/k3.inc
SOC_FAMILY_append = ":am62xx"

MACHINE_FEATURES += "screen touchscreen"

SERIAL_CONSOLES = "115200;ttyS2"
SERIAL_CONSOLES_CHECK = "${SERIAL_CONSOLES}"

TFA_K3_SYSTEM_SUSPEND = "1"

# Default tiboot3.bin on AM62x is for HS-FS
BBMULTICONFIG = "k3r5-hs-fs"
do_image_wic[mcdepends] = "mc::k3r5-hs-fs:ti-sci-fw:do_deploy"
do_image_tar[mcdepends] = "mc::k3r5-hs-fs:ti-sci-fw:do_deploy"

# Since default tiboot3.bin on AM62x is for HS-FS, add a version for GP
BBMULTICONFIG += "k3r5-gp"
IMAGE_BOOT_FILES += " tiboot3-am62x-gp-evm.bin"
do_image_wic[mcdepends] += "mc::k3r5-gp:ti-sci-fw:do_deploy"
do_image_tar[mcdepends] += "mc::k3r5-gp:ti-sci-fw:do_deploy"

# Since default tiboot3.bin on AM62x is for HS-FS, add a version for HS-SE
BBMULTICONFIG += "k3r5-hs-se"
IMAGE_BOOT_FILES += " tiboot3-am62x-hs-evm.bin"
do_image_wic[mcdepends] += "mc::k3r5-hs-se:ti-sci-fw:do_deploy"
do_image_tar[mcdepends] += "mc::k3r5-hs-se:ti-sci-fw:do_deploy"

TFA_BOARD = "lite"
OPTEEMACHINE = "k3-am62x"
OPTEEOUTPUTMACHINE = "k3"
```

## conf/machine/include/am64xx.inc
```bitbake
require conf/machine/include/k3.inc
SOC_FAMILY_append = ":am64xx"

MACHINE_FEATURES += "screen touchscreen"

SERIAL_CONSOLES = "115200;ttyS2 115200;ttyS1"
SERIAL_CONSOLES_CHECK = "${SERIAL_CONSOLES}"

KERNEL_DEVICETREE = " \
    ti/k3-am642-evm.dtb \
    ti/k3-am642-sk.dtb \
    ti/k3-am642-evm-icssg1-dualemac.dtbo \
    ti/k3-am642-evm-icssg1-dualemac-mii.dtbo \
    ti/k3-am642-evm-nand.dtbo \
"

# Default tiboot3.bin on AM64x is for SR2.0 HS-FS
BBMULTICONFIG = "k3r5-sr2-hs-fs"
do_image_wic[mcdepends] = "mc::k3r5-sr2-hs-fs:ti-sci-fw:do_deploy"
do_image_tar[mcdepends] = "mc::k3r5-sr2-hs-fs:ti-sci-fw:do_deploy"

# Since default tiboot3.bin on AM64x is for SR2.0 HS-FS, add a version for GP
BBMULTICONFIG += "k3r5-gp"
IMAGE_BOOT_FILES += " tiboot3-am64x-gp-evm.bin"
do_image_wic[mcdepends] += "mc::k3r5-gp:ti-sci-fw:do_deploy"
do_image_tar[mcdepends] += "mc::k3r5-gp:ti-sci-fw:do_deploy"

# Since default tiboot3.bin on AM64x is for SR2.0 HS-FS, add a version for SR2.0 HS-SE
BBMULTICONFIG += "k3r5-sr2-hs-se"
IMAGE_BOOT_FILES += " tiboot3-am64x_sr2-hs-evm.bin"
do_image_wic[mcdepends] += "mc::k3r5-sr2-hs-se:ti-sci-fw:do_deploy"
do_image_tar[mcdepends] += "mc::k3r5-sr2-hs-se:ti-sci-fw:do_deploy"

TFA_BOARD = "lite"
OPTEEMACHINE = "k3-am64x"
OPTEEOUTPUTMACHINE = "k3"

# Set the list of device targets for ti-pdk class recipes
TI_PDK_LIMIT_SOCS = "am64x"
TI_PDK_LIMIT_BOARDS = "am64x_evm"
TI_PDK_LIMIT_CORES = "mcu1_0 mpu1_0 mcu1_1 mcu2_0 mcu2_1"
```

## conf/machine/include/am65xx.inc
```bitbake
require conf/machine/include/k3.inc
SOC_FAMILY_append = ":am65xx"

MACHINE_FEATURES += "screen touchscreen gpu"

SERIAL_CONSOLES = "115200;ttyS2 115200;ttyS1"
SERIAL_CONSOLES_CHECK = "${SERIAL_CONSOLES}"

KERNEL_DEVICETREE = " \
    ti/k3-am654-base-board.dtb \
    ti/k3-am654-base-board-sr1.dtbo \
    ti/k3-am654-gp.dtbo \
    ti/k3-am654-idk.dtbo \
    ti/k3-am654-idk-sr1.dtbo \
    ti/k3-am654-sr1.dtbo \
    ti/k3-am654-pcie-usb2.dtbo \
    ti/k3-am654-pcie-usb3.dtbo \
    ti/k3-am654-evm-tc358876.dtbo \
    ti/k3-am654-evm-oldi-lcd1evm.dtbo \
    ti/k3-am654-evm-ov5640.dtbo \
"

BBMULTICONFIG += "k3r5-sr2"

# Since J721e does not support multi-cert tiboot3.bin add standalone sysfw.itb
IMAGE_BOOT_FILES += "sysfw.itb"

# Since default sysfw.itb on AM65x is for SR2.0, add a version for SR1.0
IMAGE_BOOT_FILES += "sysfw-am65x-evm.itb"

do_image_wic[mcdepends] += "mc::k3r5-sr2:ti-sci-fw:do_deploy"
do_image_tar[mcdepends] += "mc::k3r5-sr2:ti-sci-fw:do_deploy"

OPTEEMACHINE = "k3-am65x"
OPTEEOUTPUTMACHINE = "k3"

# Set the list of device targets for ti-pdk class recipes
TI_PDK_LIMIT_SOCS = "am65xx"
TI_PDK_LIMIT_BOARDS = "am65xx_evm am65xx_idk"
TI_PDK_LIMIT_CORES = "mcu1_0 mpu1_0"
```

## conf/machine/include/c66x.inc
```bitbake
require conf/machine/include/keystone.inc
SOC_FAMILY_append = ":c66x"

# HACK: The c66x family is composed of devices with only DSP cores, and no ARM
#       cores. The Linux kernel is not supported on these machines.
PREFERRED_PROVIDER_virtual/kernel ?= "linux-dummy"
EXTRA_IMAGEDEPENDS = ""

IMAGE_FSTYPES = "tar.xz"
```

## conf/machine/include/dra7xx.inc
```bitbake
require conf/machine/include/omap-a15.inc
SOC_FAMILY_append = ":dra7xx"

MACHINE_FEATURES += "pci"
```

## conf/machine/include/j7.inc
```bitbake
require conf/machine/include/k3.inc
SOC_FAMILY_append = ":j7"

OPTEEMACHINE = "k3-j721e"
OPTEEOUTPUTMACHINE = "k3"

# Set the list of device targets for ti-pdk class recipes
TI_PDK_LIMIT_SOCS = "j721e j7200"
TI_PDK_LIMIT_BOARDS = "j721e_evm j7200_evm"
TI_PDK_LIMIT_CORES = "mpu1_0 mcu1_0 mcu1_1 mcu2_0 mcu2_1 mcu3_0 mcu3_1 c66xdsp_1 c66xdsp_2 c7x_1"
```

## conf/machine/include/k2e.inc
```bitbake
require conf/machine/include/keystone.inc
SOC_FAMILY_append = ":k2e"

# Set the list of device targets for ti-pdk class recipes
TI_PDK_LIMIT_SOCS = "k2e"
TI_PDK_LIMIT_BOARDS = "evmK2E"
```

## conf/machine/include/k2g.inc
```bitbake
require conf/machine/include/keystone.inc
SOC_FAMILY_append = ":k2g"

# Set the list of device targets for ti-pdk class recipes
TI_PDK_LIMIT_SOCS = "k2g"
TI_PDK_LIMIT_BOARDS = "evmK2G iceK2G"
```

## conf/machine/include/k2hk.inc
```bitbake
require conf/machine/include/keystone.inc
SOC_FAMILY_append = ":k2hk"

# Set the list of device targets for ti-pdk class recipes
TI_PDK_LIMIT_SOCS = "k2h k2k"
TI_PDK_LIMIT_BOARDS = "evmK2H evmK2K"
```

## conf/machine/include/k2l.inc
```bitbake
require conf/machine/include/keystone.inc
SOC_FAMILY_append = ":k2l"

# Set the list of device targets for ti-pdk class recipes
TI_PDK_LIMIT_SOCS = "k2l"
TI_PDK_LIMIT_BOARDS = "evmK2L"
```

## conf/machine/include/k3.inc
```bitbake
# TI K3 Aarch64 profile for Cortex-A53/A72 cores

require conf/machine/include/ti-soc.inc
SOC_FAMILY_append = ":k3"

require conf/machine/include/arm/arch-arm64.inc

BBMULTICONFIG += "k3r5"

# Increase this everytime you change something in the kernel
MACHINE_KERNEL_PR = "r0"

PREFERRED_PROVIDER_virtual/kernel ?= "linux-ti-staging"
PREFERRED_PROVIDER_virtual/bootloader = "u-boot-ti-staging"
PREFERRED_PROVIDER_u-boot = "u-boot-ti-staging"

KERNEL_IMAGETYPE = "Image"
KERNEL_IMAGETYPES = "Image fitImage"
KERNEL_CLASSES += "kernel-fitimage"

UBOOT_ARCH = "arm"
UBOOT_ENTRYPOINT = "0x80008000"
UBOOT_LOADADDRESS = "0x80008000"
UBOOT_RD_LOADADDRESS = "0x84000000"
UBOOT_RD_ENTRYPOINT = "0x84000000"
UBOOT_DTB_LOADADDRESS = "0x83000000"
UBOOT_DTBO_LOADADDRESS = "0x83080000"
UBOOT_DTBO_OFFSET = "0x00010000"

SPL_BINARY = "tispl.bin"
SPL_BINARYNAME = "tispl.bin"
UBOOT_SUFFIX = "img"

EXTRA_IMAGEDEPENDS += "virtual/bootloader"

TFA_PLATFORM = "k3"
TFA_BOARD = "generic"

MACHINE_GUI_CLASS = "smallscreen"

# Use the expected value of the ubifs filesystem's volume name in the kernel
# and u-boot.
UBI_VOLNAME = "rootfs"

# List common SoC features, may need to add touchscreen for specific machines
MACHINE_FEATURES = "kernel26 apm usbgadget usbhost vfat ext2 alsa ethernet pci"

IMAGE_FSTYPES += "tar.xz wic.xz wic.bmap"

IMAGE_BOOT_FILES ?= "${SPL_BINARYNAME} u-boot.${UBOOT_SUFFIX} tiboot3.bin"

WKS_FILE ?= "sdimage-2part.wks"
do_image_wic[depends] += "virtual/bootloader:do_deploy"
do_image_wic[mcdepends] += "mc::k3r5:virtual/bootloader:do_deploy mc::k3r5:ti-sci-fw:do_deploy"
do_image_tar[mcdepends] += "mc::k3r5:virtual/bootloader:do_deploy mc::k3r5:ti-sci-fw:do_deploy"

TI_SECURE_DEV_PKG = "${TI_SECURE_DEV_PKG_K3}"
```

## conf/machine/include/k3r5.inc
```bitbake
# TI K3 Armv7 profile for Cortex-R5F cores

require conf/machine/include/ti-soc.inc
SOC_FAMILY_append = ":k3r5"

# The closest of existing tunes for Cortex-R5F
DEFAULTTUNE = "armv7athf"
require conf/machine/include/tune-cortexa8.inc

# R5 runs early bootloader and loads SYSFW
# https://git.ti.com/cgit/ti-u-boot/ti-u-boot/tree/board/ti/am65x/README
# https://git.ti.com/cgit/ti-u-boot/ti-u-boot/tree/board/ti/j721e/README
PREFERRED_PROVIDER_virtual/kernel = "linux-dummy"
PREFERRED_PROVIDER_virtual/bootloader = "u-boot-ti-staging"
PREFERRED_PROVIDER_u-boot = "u-boot-ti-staging"

SPL_BINARY = ""
UBOOT_SUFFIX = "bin"
UBOOT_BINARY = "u-boot-spl.${UBOOT_SUFFIX}"
UBOOT_IMAGE = "u-boot-r5spl-${MAINMACHINE}-${PV}-${PR}.${UBOOT_SUFFIX}"
UBOOT_SYMLINK = "u-boot-r5spl.${UBOOT_SUFFIX}"

PACKAGECONFIG_pn-u-boot-ti-staging = ""
PACKAGECONFIG_pn-u-boot-ti-mainline = ""

TI_SECURE_DEV_PKG = "${TI_SECURE_DEV_PKG_K3}"
```

## conf/machine/include/keystone.inc
```bitbake
require conf/machine/include/ti-soc.inc
SOC_FAMILY_append = ":keystone"

DEFAULTTUNE ?= "armv7athf-neon"
require conf/machine/include/tune-cortexa15.inc

PREFERRED_PROVIDER_virtual/kernel ?= "linux-ti-staging"
PREFERRED_PROVIDER_virtual/bootloader = "u-boot-ti-staging"
PREFERRED_PROVIDER_u-boot = "u-boot-ti-staging"

# Increase this everytime you change something in the kernel
MACHINE_KERNEL_PR = "r10"

KERNEL_IMAGETYPE = "zImage"

UBOOT_ENTRYPOINT = "0x80008000"
UBOOT_LOADADDRESS = "0x80008000"

SPL_BINARY = "MLO"
UBOOT_SUFFIX = "bin"

# Use the expected value of the ubifs filesystem's volume name in the kernel
# and u-boot.
UBI_VOLNAME = "rootfs"

EXTRA_IMAGEDEPENDS += "u-boot"
EXTRA_IMAGEDEPENDS += "boot-monitor"

MACHINE_FEATURES = "kernel26 apm usbgadget usbhost vfat pci dsp"
MACHINE_FEATURES_BACKFILL_CONSIDERED = "rtc"
```
