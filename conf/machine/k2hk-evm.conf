## conf/machine/k2hk-evm.conf
```bitbake
#@TYPE: Machine
#@NAME: Keystone 2 K2HK machine
#@DESCRIPTION: Machine configuration for the TI Keystone 2 K2HK EVM

require conf/machine/include/k2hk.inc

KERNEL_DEVICETREE = "keystone-k2hk-evm.dtb"

UBOOT_MACHINE = "k2hk_evm_config"

BOOT_MONITOR_MAKE_TARGET = "k2hk"

IMAGE_FSTYPES += "ubifs ubi tar.xz"

SERIAL_CONSOLE = "115200 ttyS0"

SYSVINIT_ENABLED_GETTYS = ""

# do ubiattach /dev/ubi_ctrl -m 4
# From dmesg:
# UBI: smallest flash I/O unit:    2048
# UBI: logical eraseblock size:    126976 bytes
# from ubiattach stdout:
# UBI device number 0, total 3856 LEBs
MKUBIFS_ARGS = "-F -m 2048 -e 126976 -c 4000"

# do ubiattach /dev/ubi_ctrl -m 4
# from dmesg:
# UBI: smallest flash I/O unit:    2048
# UBI: physical eraseblock size:   131072 bytes (128 KiB)
# UBI: sub-page size:              2048
UBINIZE_ARGS = "-m 2048 -p 128KiB -s 2048 -O 2048"
```

## conf/machine/k2hk-hs-evm.conf
```bitbake
#@TYPE: Machine
#@NAME: Keystone 2 K2HK HS EVM
#@DESCRIPTION: Machine configuration for the TI Keystone 2 K2HK HS EVM

require conf/machine/k2hk-evm.conf

UBOOT_MACHINE = "k2hk_hs_evm_config"
SPL_BINARY = ""

UBOOT_ENTRYPOINT = "0x82000000"
UBOOT_LOADADDRESS = "0x82000000"
UBOOT_RD_LOADADDRESS = "0x84000000"
UBOOT_RD_ENTRYPOINT = "0x84000000"

TI_SECURE_DEV_PKG = "${TI_SECURE_DEV_PKG_CAT}/k2hk"
```

## conf/machine/k2l-evm.conf
```bitbake
#@TYPE: Machine
#@NAME: Keystone 2 K2L machine
#@DESCRIPTION: Machine configuration for the TI Keystone 2 K2L EVM

require conf/machine/include/k2l.inc

KERNEL_DEVICETREE = "keystone-k2l-evm.dtb"

UBOOT_MACHINE = "k2l_evm_config"

BOOT_MONITOR_MAKE_TARGET = "k2l"

IMAGE_FSTYPES += "ubifs ubi tar.xz"

SERIAL_CONSOLE = "115200 ttyS0"

SYSVINIT_ENABLED_GETTYS = ""

# do ubiattach /dev/ubi_ctrl -m 4
# From dmesg:
# UBI: smallest flash I/O unit:    4096
# UBI: logical eraseblock size:    253952 bytes
# from ubiattach stdout:
# UBI device number 0, total 1926 LEBs
MKUBIFS_ARGS = "-F -m 4096 -e 253952 -c 2000"

# do ubiattach /dev/ubi_ctrl -m 4
# from dmesg:
# UBI: smallest flash I/O unit:    4096
# UBI: physical eraseblock size:   256 KiB
# UBI: sub-page size:              4096
UBINIZE_ARGS = "-m 4096 -p 256KiB -s 4096 -O 4096"
```

## conf/machine/k2l-hs-evm.conf
```bitbake
#@TYPE: Machine
#@NAME: Keystone 2 K2L HS EVM
#@DESCRIPTION: Machine configuration for the TI Keystone 2 K2L HS EVM

require conf/machine/k2l-evm.conf

UBOOT_MACHINE = "k2l_hs_evm_config"

UBOOT_ENTRYPOINT = "0x82000000"
UBOOT_LOADADDRESS = "0x82000000"
UBOOT_RD_LOADADDRESS = "0x84000000"
UBOOT_RD_ENTRYPOINT = "0x84000000"

TI_SECURE_DEV_PKG = "${TI_SECURE_DEV_PKG_CAT}/k2l"
```

## conf/machine/lego-ev3.conf
```bitbake
#@TYPE: Machine
#@NAME: LEGO Mindstorms EV3
#@DESCRIPTION: Machine configuration for the LEGO Mindstorms EV3

require conf/machine/include/davinci.inc
require conf/machine/include/omapl138.inc

UBOOT_MACHINE = "legoev3_config"
UBOOT_SUFFIX = "bin"
UBOOT_ENTRYPOINT = "0xC0008000"
UBOOT_LOADADDRESS = "0xC0008000"
SPL_BINARY = ""

KERNEL_DEVICETREE = "da850-lego-ev3.dtb"
KERNEL_IMAGETYPES = "uImage"
KERNEL_DEVICETREE_BUNDLE = "1"
SERIAL_CONSOLES = "115200;ttyS1"

IMAGE_FSTYPES += " wic"
WKS_FILE ?= "sdimage-bootpart.wks"
WIC_CREATE_EXTRA_ARGS += " --no-fstab-update"
IMAGE_BOOT_FILES = "${KERNEL_IMAGETYPES}"
```

## conf/machine/omap3evm.conf
```bitbake
#@TYPE: Machine
#@NAME: OMAP3 EVM
#@DESCRIPTION: Machine configuration for the TI OMAP3 EVM

require conf/machine/include/omap3.inc

MACHINE_GUI_CLASS = "smallscreen"
MACHINE_FEATURES += "touchscreen ethernet"

IMAGE_FSTYPES += "jffs2 tar.xz"
EXTRA_IMAGECMD_jffs2 = "-lnp -e 0x20000 -s 2048"

SERIAL_CONSOLES = "115200;ttyS0"
USE_VT = "0"

EXTRA_IMAGEDEPENDS += "x-load"

# NOTE: there are NAND and OneNAND versions of this board...
# do ubiattach /dev/ubi_ctrl -m 4
# From dmesg:
# UBI: smallest flash I/O unit:    2048
# UBI: logical eraseblock size:    129024 bytes
# from ubiattach stdout:
# UBI device number 0, total 1996 LEBs
MKUBIFS_ARGS = "-m 2048 -e 129024 -c 1996"

# do ubiattach /dev/ubi_ctrl -m 4
# from dmesg:
# UBI: smallest flash I/O unit:    2048
# UBI: physical eraseblock size:   131072 bytes (128 KiB)
# UBI: sub-page size:              512
UBINIZE_ARGS = "-m 2048 -p 128KiB -s 512"
```

## conf/machine/omapl137-evm.conf
```bitbake
#@TYPE: Machine
#@NAME: OMAP-L137 EVM
#@DESCRIPTION: Machine configuration for the TI OMAP-L137 EVM board

require conf/machine/include/davinci.inc
require conf/machine/include/omapl137.inc

# HACK: The omapl137 family does not have linux kernel support.
PREFERRED_PROVIDER_virtual/kernel ?= "linux-dummy"
EXTRA_IMAGEDEPENDS = ""

IMAGE_FSTYPES = "tar.xz"

# Set the list of device targets for ti-pdk class recipes
TI_PDK_LIMIT_BOARDS = "evmOMAPL137"
```

## conf/machine/omapl138-lcdk.conf
```bitbake
#@TYPE: Machine
#@NAME: OMAP-L138 LCDK
#@DESCRIPTION: Machine configuration for the TI OMAP-L138 LCDK board

require conf/machine/include/davinci.inc
require conf/machine/include/omapl138.inc

UBOOT_MACHINE = "omapl138_lcdk_config"
UBOOT_SUFFIX = "ais"

UBOOT_ENTRYPOINT = "0xc0008000"
UBOOT_LOADADDRESS = "0xc0008000"

IMAGE_FSTYPES += "tar.xz"

SERIAL_CONSOLE = "115200 ttyS2"

KERNEL_DEVICETREE = "da850-evm.dtb da850-lcdk.dtb"

# Set the list of device targets for ti-pdk class recipes
TI_PDK_LIMIT_BOARDS = "lcdkOMAPL138"
```

## conf/machine/pandaboard.conf
```bitbake
#@TYPE: Machine
#@NAME: Pandaboard
#@DESCRIPTION: Machine configuration for the OMAP4430 Panda

require conf/machine/include/omap4.inc

MACHINE_GUI_CLASS = "bigscreen"

IMAGE_FSTYPES += "tar.gz"

KERNEL_DEVICETREE = "omap4-panda.dtb omap4-panda-a4.dtb omap4-panda-es.dtb"

SERIAL_CONSOLE = "115200 ttyS2"

MACHINE_EXTRA_RRECOMMENDS = " kernel-modules"
MACHINE_FEATURES = "kernel26 wifi bluetooth alsa apm ext2 screen usbgadget usbhost vfat sgx"
```

## meta-beagle/conf/layer.conf
```bitbake
# We have a conf and classes directory, append to BBPATH
BBPATH .= ":${LAYERDIR}"

# We have a recipes directory, add to BBFILES
BBFILES += "${LAYERDIR}/recipes*/*/*.bb ${LAYERDIR}/recipes*/*/*.bbappend"

BBFILE_COLLECTIONS += "meta-beagle"
BBFILE_PATTERN_meta-beagle := "^${LAYERDIR}/"
BBFILE_PRIORITY_meta-beagle = "6"

LAYERSERIES_COMPAT_meta-beagle = "walnascar whinlatter"

LAYERDEPENDS_meta-beagle = " \
    meta-ti-bsp \
"

HOSTTOOLS_NONFATAL += "lz4c"
```

## meta-beagle/conf/machine/beagle-x15.conf
```bitbake
#@TYPE: Machine
#@NAME: BeagleBoard X15
#@DESCRIPTION: Machine configuration for the BeagleBoard X15

require conf/machine/include/am57xx.inc
require conf/machine/include/beagle-bsp.inc

KERNEL_DEVICETREE_PREFIX = " \
    ti/omap/am57xx-beagle-x15 \
    ti/omap/am57xx-idk-lcd \
"

KERNEL_DEVICETREE:bsp-bb_org-6_6 = " \
ti/omap/am571x-idk.dtb \
ti/omap/am571x-idk-touchscreen.dtbo \
ti/omap/am5729-beagleboneai.dtb \
ti/omap/am572x-idk.dtb \
ti/omap/am572x-idk-touchscreen.dtbo \
ti/omap/am574x-idk.dtb \
ti/omap/am57xx-beagle-x15.dtb \
ti/omap/am57xx-beagle-x15-revb1.dtb \
ti/omap/am57xx-beagle-x15-revc.dtb \
ti/omap/am57xx-evm.dtbo \
ti/omap/am57xx-idk-lcd-osd101t2045.dtbo \
ti/omap/am57xx-idk-lcd-osd101t2587.dtbo \
"

KERNEL_DEVICETREE:bsp-bb_org-6_12 = " \
ti/omap/am571x-idk.dtb \
ti/omap/am571x-idk-touchscreen.dtbo \
ti/omap/am5729-beagleboneai.dtb \
ti/omap/am572x-idk.dtb \
ti/omap/am572x-idk-touchscreen.dtbo \
ti/omap/am574x-idk.dtb \
ti/omap/am57xx-beagle-x15.dtb \
ti/omap/am57xx-beagle-x15-revb1.dtb \
ti/omap/am57xx-beagle-x15-revc.dtb \
ti/omap/am57xx-evm.dtbo \
ti/omap/am57xx-evm-ov10635.dtbo \
ti/omap/am57xx-idk-lcd-osd101t2045.dtbo \
ti/omap/am57xx-idk-lcd-osd101t2587.dtbo \
"

MACHINE_GUI_CLASS = "bigscreen"

SERIAL_CONSOLES = "115200;ttyS2"

UBOOT_MACHINE = "am57xx_evm_config"
```

## meta-beagle/conf/machine/beaglebadge-ti.conf
```bitbake
#@TYPE: Machine
#@NAME: AM62L Badge
#@DESCRIPTION: Machine configuration for the TI AM62L Badge

require conf/machine/include/am62lxx.inc

KERNEL_DEVICETREE_PREFIX = " \
    ti/k3-am62l3-badge \
"

KERNEL_DEVICETREE_PREFIX:bsp-ti-6_18 = " \
    ti/k3-am62l3-beaglebadge \
"

KERNEL_DEVICETREE = ""

UBOOT_MACHINE = "am62lx_badge_defconfig"
UBOOT_MACHINE:bsp-ti-6_18 = "am62lx_beaglebadge_defconfig"

TFA_BOARD = "am62l3-badge"
```

## meta-beagle/conf/machine/beaglebone-ai64-k3r5.conf
```bitbake
#@TYPE: Machine
#@NAME: BeagleBone AI-64 (R5F)
#@DESCRIPTION: Machine configuration for the BeagleBone AI-64 (R5F core)

require conf/machine/include/k3r5.inc
require conf/machine/include/beagle-bsp.inc

UBOOT_MACHINE = "j721e_beagleboneai64_r5_defconfig"
```

## meta-beagle/conf/machine/beaglebone-ai64.conf
```bitbake
#@TYPE: Machine
#@NAME: BeagleBone AI-64 (A72)
#@DESCRIPTION: Machine configuration for the BeagleBone AI-64 board (A72 core)

require conf/machine/include/j721e.inc
require conf/machine/include/beagle-bsp.inc

UBOOT_MACHINE = "j721e_beagleboneai64_a72_defconfig"

SPL_BINARY = "tispl.bin_unsigned"

KERNEL_DEVICETREE_PREFIX = " \
    ti/k3-j721e \
"

KERNEL_DEVICETREE:bsp-bb_org-6_6 = " \
ti/k3-j721e-beagleboneai64-BBORG_MOTOR.dtbo \
ti/k3-j721e-beagleboneai64-dsi-rpi-7inch-panel.dtbo \
ti/k3-j721e-beagleboneai64.dtb \
ti/k3-j721e-beagleboneai64-microtips-mf070zima-lcd3.dtbo \
ti/k3-j721e-beagleboneai64-pwm-epwm0-p8_13.dtbo \
ti/k3-j721e-beagleboneai64-pwm-epwm0-p8_13-p8_19.dtbo \
ti/k3-j721e-beagleboneai64-pwm-epwm0-p8_19.dtbo \
ti/k3-j721e-beagleboneai64-pwm-epwm2-p9_14.dtbo \
ti/k3-j721e-beagleboneai64-pwm-epwm2-p9_14-p9_16.dtbo \
ti/k3-j721e-beagleboneai64-pwm-epwm2-p9_16.dtbo \
ti/k3-j721e-beagleboneai64-pwm-epwm4-p9_25.dtbo \
ti/k3-j721e-beagleboneai64-spi-mcspi1-cs0.dtbo \
ti/k3-j721e-beagleboneai64-spi-mcspi1-cs0-no-miso.dtbo \
ti/k3-j721e-beagleboneai64-spi-mcspi2-cs0.dtbo \
ti/k3-j721e-beagleboneai64-spi-mcspi3-cs0-no-miso.dtbo \
ti/k3-j721e-beagleboneai64-spi-mcspi6-cs0-cs1.dtbo \
ti/k3-j721e-beagleboneai64-spi-mcspi6-cs0.dtbo \
ti/k3-j721e-beagleboneai64-spi-mcspi6-cs1-no-miso.dtbo \
ti/k3-j721e-beagleboneai64-spi-mcspi7-cs0.dtbo \
ti/k3-j721e-common-proc-board.dtb \
ti/k3-j721e-common-proc-board-infotainment.dtbo \
ti/k3-j721e-evm-csi2-ov5640.dtbo \
ti/k3-j721e-evm-ethfw.dtbo \
ti/k3-j721e-evm-fusion.dtbo \
ti/k3-j721e-evm-gesi-exp-board.dtbo \
ti/k3-j721e-evm-ina2xx.dtbo \
ti/k3-j721e-evm-pcie0-ep.dtbo \
ti/k3-j721e-evm-pcie1-ep.dtbo \
ti/k3-j721e-evm-quad-port-eth-exp.dtbo \
ti/k3-j721e-sk-csi2-dual-imx219.dtbo \
ti/k3-j721e-sk-csi2-ov5640.dtbo \
ti/k3-j721e-sk.dtb \
ti/k3-j721e-sk-fpdlink-fusion.dtbo \
ti/k3-j721e-sk-rpi-hdr-ehrpwm.dtbo \
"

KERNEL_DEVICETREE:bsp-bb_org-6_12 = " \
ti/k3-j721e-beagleboneai64-BBORG_MOTOR.dtbo \
ti/k3-j721e-beagleboneai64-dsi-rpi-7inch-panel.dtbo \
ti/k3-j721e-beagleboneai64.dtb \
ti/k3-j721e-beagleboneai64-microtips-mf070zima-lcd3.dtbo \
ti/k3-j721e-beagleboneai64-pwm-epwm0-p8_13.dtbo \
ti/k3-j721e-beagleboneai64-pwm-epwm0-p8_13-p8_19.dtbo \
ti/k3-j721e-beagleboneai64-pwm-epwm0-p8_19.dtbo \
ti/k3-j721e-beagleboneai64-pwm-epwm2-p9_14.dtbo \
ti/k3-j721e-beagleboneai64-pwm-epwm2-p9_14-p9_16.dtbo \
ti/k3-j721e-beagleboneai64-pwm-epwm2-p9_16.dtbo \
ti/k3-j721e-beagleboneai64-pwm-epwm4-p9_25.dtbo \
ti/k3-j721e-beagleboneai64-spi-mcspi1-cs0.dtbo \
ti/k3-j721e-beagleboneai64-spi-mcspi1-cs0-no-miso.dtbo \
ti/k3-j721e-beagleboneai64-spi-mcspi2-cs0.dtbo \
ti/k3-j721e-beagleboneai64-spi-mcspi3-cs0-no-miso.dtbo \
ti/k3-j721e-beagleboneai64-spi-mcspi6-cs0-cs1.dtbo \
ti/k3-j721e-beagleboneai64-spi-mcspi6-cs0.dtbo \
ti/k3-j721e-beagleboneai64-spi-mcspi6-cs1-no-miso.dtbo \
ti/k3-j721e-beagleboneai64-spi-mcspi7-cs0.dtbo \
ti/k3-j721e-common-proc-board.dtb \
ti/k3-j721e-common-proc-board-infotainment.dtbo \
ti/k3-j721e-evm-csi2-ov5640.dtbo \
ti/k3-j721e-evm-ethfw.dtbo \
ti/k3-j721e-evm-fusion.dtbo \
ti/k3-j721e-evm-gesi-exp-board.dtbo \
ti/k3-j721e-evm-pcie0-ep.dtbo \
ti/k3-j721e-evm-pcie1-ep.dtbo \
ti/k3-j721e-evm-pcie-ntb.dtbo \
ti/k3-j721e-evm-quad-port-eth-exp.dtbo \
ti/k3-j721e-evm-ub954.dtbo \
ti/k3-j721e-sk-csi2-dual-imx219.dtbo \
ti/k3-j721e-sk-csi2-ov5640.dtbo \
ti/k3-j721e-sk.dtb \
ti/k3-j721e-sk-fpdlink-fusion.dtbo \
"

MACHINE_GUI_CLASS = "bigscreen"

# TI has moved a driver out of its kernel tree and into an out of tree module.
# We need to not include that for older kernels since the module is still in
# the kernel.
TI_VXE_VXD_DRIVER:bsp-bb_org-6_6 = ""
```

## meta-beagle/conf/machine/beaglebone.conf
```bitbake
#@TYPE: Machine
#@NAME: BeagleBone machine
#@DESCRIPTION: Machine configuration for the http://beagleboard.org/bone board

require conf/machine/include/ti33x.inc
require conf/machine/include/beagle-bsp.inc

KERNEL_DEVICETREE_PREFIX = " \
    ti/omap/am335x-bone \
    ti/omap/am335x-pocketbeagle \
    ti/omap/am335x-sancloud-bbe \
"

KERNEL_DEVICETREE:bsp-bb_org-6_6 = " \
ti/omap/am335x-boneblack.dtb \
ti/omap/am335x-boneblack-revd.dtb \
ti/omap/am335x-boneblack-uboot.dtb \
ti/omap/am335x-boneblack-uboot-univ.dtb \
ti/omap/am335x-boneblack-wireless.dtb \
ti/omap/am335x-boneblue.dtb \
ti/omap/am335x-bone.dtb \
ti/omap/am335x-bonegreen.dtb \
ti/omap/am335x-bonegreen-gateway.dtb \
ti/omap/am335x-bonegreen-wireless.dtb \
ti/omap/am335x-bonegreen-wireless-uboot-univ.dtb \
ti/omap/am335x-evm.dtb \
ti/omap/am335x-evmsk.dtb \
ti/omap/am335x-icev2.dtb \
ti/omap/am335x-osd3358-sm-red.dtb \
ti/omap/am335x-pocketbeagle.dtb \
ti/omap/am335x-sancloud-bbe.dtb \
ti/omap/am335x-sancloud-bbe-extended-wifi.dtb \
ti/omap/am335x-sancloud-bbe-lite.dtb \
"

KERNEL_DEVICETREE:bsp-bb_org-6_12 = " \
ti/omap/am335x-boneblack.dtb \
ti/omap/am335x-boneblack-revd.dtb \
ti/omap/am335x-boneblack-uboot.dtb \
ti/omap/am335x-boneblack-uboot-univ.dtb \
ti/omap/am335x-boneblack-wireless.dtb \
ti/omap/am335x-boneblue.dtb \
ti/omap/am335x-bone.dtb \
ti/omap/am335x-bonegreen.dtb \
ti/omap/am335x-bonegreen-eco.dtb \
ti/omap/am335x-bonegreen-gateway.dtb \
ti/omap/am335x-bonegreen-wireless.dtb \
ti/omap/am335x-bonegreen-wireless-uboot-univ.dtb \
ti/omap/am335x-evm.dtb \
ti/omap/am335x-evmsk.dtb \
ti/omap/am335x-icev2.dtb \
ti/omap/am335x-osd3358-sm-red.dtb \
ti/omap/am335x-pocketbeagle.dtb \
ti/omap/am335x-sancloud-bbe.dtb \
ti/omap/am335x-sancloud-bbe-extended-wifi.dtb \
ti/omap/am335x-sancloud-bbe-lite.dtb \
"

MACHINE_GUI_CLASS = "bigscreen"
MACHINE_FEATURES += "screen"

SERIAL_CONSOLES = "115200;ttyS0"
```

## meta-beagle/conf/machine/beagleplay-k3r5.conf
```bitbake
#@TYPE: Machine
#@NAME: BeaglePlay (R5F)
#@DESCRIPTION: Machine configuration for the BeaglePlay (R5F core)

require conf/machine/beagleplay-ti-k3r5.conf

require conf/machine/include/beagle-bsp.inc
```

## meta-beagle/conf/machine/beagleplay-ti.conf
```bitbake
#@TYPE: Machine
#@NAME: BeaglePlay (A53)
#@DESCRIPTION: Machine configuration for the BeaglePlay board (A53 core)

require conf/machine/include/am62xx.inc

SERIAL_CONSOLES = "115200;ttyS2"

UBOOT_MACHINE = "am62x_beagleplay_a53_defconfig"

SPL_BINARY = "tispl.bin_unsigned"

KERNEL_DEVICETREE_PREFIX = " \
    ti/k3-am625-beagle \
    ti/k3-am625-sk \
    ti/k3-am62x-sk \
"

KERNEL_DEVICETREE = " \
    ti/k3-am625-beagleplay-csi2-ov5640.dtbo \
    ti/k3-am625-beagleplay-csi2-tevi-ov5640.dtbo \
    ti/k3-am625-beagleplay.dtb \
    ti/k3-am625-sk.dtb \
    ti/k3-am62x-sk-csi2-imx219.dtbo \
    ti/k3-am62x-sk-csi2-ov5640.dtbo \
    ti/k3-am62x-sk-csi2-tevi-ov5640.dtbo \
    ti/k3-am62x-sk-hdmi-audio.dtbo \
"

MACHINE_GUI_CLASS = "bigscreen"
```
