## meta-beagle/conf/machine/beagleplay.conf
```bitbake
#@TYPE: Machine
#@NAME: BeaglePlay (A53)
#@DESCRIPTION: Machine configuration for the BeaglePlay board (A53 core)

require conf/machine/beagleplay-ti.conf

require conf/machine/include/beagle-bsp.inc

KERNEL_DEVICETREE:append:bsp-bb_org-6_6 = " \
ti/k3-am625-beagleplay-csi2-ov5640.dtbo \
ti/k3-am625-beagleplay-csi2-tevi-ov5640.dtbo \
ti/k3-am625-beagleplay.dtb \
ti/k3-am625-beagleplay-lincolntech-lcd185-panel.dtbo \
ti/k3-am625-minimal.dtb \
ti/k3-am625-sk.dtb \
ti/k3-am625-sk-ecap-capture.dtbo \
ti/k3-am625-sk-lincolntech-lcd185-panel.dtbo \
ti/k3-am625-sk-m2-cc3301.dtbo \
ti/k3-am625-sk-mcspi-loopback.dtbo \
ti/k3-am625-sk-microtips-mf101hie-panel.dtbo \
ti/k3-am625-sk-rpi-hdr-ehrpwm.dtbo \
ti/k3-am62x-sk-csi2-imx219.dtbo \
ti/k3-am62x-sk-csi2-ov5640.dtbo \
ti/k3-am62x-sk-csi2-tevi-ov5640.dtbo \
ti/k3-am62x-sk-csi2-v3link-fusion.dtbo \
ti/k3-am62x-sk-dmtimer-pwm.dtbo \
ti/k3-am62x-sk-eqep.dtbo \
ti/k3-am62x-sk-fastboot-disable-hdmi.dtbo \
ti/k3-am62x-sk-hdmi-audio.dtbo \
ti/k3-am62x-sk-lpm-wkup-sources.dtbo \
ti/k3-am62x-sk-mcan.dtbo \
ti/k3-am62x-sk-microtips-mf103hie-lcd2.dtbo \
ti/k3-am62x-sk-pwm.dtbo \
"
```

## meta-beagle/conf/machine/beagley-ai-k3r5.conf
```bitbake
#@TYPE: Machine
#@NAME: BeagleY AI (R5F)
#@DESCRIPTION: Machine configuration for the BeagleY AI (R5F core)

require conf/machine/beagley-ai-ti-k3r5.conf

require conf/machine/include/beagle-bsp.inc

UBOOT_MACHINE:bsp-bb_org-6_6 = "j722s_evm_r5_defconfig"
```

## meta-beagle/conf/machine/beagley-ai-ti.conf
```bitbake
#@TYPE: Machine
#@NAME: BeagleY AI (A53)
#@DESCRIPTION: Machine configuration for the BeagleY AI board (A53 core)

require conf/machine/include/j722s.inc

UBOOT_MACHINE = "am67a_beagley_ai_a53_defconfig"
UBOOT_MACHINE:bsp-ti-6_6 = "j722s_evm_a53_config"

KERNEL_DEVICETREE_PREFIX = " \
    ti/k3-am67a \
    ti/k3-j722s \
"

MACHINE_GUI_CLASS = "bigscreen"
```

## meta-beagle/conf/machine/beagley-ai.conf
```bitbake
#@TYPE: Machine
#@NAME: BeagleY AI (A53)
#@DESCRIPTION: Machine configuration for the BeagleY AI board (A53 core)

require conf/machine/include/j722s.inc
require conf/machine/include/beagle-bsp.inc

IMAGE_SR1_HS_SE_FILES:bsp-bb_org-6_6 = ""

UBOOT_MACHINE:bsp-bb_org-6_6 = "j722s_evm_a53_config"

UBOOT_MACHINE = "am67a_beagley_ai_a53_defconfig"

KERNEL_DEVICETREE_PREFIX = " \
    ti/k3-am67a \
    ti/k3-j722s \
"

KERNEL_DEVICETREE:bsp-bb_org-6_6 = " \
ti/k3-am67a-beagley-ai.dtb \
ti/k3-am67a-beagley-ai-i2c1-400000.dtbo \
ti/k3-am67a-beagley-ai-i2c1-ads1115.dtbo \
ti/k3-am67a-beagley-ai-i2c1-rtc-rv3028.dtbo \
ti/k3-am67a-beagley-ai-i2c1-ssd1306.dtbo \
ti/k3-am67a-beagley-ai-mikroe-eth.dtbo \
ti/k3-am67a-beagley-ai-mikroe-microsd.dtbo \
ti/k3-am67a-beagley-ai-pps-gpio18.dtbo \
ti/k3-am67a-beagley-ai-pwm-ecap0-gpio12.dtbo \
ti/k3-am67a-beagley-ai-pwm-ecap1-gpio16.dtbo \
ti/k3-am67a-beagley-ai-pwm-ecap1-gpio21.dtbo \
ti/k3-am67a-beagley-ai-pwm-ecap2-gpio17.dtbo \
ti/k3-am67a-beagley-ai-pwm-ecap2-gpio18.dtbo \
ti/k3-am67a-beagley-ai-pwm-epwm0-gpio12.dtbo \
ti/k3-am67a-beagley-ai-pwm-epwm0-gpio14.dtbo \
ti/k3-am67a-beagley-ai-pwm-epwm0-gpio15.dtbo \
ti/k3-am67a-beagley-ai-pwm-epwm0-gpio15-gpio12.dtbo \
ti/k3-am67a-beagley-ai-pwm-epwm0-gpio15-gpio14.dtbo \
ti/k3-am67a-beagley-ai-pwm-epwm0-gpio5.dtbo \
ti/k3-am67a-beagley-ai-pwm-epwm0-gpio5-gpio12.dtbo \
ti/k3-am67a-beagley-ai-pwm-epwm0-gpio5-gpio14.dtbo \
ti/k3-am67a-beagley-ai-pwm-epwm1-gpio13.dtbo \
ti/k3-am67a-beagley-ai-pwm-epwm1-gpio20.dtbo \
ti/k3-am67a-beagley-ai-pwm-epwm1-gpio21.dtbo \
ti/k3-am67a-beagley-ai-pwm-epwm1-gpio21-gpio13.dtbo \
ti/k3-am67a-beagley-ai-pwm-epwm1-gpio21-gpio20.dtbo \
ti/k3-am67a-beagley-ai-pwm-epwm1-gpio6.dtbo \
ti/k3-am67a-beagley-ai-pwm-epwm1-gpio6-gpio13.dtbo \
ti/k3-am67a-beagley-ai-pwm-epwm1-gpio6-gpio20.dtbo \
ti/k3-am67a-beagley-ai-spi0-1cs.dtbo \
ti/k3-am67a-beagley-ai-spi0-2cs.dtbo \
ti/k3-am67a-beagley-ai-spidev0.dtbo \
ti/k3-am67a-beagley-ai-uart-ttyama0.dtbo \
ti/k3-j722s-evm-csi2-ov5640.dtbo \
ti/k3-j722s-evm-csi2-quad-rpi-cam-imx219.dtbo \
ti/k3-j722s-evm-csi2-quad-tevi-ov5640.dtbo \
ti/k3-j722s-evm-dsi-rpi-7inch-panel.dtbo \
ti/k3-j722s-evm.dtb \
ti/k3-j722s-evm-fpdlink-fusion.dtbo \
ti/k3-j722s-evm-microtips-mf101hie-panel.dtbo \
ti/k3-j722s-evm-pwm.dtbo \
ti/k3-j722s-evm-v3link-fusion.dtbo \
"

KERNEL_DEVICETREE:bsp-bb_org-6_12 = " \
ti/k3-am67a-beagley-ai.dtb \
ti/k3-am67a-beagley-ai-i2c1-400000.dtbo \
ti/k3-am67a-beagley-ai-i2c1-ads1115.dtbo \
ti/k3-am67a-beagley-ai-i2c1-rtc-rv3028.dtbo \
ti/k3-am67a-beagley-ai-i2c1-ssd1306.dtbo \
ti/k3-am67a-beagley-ai-mikroe-eth.dtbo \
ti/k3-am67a-beagley-ai-mikroe-microsd.dtbo \
ti/k3-am67a-beagley-ai-pps-gpio18.dtbo \
ti/k3-am67a-beagley-ai-pwm-ecap0-gpio12.dtbo \
ti/k3-am67a-beagley-ai-pwm-ecap1-gpio16.dtbo \
ti/k3-am67a-beagley-ai-pwm-ecap1-gpio21.dtbo \
ti/k3-am67a-beagley-ai-pwm-ecap2-gpio17.dtbo \
ti/k3-am67a-beagley-ai-pwm-ecap2-gpio18.dtbo \
ti/k3-am67a-beagley-ai-pwm-epwm0-gpio12.dtbo \
ti/k3-am67a-beagley-ai-pwm-epwm0-gpio14.dtbo \
ti/k3-am67a-beagley-ai-pwm-epwm0-gpio15.dtbo \
ti/k3-am67a-beagley-ai-pwm-epwm0-gpio15-gpio12.dtbo \
ti/k3-am67a-beagley-ai-pwm-epwm0-gpio15-gpio14.dtbo \
ti/k3-am67a-beagley-ai-pwm-epwm0-gpio5.dtbo \
ti/k3-am67a-beagley-ai-pwm-epwm0-gpio5-gpio12.dtbo \
ti/k3-am67a-beagley-ai-pwm-epwm0-gpio5-gpio14.dtbo \
ti/k3-am67a-beagley-ai-pwm-epwm1-gpio13.dtbo \
ti/k3-am67a-beagley-ai-pwm-epwm1-gpio20.dtbo \
ti/k3-am67a-beagley-ai-pwm-epwm1-gpio21.dtbo \
ti/k3-am67a-beagley-ai-pwm-epwm1-gpio21-gpio13.dtbo \
ti/k3-am67a-beagley-ai-pwm-epwm1-gpio21-gpio20.dtbo \
ti/k3-am67a-beagley-ai-pwm-epwm1-gpio6.dtbo \
ti/k3-am67a-beagley-ai-pwm-epwm1-gpio6-gpio13.dtbo \
ti/k3-am67a-beagley-ai-pwm-epwm1-gpio6-gpio20.dtbo \
ti/k3-am67a-beagley-ai-spi0-1cs.dtbo \
ti/k3-am67a-beagley-ai-spi0-2cs.dtbo \
ti/k3-am67a-beagley-ai-spidev0.dtbo \
ti/k3-am67a-beagley-ai-uart-ttyama0.dtbo \
ti/k3-j722s-evm-csi2-quad-rpi-cam-imx219.dtbo \
ti/k3-j722s-evm-csi2-quad-tevi-ov5640.dtbo \
ti/k3-j722s-evm-dsi-rpi-7inch-panel.dtbo \
ti/k3-j722s-evm.dtb \
ti/k3-j722s-evm-fpdlink-fusion.dtbo \
ti/k3-j722s-evm-fpdlink-iv-fusion.dtbo \
ti/k3-j722s-evm-microtips-mf101hie-panel.dtbo \
ti/k3-j722s-evm-pwm.dtbo \
ti/k3-j722s-evm-v3link-fusion.dtbo \
"

MACHINE_GUI_CLASS = "bigscreen"
```

## meta-beagle/conf/machine/include/beagle-bsp.inc
```bitbake
# Use meta-ti-bsp "multi-BSP" facility to create a custom "bb_org" BSP profile
# with default preferences for Beagle platforms

# Default is bb_org-6_12, but can override with any of the existing options
TI_PREFERRED_BSP ?= "bb_org-6_12"

# ===========
# bb_org-6_12
# BeagleBoard.org kernel 6.12, u-boot 2025.04
# based on TI staging trees with extra Beagle-specific features
# but may not be up-to-date with TI version
# ===========
BSP_KERNEL_PROVIDER:bsp-bb_org-6_12 = "linux-bb.org"
BSP_KERNEL_VERSION:bsp-bb_org-6_12 = "6.12.%"
BSP_BOOTLOADER_PROVIDER:bsp-bb_org-6_12 = "u-boot-bb.org"
BSP_BOOTLOADER_VERSION:bsp-bb_org-6_12 = "2025.%"

BSP_SGX_DRIVER_PROVIDER:bsp-bb_org-6_12 = "ti-sgx-ddk-km"
BSP_SGX_DRIVER_VERSION:bsp-bb_org-6_12 = "1.17%"
BSP_SGX_UMLIBS_VERSION:bsp-bb_org-6_12 = "1.17%"
BSP_ROGUE_DRIVER_PROVIDER:bsp-bb_org-6_12 = "ti-img-rogue-driver"
BSP_ROGUE_DRIVER_VERSION:bsp-bb_org-6_12 = "24%"
BSP_ROGUE_UMLIBS_VERSION:bsp-bb_org-6_12 = "24%"
BSP_MESA_PVR_VERSION:bsp-bb_org-6_12 = "24%"

# GC320 support requires out-of-tree drivers not yet available in bb.org 6.12
MACHINE_FEATURES:remove:bsp-bb_org-6_12 = "gc320"

# ==========
# bb_org-6_6
# BeagleBoard.org kernel 6.6, u-boot 2024.10
# based on TI staging trees with extra Beagle-specific features
# but may not be up-to-date with TI version
# ==========
BSP_KERNEL_PROVIDER:bsp-bb_org-6_6 = "linux-bb.org"
BSP_KERNEL_VERSION:bsp-bb_org-6_6 = "6.6.%"
BSP_BOOTLOADER_PROVIDER:bsp-bb_org-6_6 = "u-boot-bb.org"
BSP_BOOTLOADER_VERSION:bsp-bb_org-6_6 = "2024.%"

BSP_SGX_DRIVER_PROVIDER:bsp-bb_org-6_6 = "ti-sgx-ddk-km"
BSP_SGX_DRIVER_VERSION:bsp-bb_org-6_6 = "1.17%"
BSP_SGX_UMLIBS_VERSION:bsp-bb_org-6_6 = "1.17%"
BSP_ROGUE_DRIVER_PROVIDER:bsp-bb_org-6_6 = "ti-img-rogue-driver"
BSP_ROGUE_DRIVER_VERSION:bsp-bb_org-6_6 = "24%"
BSP_ROGUE_UMLIBS_VERSION:bsp-bb_org-6_6 = "24%"
BSP_MESA_PVR_VERSION:bsp-bb_org-6_6 = "24%"

# GC320 support requires out-of-tree drivers not yet available in bb.org 6.6
MACHINE_FEATURES:remove:bsp-bb_org-6_6 = "gc320"
```

## meta-beagle/conf/machine/pocketbeagle2-k3r5.conf
```bitbake
#@TYPE: Machine
#@NAME: PocketBeagle2 (R5F)
#@DESCRIPTION: Machine configuration for the PocketBeagle2 (R5F core)

require conf/machine/include/k3r5.inc
require conf/machine/include/beagle-bsp.inc

SYSFW_SOC = "am62x"
SYSFW_CONFIG = "evm"
SYSFW_SUFFIX = "hs-fs"

UBOOT_MACHINE = "am62_pocketbeagle2_r5_defconfig"
```

## meta-beagle/conf/machine/pocketbeagle2.conf
```bitbake
#@TYPE: Machine
#@NAME: PocketBeagle2 (A53)
#@DESCRIPTION: Machine configuration for the PocketBeagle2 board (A53 core)

require conf/machine/include/k3.inc
require conf/machine/include/mc_k3r5.inc

require conf/machine/include/beagle-bsp.inc

SOC_FAMILY:append = ":am62xx"

SERIAL_CONSOLES = "115200;ttyS2"

TFA_BOARD = "lite"
TFA_K3_SYSTEM_SUSPEND = "1"

OPTEEMACHINE = "k3-am62x"

UBOOT_MACHINE = "am6232_pocketbeagle2_a53_defconfig"

KERNEL_DEVICETREE_PREFIX = " \
    ti/k3-am6232 \
    ti/k3-am62-pocket \
"

KERNEL_DEVICETREE = " \
ti/k3-am6232-pocketbeagle2.dtb \
ti/k3-am6232-pocketbeagle2-techlab-cape.dtbo \
ti/k3-am625-beagleplay-bcfserial-no-firmware.dtbo \
ti/k3-am625-beagleplay-csi2-ov5640.dtbo \
ti/k3-am625-beagleplay-csi2-tevi-ov5640.dtbo \
ti/k3-am625-beagleplay.dtb \
ti/k3-am625-beagleplay-lincolntech-lcd185-panel.dtbo \
ti/k3-am625-sk.dtb \
ti/k3-am625-sk-lincolntech-lcd185-panel.dtbo \
ti/k3-am625-sk-m2-cc3351.dtbo \
ti/k3-am625-sk-mcspi-loopback.dtbo \
ti/k3-am625-sk-microtips-mf101hie-panel.dtbo \
ti/k3-am625-sk-rpi-hdr-ehrpwm.dtbo \
ti/k3-am62-pocketbeagle2-ardupilot-cape.dtbo \
ti/k3-am62-pocketbeagle2.dtb \
ti/k3-am62-pocketbeagle2-leds-off.dtbo \
ti/k3-am62-pocketbeagle2-techlab-cape.dtbo \
ti/k3-am62x-sk-csi2-imx219.dtbo \
ti/k3-am62x-sk-csi2-ov5640.dtbo \
ti/k3-am62x-sk-csi2-tevi-ov5640.dtbo \
ti/k3-am62x-sk-csi2-v3link-fusion.dtbo \
ti/k3-am62x-sk-dmtimer-pwm.dtbo \
ti/k3-am62x-sk-ecap-capture.dtbo \
ti/k3-am62x-sk-eqep.dtbo \
ti/k3-am62x-sk-fastboot-disable-hdmi.dtbo \
ti/k3-am62x-sk-hdmi-audio.dtbo \
ti/k3-am62x-sk-lpm-io-ddr-wkup-sources.dtbo \
ti/k3-am62x-sk-lpm-wkup-sources.dtbo \
ti/k3-am62x-sk-mcan.dtbo \
ti/k3-am62x-sk-microtips-mf103hie-lcd2.dtbo \
ti/k3-am62x-sk-pwm.dtbo \
"
```
