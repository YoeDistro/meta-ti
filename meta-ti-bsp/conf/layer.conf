## meta-ti-bsp/conf/machine/am62xx-lp-evm.conf
```bitbake
#@TYPE: Machine
#@NAME: AM62XX LP EVM
#@DESCRIPTION: Machine configuration for the TI AM62XX LP EVM

require conf/machine/include/am62xx.inc

KERNEL_DEVICETREE_PREFIX = " \
    ti/k3-am62-lp \
    ti/k3-am625-sk \
    ti/k3-am62x-sk-dmtimer-pwm \
    ti/k3-am62x-sk-eqep \
    ti/k3-am62x-sk-hdmi \
    ti/k3-am62x-sk-lpm \
    ti/k3-am62x-sk-mcan \
    ti/k3-am62x-sk-pwm \
"

KERNEL_DEVICETREE = " \
    ti/k3-am62-lp-sk-nand.dtbo \
    ti/k3-am62-lp-sk.dtb \
    ti/k3-am625-sk.dtb \
    ti/k3-am62x-sk-hdmi-audio.dtbo \
"

FIT_CONF_DEFAULT_DTB = "ti/k3-am62-lp-sk.dtb"

UBOOT_MACHINE = "am62x_lpsk_a53_defconfig"
```

## meta-ti-bsp/conf/machine/am62xx-unified-k3r5.conf
```bitbake
#@TYPE: Machine
#@NAME: AM62XX EVM (R5F)
#@DESCRIPTION: Machine configuration for the TI AM62xx EVM (R5F core)

require conf/machine/include/k3r5.inc
require conf/machine/include/ti-extras.inc

SYSFW_SOC = "am62x"
SYSFW_CONFIG = "evm"
SYSFW_SUFFIX = "hs-fs"

UBOOT_MACHINE = ""
# Last config in the list is default
UBOOT_CONFIG ??= "sip lpsk evm"

UBOOT_CONFIG:bsp-ti-6_1 ??= "evm"

UBOOT_CONFIG[sip] = "am62xsip_evm_r5_defconfig"
UBOOT_CONFIG[lpsk] = "am62x_lpsk_r5_defconfig"
UBOOT_CONFIG[evm] = "am62x_evm_r5_defconfig"

UBOOT_FRAGMENTS_CONFIG_SIP = ""
UBOOT_FRAGMENTS_CONFIG_SIP:bsp-ti-6_1 = "am62xsip_sk_r5"

UBOOT_FRAGMENTS_CONFIG[sip] = "${UBOOT_FRAGMENTS_CONFIG_SIP}"
UBOOT_FRAGMENTS_CONFIG[lpsk] = ""
UBOOT_FRAGMENTS_CONFIG[evm] = ""
```

## meta-ti-bsp/conf/machine/am62xx-unified.conf
```bitbake
#@TYPE: Machine
#@NAME: AM62XX Unified EVM
#@DESCRIPTION: Machine configuration for the TI AM62XX EVM and all of its variations

require conf/machine/include/am62xx.inc
require conf/machine/include/ti-extras.inc

KERNEL_DEVICETREE_PREFIX = " \
    ti/k3-am62-lp \
    ti/k3-am625 \
    ti/k3-am62x-sk \
"

KERNEL_DEVICETREE = " \
    ti/k3-am62-lp-sk.dtb \
    ti/k3-am625-beagleplay-csi2-ov5640.dtbo \
    ti/k3-am625-beagleplay-csi2-tevi-ov5640.dtbo \
    ti/k3-am625-beagleplay.dtb \
    ti/k3-am625-phyboard-lyra-rdk.dtb \
    ti/k3-am625-sk.dtb \
    ti/k3-am625-verdin-nonwifi-dahlia.dtb \
    ti/k3-am625-verdin-nonwifi-dev.dtb \
    ti/k3-am625-verdin-nonwifi-mallow.dtb \
    ti/k3-am625-verdin-nonwifi-yavia.dtb \
    ti/k3-am625-verdin-wifi-dahlia.dtb \
    ti/k3-am625-verdin-wifi-dev.dtb \
    ti/k3-am625-verdin-wifi-mallow.dtb \
    ti/k3-am625-verdin-wifi-yavia.dtb \
    ti/k3-am62x-sk-csi2-imx219.dtbo \
    ti/k3-am62x-sk-csi2-ov5640.dtbo \
    ti/k3-am62x-sk-csi2-tevi-ov5640.dtbo \
    ti/k3-am62x-sk-hdmi-audio.dtbo \
"

UBOOT_MACHINE = ""
# Last config in the list is default
UBOOT_CONFIG ??= "sip lpsk evm"

UBOOT_CONFIG:bsp-ti-6_1 ??= "lpsk evm"

UBOOT_CONFIG[sip] = "am62xsip_evm_a53_defconfig"
UBOOT_CONFIG[lpsk] = "am62x_lpsk_a53_defconfig"
UBOOT_CONFIG[evm] = "am62x_evm_a53_defconfig"
```

## meta-ti-bsp/conf/machine/am62xxsip-evm-k3r5.conf
```bitbake
#@TYPE: Machine
#@NAME: AM62XX SIP EVM (R5F)
#@DESCRIPTION: Machine configuration for the TI AM62xx SIP EVM (R5F core)

require conf/machine/include/k3r5.inc

UBOOT_MACHINE = "am6254xxl_evm_r5_defconfig"
UBOOT_MACHINE:bsp-ti-6_6 = "am62xsip_evm_r5_defconfig"
UBOOT_MACHINE:bsp-ti-6_18 = "am6254atl_evm_r5_defconfig"
```

## meta-ti-bsp/conf/machine/am62xxsip-evm.conf
```bitbake
#@TYPE: Machine
#@NAME: AM62XX SIP EVM
#@DESCRIPTION: Machine configuration for the TI AM62XX SIP EVM

require conf/machine/include/am62xx.inc

TFA_K3_BL32_BASE = "0x80080000"
TFA_K3_BL32_BASE:bsp-ti-6_6 = ""

TFA_K3_PRELOADED_BL33 = "0x82000000"
TFA_K3_PRELOADED_BL33:bsp-ti-6_6 = ""

OPTEE_K3_TZDRAM_START = "0x80080000"
OPTEE_K3_TZDRAM_START:bsp-ti-6_6 = ""

KERNEL_DEVICETREE_PREFIX = " \
    ti/k3-am625 \
    ti/k3-am62x-sk \
"

KERNEL_DEVICETREE = " \
    ti/k3-am625-sk.dtb \
"

FIT_CONF_DEFAULT_DTB = "k3-am6254xxl-sk.dtb"
FIT_CONF_DEFAULT_DTB:bsp-ti-6_6 = "k3-am625-sk.dtb"
FIT_CONF_DEFAULT_DTB:bsp-ti-6_18 = "k3-am6254atl-sk.dtb"

UBOOT_MACHINE = "am6254xxl_evm_a53_defconfig"
UBOOT_MACHINE:bsp-ti-6_6 = "am62xsip_evm_a53_defconfig"
UBOOT_MACHINE:bsp-ti-6_18 = "am6254atl_evm_a53_defconfig"
```

## meta-ti-bsp/conf/machine/am64xx-evm-k3r5.conf
```bitbake
#@TYPE: Machine
#@NAME: AM64xx EVM (R5F)
#@DESCRIPTION: Machine configuration for the TI AM64xx EVM (R5F core)

require conf/machine/include/k3r5.inc

UBOOT_MACHINE = ""

UBOOT_ECDSA_SIGN_CONFIG ?= "ecdsa"
UBOOT_ECDSA_SIGN_CONFIG:bsp-ti-6_6 = ""
UBOOT_ECDSA_SIGN_CONFIG:bsp-next = ""
UBOOT_ECDSA_SIGN_CONFIG:bsp-mainline = ""

UBOOT_CONFIG = "${UBOOT_ECDSA_SIGN_CONFIG} main"

UBOOT_CONFIG[main] = "am64x_evm_r5_defconfig"
UBOOT_CONFIG[ecdsa] = "am64x_evm_r5_defconfig"

UBOOT_CONFIG_MAKE_OPTS[ecdsa] = "${TI_SIGN_WITH_ECDSA_KEY}"
```
