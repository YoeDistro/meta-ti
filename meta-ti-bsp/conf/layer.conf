## meta-ti-bsp/conf/layer.conf
```bitbake
# We have a conf and classes directory, append to BBPATH
BBPATH .= ":${LAYERDIR}"
METATIBASE := '${@os.path.normpath("${LAYERDIR}/")}'

# We have a recipes directory, add to BBFILES
BBFILES += "${LAYERDIR}/recipes*/*/*.bb ${LAYERDIR}/recipes*/*/*.bbappend"

BBFILE_COLLECTIONS += "meta-ti-bsp"
BBFILE_PATTERN_meta-ti-bsp := "^${LAYERDIR}/"
BBFILE_PRIORITY_meta-ti-bsp = "6"

LAYERSERIES_COMPAT_meta-ti-bsp = "scarthgap"

LICENSE_PATH += "${LAYERDIR}/licenses"

LAYERDEPENDS_meta-ti-bsp = " \
    core \
    meta-arm \
"

LAYERRECOMMENDS_meta-ti-bsp = " \
    openembedded-layer \
"

BBFILES_DYNAMIC += " \
    openembedded-layer:${LAYERDIR}/dynamic-layers/openembedded-layer/recipes*/*/*.bbappend \
"

SIGGEN_EXCLUDERECIPES_ABISAFE += " \
    mesa-pvr \
"

HOSTTOOLS_NONFATAL += "truncate xxd comm"

TI_COMMON_DEPLOY ?= "${TOPDIR}/deploy-ti"
DEPLOY_DIR_IMAGE:ti-soc = "${TI_COMMON_DEPLOY}/images/${MACHINE}"
SDK_DEPLOY:ti-soc = "${TI_COMMON_DEPLOY}/sdk"
PSEUDO_IGNORE_PATHS:append:ti-soc = ",${TI_COMMON_DEPLOY}"

MIRRORS += " \
    git://git.ti.com/.* git://github.com/TexasInstruments/BASENAME;protocol=https \
    gitsm://git.ti.com/.* gitsm://github.com/TexasInstruments/BASENAME;protocol=https \
"
```

## meta-ti-bsp/conf/machine/am335x-hs-evm.conf
```bitbake
#@TYPE: Machine
#@NAME: AM335x HS EVM
#@DESCRIPTION: Machine configuration for the TI AM335x HS EVM

require conf/machine/am335x-evm.conf

UBOOT_MACHINE = ""
# Last config in the list is default
UBOOT_CONFIG ??= "uart mmc"
UBOOT_CONFIG[uart] = "am335x_hs_evm_uart_config"
UBOOT_CONFIG[mmc] = "am335x_hs_evm_config"

# FIT image for legacy secure devices
KERNEL_CLASSES += " kernel-fitimage-legacyhs"
KERNEL_IMAGETYPES += " fitImage"

# FIT image settings
FITIMAGE_HASH_ALGO = ""
FITIMAGE_DTB_BY_NAME = "1"
FITIMAGE_TEE_BY_NAME = "1"
FITIMAGE_CONF_BY_NAME = "1"
```

## meta-ti-bsp/conf/machine/am437x-hs-evm.conf
```bitbake
#@TYPE: Machine
#@NAME: AM437x HS EVM
#@DESCRIPTION: Machine configuration for the TI AM437x HS EVM

require conf/machine/am437x-evm.conf

UBOOT_MACHINE = "am43xx_hs_evm_config"

OPTEEMACHINE = "ti-am43xx"
OPTEEFLAVOR = "am43xx"

EXTRA_IMAGEDEPENDS += "optee-os"

# FIT image for legacy secure devices
KERNEL_BASE_CLASS = "kernel_legacyhs"
KERNEL_CLASSES += " kernel-fitimage-legacyhs"
KERNEL_IMAGETYPES += " fitImage"

# FIT image settings
FITIMAGE_HASH_ALGO = ""
FITIMAGE_PACK_TEE = "1"
FITIMAGE_DTB_BY_NAME = "1"
FITIMAGE_TEE_BY_NAME = "1"
FITIMAGE_CONF_BY_NAME = "1"
```

## meta-ti-bsp/conf/machine/am57xx-evm.conf
```bitbake
#@TYPE: Machine
#@NAME: AM57xx EVM
#@DESCRIPTION: Machine configuration for the TI AM57xx EVM

require conf/machine/include/am57xx.inc

MACHINE_FEATURES += "touchscreen"

SERIAL_CONSOLES = "115200;ttyS2"

KERNEL_DEVICETREE_PREFIX = " \
    am57 \
    ov10635 \
    ti/am57 \
    ti/lcd \
    ti/ov10635 \
    ti/omap/am57 \
"

KERNEL_DEVICETREE_DTBMERGE = " \
    am57xx-evm.dtb \
    am57xx-evm-reva3.dtb \
    ti/omap/am57xx-evm.dtb \
    ti/omap/am57xx-evm-reva3.dtb \
"

KERNEL_DEVICETREE = " \
    ti/omap/am571x-idk-touchscreen.dtbo \
    ti/omap/am571x-idk.dtb \
    ti/omap/am5729-beagleboneai.dtb \
    ti/omap/am572x-idk-touchscreen.dtbo \
    ti/omap/am572x-idk.dtb \
    ti/omap/am574x-idk.dtb \
    ti/omap/am57xx-beagle-x15-revb1.dtb \
    ti/omap/am57xx-beagle-x15-revc.dtb \
    ti/omap/am57xx-beagle-x15.dtb \
    ti/omap/am57xx-cl-som-am57x.dtb \
    ti/omap/am57xx-evm-reva3.dtb \
    ti/omap/am57xx-evm.dtb \
    ti/omap/am57xx-evm.dtbo \
    ti/omap/am57xx-idk-lcd-osd101t2045.dtbo \
    ti/omap/am57xx-idk-lcd-osd101t2587.dtbo \
    ti/omap/am57xx-sbc-am57x.dtb \
"

UBOOT_MACHINE = "am57xx_evm_config"

# UBI information.  Note that this is board and kernel specific.  Changes
# in your kernel port may require changes in these variables.  For more
# details about this board please see
# http://processors.wiki.ti.com/index.php/UBIFS_Support

# do ubiattach /dev/ubi_ctrl -m 7 -O 2048
# From dmesg:
# UBI: smallest flash I/O unit:    2048
# UBI: logical eraseblock size:    126976 bytes
# from ubiattach stdout:
# UBI device number 0, total 1988 LEBs
MKUBIFS_ARGS = "-F -m 2048 -e 126976 -c 8192"

# do ubiattach /dev/ubi_ctrl -m 7 -O 2048
# from dmesg:
# UBI: smallest flash I/O unit:    2048
# UBI: physical eraseblock size:   131072 bytes (128 KiB)
# UBI: sub-page size:              512
# UBI: VID header offset:          2048 (aligned 2048)
UBINIZE_ARGS = "-m 2048 -p 128KiB -s 512 -O 2048"
```

## meta-ti-bsp/conf/machine/am57xx-hs-evm.conf
```bitbake
#@TYPE: Machine
#@NAME: AM57xx HS EVM
#@DESCRIPTION: Machine configuration for the TI AM57xx HS EVM

require conf/machine/am57xx-evm.conf

UBOOT_MACHINE = "am57xx_hs_evm_config"

OPTEEMACHINE = "ti-am57xx"
OPTEEFLAVOR = "am57xx"
OPTEEPAGER = "y"

EXTRA_IMAGEDEPENDS += "optee-os"

# FIT image for legacy secure devices
KERNEL_BASE_CLASS = "kernel_legacyhs"
KERNEL_CLASSES += " kernel-fitimage-legacyhs"
KERNEL_IMAGETYPES += " fitImage"

# FIT image settings
FITIMAGE_HASH_ALGO = ""
FITIMAGE_PACK_TEE = "1"
FITIMAGE_DTB_BY_NAME = "1"
FITIMAGE_TEE_BY_NAME = "1"
FITIMAGE_CONF_BY_NAME = "1"
```

## meta-ti-bsp/conf/machine/am62axx-evm-k3r5.conf
```bitbake
#@TYPE: Machine
#@NAME: AM62A HS-FS EVM (R5F)
#@DESCRIPTION: Machine configuration for the TI AM62A EVM (R5F core)

require conf/machine/include/k3r5.inc

UBOOT_MACHINE = ""

#XXX UBOOT_CONFIG = "falcon main"
UBOOT_CONFIG = "main"
UBOOT_CONFIG:prepend:tie-test-builds = "usbdfu "
UBOOT_CONFIG[main] = "am62ax_evm_r5_defconfig"
UBOOT_CONFIG[falcon] = "am62ax_evm_r5_defconfig"
UBOOT_CONFIG[usbdfu] = "am62ax_evm_r5_defconfig"

UBOOT_CONFIG_FRAGMENTS[falcon] = "k3_r5_falcon.config"
UBOOT_CONFIG_FRAGMENTS[usbdfu] = "am62x_r5_usbdfu.config"
```

## meta-ti-bsp/conf/machine/am62axx-evm.conf
```bitbake
#@TYPE: Machine
#@NAME: AM62AXX EVM
#@DESCRIPTION: Machine configuration for the TI AM62AXX EVM

require conf/machine/include/am62axx.inc

KERNEL_DEVICETREE_PREFIX = " \
    ti/k3-am62a7 \
    ti/k3-am62x-sk \
    ti/k3-fpdlink \
    ti/k3-v3link \
"

KERNEL_DEVICETREE_DTBMERGE = " \
    ti/k3-am62a7-sk-ub954-evm-ov2312.dtb \
"

KERNEL_DEVICETREE = " \
    ti/k3-am62a7-phyboard-lyra-rdk.dtb \
    ti/k3-am62a7-sk.dtb \
    ti/k3-am62x-sk-csi2-imx219.dtbo \
    ti/k3-am62x-sk-csi2-ov5640.dtbo \
    ti/k3-am62x-sk-csi2-tevi-ov5640.dtbo \
    ti/k3-am62x-sk-hdmi-audio.dtbo \
"

FIT_CONF_DEFAULT_DTB = "k3-am62a7-sk.dtb"

UBOOT_MACHINE = "am62ax_evm_a53_defconfig"
```

## meta-ti-bsp/conf/machine/am62dxx-evm-k3r5.conf
```bitbake
#@TYPE: Machine
#@NAME: AM62D HS-FS EVM (R5F)
#@DESCRIPTION: Machine configuration for the TI AM62D EVM (R5F core)

require conf/machine/include/k3r5.inc

UBOOT_MACHINE = "am62dx_evm_r5_defconfig"
```

## meta-ti-bsp/conf/machine/am62dxx-evm.conf
```bitbake
#@TYPE: Machine
#@NAME: AM62DXX EVM
#@DESCRIPTION: Machine configuration for the TI AM62DXX EVM

require conf/machine/include/am62dxx.inc

KERNEL_DEVICETREE_PREFIX = " \
    ti/k3-am62d2 \
    ti/k3-am62a7-sk \
    ti/k3-am62x-sk-csi2 \
    ti/k3-am62x-sk-ecap-capture \
    ti/k3-am62x-sk-eqep \
    ti/k3-am62x-sk-hdmi \
    ti/k3-am62x-sk-lpm \
    ti/k3-am62x-sk-mcspi-loopback \
    ti/k3-am62x-sk-pwm \
"

KERNEL_DEVICETREE = ""

FIT_CONF_DEFAULT_DTB = "k3-am62d2-evm.dtb"

UBOOT_MACHINE = "am62dx_evm_a53_defconfig"

MACHINE_ESSENTIAL_EXTRA_RRECOMMENDS += "ti-adc-fw"
```

## meta-ti-bsp/conf/machine/am62lxx-evm.conf
```bitbake
#@TYPE: Machine
#@NAME: AM62L EVM
#@DESCRIPTION: Machine configuration for the TI AM62L EVM

require conf/machine/include/am62lxx.inc

IMAGE_FSTYPES += "ubifs ubi"

MKUBIFS_ARGS ?= "-F -m 4096 -e 258048 -c 12000"

UBINIZE_ARGS ?= "-m 4096 -p 256KiB -s 1024 -O 1024"

KERNEL_DEVICETREE_PREFIX = " \
    ti/k3-am62l \
"

KERNEL_DEVICETREE = ""

UBOOT_MACHINE = "am62lx_evm_defconfig"
FIT_CONF_DEFAULT_DTB = "k3-am62l3-evm.dtb"
UBOOT_LOADADDRESS = "0x82400000"
UBOOT_ENTRYPOINT = "0x82400000"
UBOOT_RD_LOADADDRESS = "0x84000000"
UBOOT_RD_ENTRYPOINT = "0x84000000"
UBOOT_DTB_LOADADDRESS = "0x84f00000"
UBOOT_DTBO_LOADADDRESS = "0x84f80000"
```

## meta-ti-bsp/conf/machine/am62pxx-evm-k3r5.conf
```bitbake
#@TYPE: Machine
#@NAME: AM62PX EVM (R5F)
#@DESCRIPTION: Machine configuration for the TI AM62Px EVM (R5F core)

require conf/machine/include/k3r5.inc

UBOOT_MACHINE = ""

UBOOT_ECDSA_SIGN_CONFIG ?= "ecdsa"
UBOOT_ECDSA_SIGN_CONFIG:bsp-ti-6_6 = ""
UBOOT_ECDSA_SIGN_CONFIG:bsp-next = ""
UBOOT_ECDSA_SIGN_CONFIG:bsp-mainline = ""

UBOOT_CONFIG = "${UBOOT_ECDSA_SIGN_CONFIG} main"
UBOOT_CONFIG:prepend:tie-test-builds = "usbdfu "

UBOOT_CONFIG[main] = "am62px_evm_r5_defconfig"
UBOOT_CONFIG[ecdsa] = "am62px_evm_r5_defconfig"
UBOOT_CONFIG[usbdfu] = "am62px_evm_r5_defconfig"

UBOOT_CONFIG_MAKE_OPTS[ecdsa] = "${TI_SIGN_WITH_ECDSA_KEY}"

UBOOT_CONFIG_FRAGMENTS[usbdfu] = "am62x_r5_usbdfu.config"

UBOOT_FRAGMENTS:ti-falcon = "k3_r5_falcon.config"
```

## meta-ti-bsp/conf/machine/am62pxx-evm.conf
```bitbake
#@TYPE: Machine
#@NAME: AM62PX EVM
#@DESCRIPTION: Machine configuration for the TI AM62PX EVM

require conf/machine/include/am62pxx.inc

KERNEL_DEVICETREE_PREFIX = " \
    ti/k3-am62p5 \
    ti/k3-am62x-sk-csi2 \
    ti/k3-am62x-sk-hdmi \
    ti/k3-am62x-sk-lpm \
    ti/k3-am62x-sk-mcspi-loopback \
    ti/k3-v3link \
"

KERNEL_DEVICETREE = " \
    ti/k3-am62p5-sk.dtb \
    ti/k3-am62x-sk-csi2-imx219.dtbo \
    ti/k3-am62x-sk-csi2-ov5640.dtbo \
    ti/k3-am62x-sk-csi2-tevi-ov5640.dtbo \
    ti/k3-am62x-sk-hdmi-audio.dtbo \
"

FIT_CONF_DEFAULT_DTB = "k3-am62p5-sk.dtb"

UBOOT_ECDSA_SIGN_CONFIG ?= "ecdsa"
UBOOT_ECDSA_SIGN_CONFIG:bsp-ti-6_6 = ""
UBOOT_ECDSA_SIGN_CONFIG:bsp-next = ""
UBOOT_ECDSA_SIGN_CONFIG:bsp-mainline = ""

ECDSA_BOOT_FILES ?= "tiboot3.bin-ecdsa tiboot3-*-evm.bin-ecdsa tispl.bin-ecdsa u-boot.img-ecdsa"
ECDSA_BOOT_FILES:bsp-ti-6_6 = ""
ECDSA_BOOT_FILES:bsp-next = ""
ECDSA_BOOT_FILES:bsp-mainline = ""

UBOOT_MACHINE = ""
UBOOT_CONFIG = "${UBOOT_ECDSA_SIGN_CONFIG} main"
UBOOT_CONFIG[main] = "am62px_evm_a53_defconfig"
UBOOT_CONFIG[ecdsa] = "am62px_evm_a53_defconfig"

UBOOT_CONFIG_MAKE_OPTS[ecdsa] = "${TI_SIGN_WITH_ECDSA_KEY}"

IMAGE_BOOT_FILES += "${ECDSA_BOOT_FILES}"

# UBOOT_FRAGMENTS holds the list of u-boot config fragments which has to be build
# along with the base defconfig mentioned in UBOOT_MACHINE. Refer u-boot-mergeconfig.inc
# under meta-ti-bsp/recipes-bsp/u-boot/ for more details.
# For AM62P tisdk-display-cluster image, splash screen is handled by SBL.
# Hence, disable the A53 based splash screen using the am62x_evm_prune_splashscreen.config fragment present in ti-u-boot tree
UBOOT_FRAGMENTS = "${@oe.utils.conditional('DISPLAY_CLUSTER_ENABLE', '1', 'am62x_evm_prune_splashscreen.config', '', d)}"
```

## meta-ti-bsp/conf/machine/am62xx-evm-k3-falcon.conf
```bitbake
#@TYPE: Machine
#@NAME: AM62XX EVM
#@DESCRIPTION: Machine configuration for the TI AM62XX EVM

require conf/machine/include/k3-falcon.inc

SOC_FAMILY:append = ":k3"
SOC_FAMILY:append = ":am62xx"

MACHINE_FEATURES += "screen"

require conf/machine/include/mesa-pvr.inc
PREFERRED_PROVIDER_virtual/gpudriver ?= "${BSP_ROGUE_DRIVER_PROVIDER}"

# Bitmap image tarball for early splashscreen
IMAGE_BOOT_FILES += "ti_logo_414x97_32bpp.bmp.gz"

TFA_BOARD = "lite"
TFA_K3_SYSTEM_SUSPEND = "1"

OPTEEMACHINE = "k3-am62x"

KERNEL_DEVICETREE_PREFIX = " \
    ti/k3-am625 \
    ti/k3-am62x-sk \
"

KERNEL_DEVICETREE = " \
    ti/k3-am625-beagleplay-csi2-ov5640.dtbo \
    ti/k3-am625-beagleplay-csi2-tevi-ov5640.dtbo \
    ti/k3-am625-beagleplay.dtb \
    ti/k3-am625-phyboard-lyra-1-4-ghz-opp.dtbo \
    ti/k3-am625-phyboard-lyra-rdk.dtb \
    ti/k3-am625-sk.dtb \
    ti/k3-am625-verdin-nonwifi-dahlia.dtb \
    ti/k3-am625-verdin-nonwifi-dev.dtb \
    ti/k3-am625-verdin-nonwifi-mallow.dtb \
    ti/k3-am625-verdin-nonwifi-yavia.dtb \
    ti/k3-am625-verdin-wifi-dahlia.dtb \
    ti/k3-am625-verdin-wifi-dev.dtb \
    ti/k3-am625-verdin-wifi-mallow.dtb \
    ti/k3-am625-verdin-wifi-yavia.dtb \
    ti/k3-am62x-sk-csi2-imx219.dtbo \
    ti/k3-am62x-sk-csi2-ov5640.dtbo \
    ti/k3-am62x-sk-csi2-tevi-ov5640.dtbo \
    ti/k3-am62x-sk-hdmi-audio.dtbo \
"

FIT_CONF_DEFAULT_DTB = "k3-am625-sk.dtb"

UBOOT_MACHINE = "am62x_evm_a53_defconfig"
```

## meta-ti-bsp/conf/machine/am62xx-evm-k3r5-falcon.conf
```bitbake
require conf/machine/include/k3r5-falcon.inc
require conf/machine/include/am62xx-k3r5.inc

UBOOT_CONFIG_FRAGMENTS = "k3_r5_falcon.config"

TI_UPSTREAM_TOOLS_MACHINE = "am62xx-evm-k3r5"

UBOOT_CONFIG:remove:k3r5-falcon = "${UBOOT_TEST_BUILD_CONFIGS}"
```

## meta-ti-bsp/conf/machine/am62xx-evm-k3r5-gp.conf
```bitbake
#@TYPE: Machine
#@NAME: AM62XX EVM (R5F)
#@DESCRIPTION: Machine configuration for the TI AM62xx EVM (R5F core)

require conf/machine/include/k3r5.inc

SYSFW_SOC = "am62x"
SYSFW_CONFIG = "evm"
SYSFW_SUFFIX = "gp"

SYSFW_TIBOOT3_SYMLINK = ""

UBOOT_MACHINE = "am62x_evm_r5_defconfig"

SPL_BINARY = ""
UBOOT_BINARY = "u-boot-spl.${UBOOT_SUFFIX}"
UBOOT_IMAGE = "u-boot-r5spl-gp-${MAINMACHINE}-${PV}-${PR}.${UBOOT_SUFFIX}"
UBOOT_SYMLINK = "u-boot-r5spl-gp.${UBOOT_SUFFIX}"
```

## meta-ti-bsp/conf/machine/am62xx-evm-k3r5.conf
```bitbake
#@TYPE: Machine
#@NAME: AM62XX EVM (R5F)
#@DESCRIPTION: Machine configuration for the TI AM62xx EVM (R5F core)

require conf/machine/include/k3r5.inc

UBOOT_MACHINE = ""

UBOOT_CONFIG = "falcon main"
UBOOT_CONFIG:prepend:tie-test-builds = "usbdfu "
UBOOT_CONFIG[main] = "am62x_evm_r5_defconfig"
UBOOT_CONFIG[falcon] = "am62x_evm_r5_defconfig"
UBOOT_CONFIG[usbdfu] = "am62x_evm_r5_defconfig"

UBOOT_CONFIG_FRAGMENTS[falcon] = "k3_r5_falcon.config"
UBOOT_CONFIG_FRAGMENTS[usbdfu] = "am62x_r5_usbdfu.config"
```

## meta-ti-bsp/conf/machine/am62xx-evm.conf
```bitbake
#@TYPE: Machine
#@NAME: AM62XX EVM
#@DESCRIPTION: Machine configuration for the TI AM62XX EVM

require conf/machine/include/am62xx.inc
require conf/machine/include/ti-extras.inc

KERNEL_DEVICETREE_PREFIX = " \
    ti/k3-am625 \
    ti/k3-am62x-sk \
"

KERNEL_DEVICETREE = " \
    ti/k3-am625-beagleplay-csi2-ov5640.dtbo \
    ti/k3-am625-beagleplay-csi2-tevi-ov5640.dtbo \
    ti/k3-am625-beagleplay.dtb \
    ti/k3-am625-phyboard-lyra-1-4-ghz-opp.dtbo \
    ti/k3-am625-phyboard-lyra-rdk.dtb \
    ti/k3-am625-sk.dtb \
    ti/k3-am625-verdin-nonwifi-dahlia.dtb \
    ti/k3-am625-verdin-nonwifi-dev.dtb \
    ti/k3-am625-verdin-nonwifi-mallow.dtb \
    ti/k3-am625-verdin-nonwifi-yavia.dtb \
    ti/k3-am625-verdin-wifi-dahlia.dtb \
    ti/k3-am625-verdin-wifi-dev.dtb \
    ti/k3-am625-verdin-wifi-mallow.dtb \
    ti/k3-am625-verdin-wifi-yavia.dtb \
    ti/k3-am62x-sk-csi2-imx219.dtbo \
    ti/k3-am62x-sk-csi2-ov5640.dtbo \
    ti/k3-am62x-sk-csi2-tevi-ov5640.dtbo \
    ti/k3-am62x-sk-hdmi-audio.dtbo \
"

UBOOT_MACHINE = "am62x_evm_a53_defconfig"
```

## meta-ti-bsp/conf/machine/am62xx-lp-evm-k3r5-hs-se.conf
```bitbake
#@TYPE: Machine
#@NAME: AM62xx LPSK HS-SE EVM (R5F)
#@DESCRIPTION: Machine configuration for the TI AM62xx LP HS-SE EVM (R5F core)

# Booting HS-SE requires different SYSFW, the rest is handled at runtime

require conf/machine/include/k3r5.inc
SOC_FAMILY:append = ":k3r5-hs-se"

SYSFW_SOC = "am62x"
SYSFW_CONFIG = "evm"
SYSFW_SUFFIX = "hs"

UBOOT_MACHINE = "am62x_lpsk_r5_defconfig"
```

## meta-ti-bsp/conf/machine/am62xx-lp-evm-k3r5.conf
```bitbake
#@TYPE: Machine
#@NAME: AM62XX LP GP EVM (R5F)
#@DESCRIPTION: Machine configuration for the TI AM62xx LP GP EVM (R5F core)

require conf/machine/include/k3r5.inc

UBOOT_MACHINE = "am62x_lpsk_r5_defconfig"

UBOOT_FRAGMENTS:ti-falcon = "k3_r5_falcon.config"
```
