## meta-ti-bsp/conf/machine/include/am62xx-lp.inc
```bitbake
require conf/machine/include/k3.inc
SOC_FAMILY:append = ":am62xx"

MACHINE_FEATURES += "screen touchscreen"

TFA_K3_SYSTEM_SUSPEND = "1"

# Default tiboot3.bin on AM62x LP is for HS-FS
IMAGE_BOOT_FILES += "tiboot3-am62x-hs-fs-evm.bin"

# Since default tiboot3.bin on AM62x LP is for HS-FS, add a version for HS-SE
IMAGE_BOOT_FILES += "tiboot3-am62x-hs-evm.bin"

TFA_BOARD = "lite"
OPTEEMACHINE = "k3-am62x"
```

## meta-ti-bsp/conf/machine/include/am62xx.inc
```bitbake
require conf/machine/include/k3.inc
SOC_FAMILY:append = ":am62xx"

MACHINE_FEATURES += "screen gpu"

require conf/machine/include/mesa-pvr.inc
PREFERRED_PROVIDER_virtual/gpudriver ?= "${BSP_ROGUE_DRIVER_PROVIDER}"

# Default tiboot3.bin on AM62x is for HS-FS
TI_BOOTLOADERS += "tiboot3-am62x-hs-fs-evm.bin"
TI_MULTICONFIGS += "am62x-hs-fs-evm"

# Since default tiboot3.bin on AM62x is for HS-FS, add a version for GP
TI_BOOTLOADERS += "tiboot3-am62x-gp-evm.bin"
TI_MULTICONFIGS += "am62x-gp-evm"

# Since default tiboot3.bin on AM62x is for HS-FS, add a version for HS-SE
TI_BOOTLOADERS += "tiboot3-am62x-hs-evm.bin"
TI_MULTICONFIGS += "am62x-hs-evm"

# Bitmap image tarball for early splashscreen
IMAGE_BOOT_FILES += "ti_logo_414x97_32bpp.bmp.gz"

TFA_BOARD = "lite"
TFA_K3_SYSTEM_SUSPEND = "1"

OPTEEMACHINE = "k3-am62x"

# Normally AM62 boards use ttyS2, but our Jailhouse inmate may use ttyS3, so try both
SERIAL_CONSOLES = "115200;ttyS2 115200;ttyS3"
```

## meta-ti-bsp/conf/machine/include/am64xx.inc
```bitbake
require conf/machine/include/k3.inc
require conf/machine/include/mc_k3r5.inc

SOC_FAMILY:append = ":am64xx"

KERNEL_DEVICETREE_PREFIX = "ti/k3-am642"

KERNEL_DEVICETREE = " \
    ti/k3-am642-evm-icssg1-dualemac-mii.dtbo \
    ti/k3-am642-evm-icssg1-dualemac.dtbo \
    ti/k3-am642-evm-nand.dtbo \
    ti/k3-am642-evm.dtb \
    ti/k3-am642-hummingboard-t-pcie.dtbo \
    ti/k3-am642-hummingboard-t-usb3.dtbo \
    ti/k3-am642-hummingboard-t.dtb \
    ti/k3-am642-phyboard-electra-gpio-fan.dtbo \
    ti/k3-am642-phyboard-electra-pcie-usb2.dtbo \
    ti/k3-am642-phyboard-electra-rdk.dtb \
    ti/k3-am642-sk.dtb \
    ti/k3-am642-tqma64xxl-mbax4xxl.dtb \
"

TFA_BOARD = "lite"

OPTEEMACHINE = "k3-am64x"

MACHINE_ESSENTIAL_EXTRA_RRECOMMENDS += "prueth-fw pruhsr-fw prusw-fw"

TI_WKS_BOOTLOADER_APPEND = "console=ttyS2,115200n8"
```

## meta-ti-bsp/conf/machine/include/am65xx.inc
```bitbake
require conf/machine/include/k3.inc
require conf/machine/include/mc_k3r5.inc

SOC_FAMILY:append = ":am65xx"

MACHINE_FEATURES += "screen touchscreen gpu"

require conf/machine/include/mesa-pvr.inc
PREFERRED_PROVIDER_virtual/gpudriver ?= "${BSP_SGX_DRIVER_PROVIDER}"

KERNEL_DEVICETREE_PREFIX = "ti/k3-am654"

KERNEL_DEVICETREE_DTBMERGE = " \
    ti/k3-am654-gp-evm.dtb \
    ti/k3-am654-evm.dtb \
    ti/k3-am654-idk.dtb \
    ti/k3-am6548-iot2050-advanced-m2-bkey-ekey-pcie.dtb \
    ti/k3-am6548-iot2050-advanced-m2-bkey-usb3.dtb \
"

KERNEL_DEVICETREE = " \
    ti/k3-am654-base-board-rocktech-rk101-panel.dtbo \
    ti/k3-am654-base-board.dtb \
    ti/k3-am654-icssg2.dtbo \
    ti/k3-am654-idk.dtbo \
    ti/k3-am654-pcie-usb2.dtbo \
    ti/k3-am654-pcie-usb3.dtbo \
    ti/k3-am6548-iot2050-advanced-m2-bkey-ekey-pcie.dtbo \
    ti/k3-am6548-iot2050-advanced-m2-bkey-usb3.dtbo \
    ti/k3-am6548-iot2050-advanced-m2.dtb \
    ti/k3-am6548-iot2050-advanced-pg2.dtb \
    ti/k3-am6548-iot2050-advanced-sm.dtb \
    ti/k3-am6548-iot2050-advanced.dtb \
"

# Deploy SYSFW and any variants
IMAGE_BOOT_FILES += "sysfw.itb sysfw-*-evm.itb"

TFA_BOARD = "generic"

OPTEEMACHINE = "k3-am65x"

MACHINE_ESSENTIAL_EXTRA_RRECOMMENDS += "prueth-fw"
```

## meta-ti-bsp/conf/machine/include/am68.inc
```bitbake
require conf/machine/include/k3.inc
require conf/machine/include/mc_k3r5.inc

SOC_FAMILY:append = ":j721s2"

MACHINE_FEATURES += "screen gpu"

require conf/machine/include/mesa-pvr.inc
PREFERRED_PROVIDER_virtual/gpudriver ?= "${BSP_ROGUE_DRIVER_PROVIDER}"

# Default tiboot3.bin on AM68 is for SR1.0 HS-FS
IMAGE_BOOT_FILES += "tiboot3-j721s2-hs-fs-evm.bin"

# Since default tiboot3.bin on AM68 is for HS-FS, add a version for SR1.0 HS-SE
IMAGE_BOOT_FILES += "tiboot3-j721s2-hs-evm.bin"

TFA_BOARD = "generic"

OPTEEMACHINE = "k3-j784s4"

MACHINE_ESSENTIAL_EXTRA_RRECOMMENDS += "cadence-mhdp-fw cnm-wave-fw"
```

## meta-ti-bsp/conf/machine/include/am69.inc
```bitbake
require conf/machine/include/k3.inc
require conf/machine/include/mc_k3r5.inc

SOC_FAMILY:append = ":j784s4"

MACHINE_FEATURES += "screen"

require conf/machine/include/mesa-pvr.inc
PREFERRED_PROVIDER_virtual/gpudriver ?= "${BSP_ROGUE_DRIVER_PROVIDER}"

TFA_BOARD = "j784s4"

OPTEEMACHINE = "k3-j784s4"

MACHINE_ESSENTIAL_EXTRA_RRECOMMENDS += "cadence-mhdp-fw cnm-wave-fw ti-eth-fw-j784s4"
```

## meta-ti-bsp/conf/machine/include/dra7xx.inc
```bitbake
require conf/machine/include/omap-a15.inc
SOC_FAMILY:append = ":dra7xx"

MACHINE_FEATURES += "pci"
```

## meta-ti-bsp/conf/machine/include/j7.inc
```bitbake
require conf/machine/include/k3.inc
SOC_FAMILY:append = ":j7"

OPTEEMACHINE = "k3-j721e"
OPTEEOUTPUTMACHINE = "k3"
```

## meta-ti-bsp/conf/machine/include/j7200.inc
```bitbake
require conf/machine/include/k3.inc
require conf/machine/include/mc_k3r5.inc

SOC_FAMILY:append = ":j7200"

TFA_BOARD = "generic"

OPTEEMACHINE = "k3-j721e"

MACHINE_ESSENTIAL_EXTRA_RRECOMMENDS += "ti-eth-fw-j7200"
```

## meta-ti-bsp/conf/machine/include/j721e.inc
```bitbake
require conf/machine/include/k3.inc
require conf/machine/include/mc_k3r5.inc

SOC_FAMILY:append = ":j721e"

MACHINE_FEATURES += "screen gpu"

require conf/machine/include/mesa-pvr.inc
PREFERRED_PROVIDER_virtual/gpudriver ?= "${BSP_ROGUE_DRIVER_PROVIDER}"

# Deploy SYSFW and any variants
IMAGE_BOOT_FILES += "sysfw.itb sysfw-*-evm.itb"

TFA_BOARD = "generic"

OPTEEMACHINE = "k3-j721e"

TI_VXE_VXD_DRIVER = "ti-vxe-vxd-driver"
TI_VXE_VXD_DRIVER:bsp-ti-6_6 = ""

MACHINE_ESSENTIAL_EXTRA_RRECOMMENDS += "cadence-mhdp-fw vxd-dec-fw ti-eth-fw-j721e ${TI_VXE_VXD_DRIVER}"
```

## meta-ti-bsp/conf/machine/include/j721s2.inc
```bitbake
require conf/machine/include/k3.inc
require conf/machine/include/mc_k3r5.inc

SOC_FAMILY:append = ":j721s2"

MACHINE_FEATURES += "screen gpu"

require conf/machine/include/mesa-pvr.inc
PREFERRED_PROVIDER_virtual/gpudriver ?= "${BSP_ROGUE_DRIVER_PROVIDER}"

TFA_BOARD = "generic"

OPTEEMACHINE = "k3-j784s4"

MACHINE_ESSENTIAL_EXTRA_RRECOMMENDS += "cadence-mhdp-fw cnm-wave-fw"
```

## meta-ti-bsp/conf/machine/include/j722s.inc
```bitbake
require conf/machine/include/k3.inc
require conf/machine/include/mc_k3r5.inc

SOC_FAMILY:append = ":j722s"

MACHINE_FEATURES += "screen gpu"

require conf/machine/include/mesa-pvr.inc
PREFERRED_PROVIDER_virtual/gpudriver ?= "${BSP_ROGUE_DRIVER_PROVIDER}"

TFA_BOARD = "lite"
TFA_K3_SYSTEM_SUSPEND = "1"

OPTEEMACHINE = "k3-am62x"

MACHINE_ESSENTIAL_EXTRA_RRECOMMENDS += "cnm-wave-fw"

SERIAL_CONSOLES = "115200;ttyS2"
```

## meta-ti-bsp/conf/machine/include/j742s2.inc
```bitbake
require conf/machine/include/k3.inc
SOC_FAMILY:append = ":j742s2"

MACHINE_FEATURES += "screen gpu"

require conf/machine/include/mesa-pvr.inc
PREFERRED_PROVIDER_virtual/gpudriver ?= "${BSP_ROGUE_DRIVER_PROVIDER}"

# Default tiboot3.bin on J742S2 is for HS-FS
TI_BOOTLOADERS += "tiboot3-j742s2-hs-fs-evm.bin"
TI_MULTICONFIGS += "j742s2-hs-fs-evm"

# Since default tiboot3.bin on J742S2 is for HS-FS, add a version for SR1.0 HS-SE
TI_BOOTLOADERS += "tiboot3-j742s2-hs-evm.bin"
TI_MULTICONFIGS += "j742s2-hs-evm"

TFA_BOARD = "j784s4"

OPTEEMACHINE = "k3-j784s4"

MACHINE_ESSENTIAL_EXTRA_RRECOMMENDS += "cadence-mhdp-fw cnm-wave-fw"
```

## meta-ti-bsp/conf/machine/include/j784s4.inc
```bitbake
require conf/machine/include/k3.inc
require conf/machine/include/mc_k3r5.inc

SOC_FAMILY:append = ":j784s4"

MACHINE_FEATURES += "screen"

require conf/machine/include/mesa-pvr.inc
PREFERRED_PROVIDER_virtual/gpudriver ?= "${BSP_ROGUE_DRIVER_PROVIDER}"

TFA_BOARD = "j784s4"

OPTEEMACHINE = "k3-j784s4"

MACHINE_ESSENTIAL_EXTRA_RRECOMMENDS += "cadence-mhdp-fw cnm-wave-fw ti-eth-fw-j784s4"

TI_CORE_INITRAMFS_KERNEL_MODULES = "kernel-module-cdns-pltfrm kernel-module-ti-j721e-ufs"
TI_CORE_INITRAMFS_KERNEL_MODULES:bsp-ti-6_6 = ""
TI_CORE_INITRAMFS_KERNEL_MODULES:bsp-ti-6_12 = ""
```

## meta-ti-bsp/conf/machine/include/k3-falcon.inc
```bitbake
# TI K3 Aarch64 profile for Cortex-A53/A72 cores

require conf/machine/include/ti-soc.inc
SOC_FAMILY:append = ":k3-falcon"

DEFAULTTUNE ?= "aarch64"
require conf/machine/include/arm/armv8a/tune-cortexa72-cortexa53.inc

require conf/machine/include/ti-bsp.inc

KERNEL_IMAGETYPE = "Image"
KERNEL_CLASSES += "kernel-fit-extra-artifacts"

UBOOT_ARCH = "arm"
UBOOT_DTB_LOADADDRESS = "0x88000000"
UBOOT_DTBO_LOADADDRESS = "0x88080000"
UBOOT_DTBO_OFFSET = "0x00010000"

SPL_BINARY = "tispl.bin"
SPL_BINARYNAME = "tispl.bin"
UBOOT_SUFFIX = "img"

FIT_KERNEL_SIGN_ENABLE = "1"
FIT_KERNEL_SIGN_KEYNAME ?= "custMpk"
FIT_KERNEL_SIGN_KEYDIR ?= "${TI_SECURE_DEV_PKG}/keys"
UBOOT_MKIMAGE_DTCOPTS = "-I dts -O dtb"
FIT_HASH_ALG ?= "sha512"
FIT_SIGN_ALG ?= "rsa4096"

TFA_PLATFORM = "k3"

# Use the expected value of the ubifs filesystem's volume name in the kernel
# and u-boot.
UBI_VOLNAME = "rootfs"

SERIAL_CONSOLES = "115200;ttyS0 115200;ttyS2"
```

## meta-ti-bsp/conf/machine/include/k3.inc
```bitbake
# TI K3 Aarch64 profile for Cortex-A53/A72 cores

require conf/machine/include/ti-soc.inc
SOC_FAMILY:append = ":k3"

DEFAULTTUNE ?= "aarch64"
require conf/machine/include/arm/armv8a/tune-cortexa72-cortexa53.inc

require conf/machine/include/ti-bsp.inc

KERNEL_IMAGETYPE = "Image"
KERNEL_CLASSES += "kernel-fit-extra-artifacts"

UBOOT_ARCH = "arm"
UBOOT_DTB_LOADADDRESS = "0x88000000"
UBOOT_DTBO_LOADADDRESS = "0x88080000"
UBOOT_DTBO_OFFSET = "0x00010000"

SPL_BINARY = "tispl.bin"
SPL_BINARYNAME = "tispl.bin"
UBOOT_SUFFIX = "img"

UBOOT_SIGN_ENABLE = "1"
UBOOT_MKIMAGE_DTCOPTS = "-I dts -O dtb"
UBOOT_SIGN_KEYNAME ?= "custMpk"
UBOOT_SIGN_KEYDIR ?= "${TI_SECURE_DEV_PKG}/keys"
FIT_HASH_ALG ?= "sha512"
FIT_SIGN_ALG ?= "rsa4096"

EXTRA_IMAGEDEPENDS += "virtual/bootloader"

MACHINE_ESSENTIAL_EXTRA_RDEPENDS += "kernel-image-image ti-kernel-fitimage"

TFA_PLATFORM = "k3"

# Use the expected value of the ubifs filesystem's volume name in the kernel
# and u-boot.
UBI_VOLNAME = "rootfs"

# List common SoC features, may need to add touchscreen for specific machines
MACHINE_FEATURES = "apm usbgadget usbhost vfat ext2 alsa pci optee-ftpm"

IMAGE_FSTYPES += "tar.xz wic.xz wic.bmap"

IMAGE_BOOT_FILES ?= "${SPL_BINARYNAME} u-boot.${UBOOT_SUFFIX} tiboot3.bin"
IMAGE_EFI_BOOT_FILES ?= "${IMAGE_BOOT_FILES}"

EFI_PROVIDER ?= "grub-efi"
MACHINE_FEATURES += "efi"

WKS_FILE ?= "${@bb.utils.contains("MACHINE_FEATURES", "efi", "sdimage-2part-efi.wks.in", "sdimage-2part.wks", d)}"

do_image_wic[depends] += "virtual/bootloader:do_deploy"

SERIAL_CONSOLES = "115200;ttyS0 115200;ttyS2"

FALCON_INCLUDE = ""
FALCON_INCLUDE:ti-falcon = "conf/machine/include/ti-falcon.inc"

require ${FALCON_INCLUDE}
```

## meta-ti-bsp/conf/machine/include/k3r5.inc
```bitbake
# TI K3 Armv7 profile for Cortex-R5F cores

require conf/machine/include/ti-soc.inc
SOC_FAMILY:append = ":k3r5"

# The closest of existing tunes for Cortex-R5F
DEFAULTTUNE = "armv7athf"
require conf/machine/include/arm/armv7a/tune-cortexa8.inc

# R5 runs early bootloader and loads SYSFW
# https://git.ti.com/cgit/ti-u-boot/ti-u-boot/tree/doc/board/ti/j721e_evm.rst
# https://git.ti.com/cgit/ti-u-boot/ti-u-boot/tree/doc/board/ti/am62x_sk.rst
# https://git.ti.com/cgit/ti-u-boot/ti-u-boot/tree/doc/board/ti/k3.rst

require conf/machine/include/ti-bsp.inc
PREFERRED_PROVIDER_virtual/kernel = "linux-dummy"

UBOOT_SUFFIX = "bin"
UBOOT_BINARY = "tiboot3.${UBOOT_SUFFIX}"

PACKAGECONFIG:pn-u-boot-ti-staging = ""
PACKAGECONFIG:pn-u-boot-ti-mainline = ""
```

## meta-ti-bsp/conf/machine/include/mc_k3-falcon.inc
```bitbake
BBMULTICONFIG += "k3-falcon"

do_image[mcdepends] += "mc::k3-falcon:virtual/bootloader:do_deploy"
```

## meta-ti-bsp/conf/machine/include/mc_k3r5-falcon.inc
```bitbake
BBMULTICONFIG += "k3r5-falcon"

do_image[mcdepends] += "mc::k3r5-falcon:virtual/bootloader:do_deploy"
```

## meta-ti-bsp/conf/machine/include/omap-a15.inc
```bitbake
require conf/machine/include/ti-soc.inc
SOC_FAMILY:append = ":omap-a15"

DEFAULTTUNE ?= "armv7athf-neon"
require conf/machine/include/arm/armv7a/tune-cortexa15.inc

require conf/machine/include/ti-bsp.inc

# Graphics providers and variables
require conf/machine/include/mesa-pvr.inc
PREFERRED_PROVIDER_virtual/gpudriver ?= "${BSP_SGX_DRIVER_PROVIDER}"
PVR_DISPLAY_CONTROLLER_ALIAS ?= "omapdrm"

KERNEL_IMAGETYPE = "zImage"
KERNEL_IMAGETYPES = "zImage uImage"
KERNEL_CLASSES += "kernel-uimage"

UBOOT_ARCH = "arm"
UBOOT_ENTRYPOINT = "0x80008000"
UBOOT_LOADADDRESS = "0x80008000"

DEVICETREE_FILE = "${@(d.getVar('KERNEL_DEVICETREE') or "").replace("ti/omap/","").replace("ti/","")}"

# Generate an extlinux.conf file
UBOOT_EXTLINUX = "1"
UBOOT_EXTLINUX_ROOT = "root=PARTUUID=${uuid}"
UBOOT_EXTLINUX_BOOT_FILES = " \
    extlinux.conf;extlinux/extlinux.conf \
    ${KERNEL_IMAGETYPE} \
    ${DEVICETREE_FILE} \
"

SPL_BINARY = "MLO"
UBOOT_SUFFIX = "img"

EXTRA_IMAGEDEPENDS += "virtual/bootloader"

MACHINE_ESSENTIAL_EXTRA_RDEPENDS += "kernel-image-zimage"

MACHINE_ESSENTIAL_EXTRA_RRECOMMENDS += "vpdma-fw goodix-fw"

# Use the expected value of the ubifs filesystem's volume name in the kernel
# and u-boot.
UBI_VOLNAME = "rootfs"

# List common SoC features, may need to add touchscreen for specific machines
MACHINE_FEATURES = "apm usbgadget usbhost vfat ext2 screen alsa gpu mmip dsp gc320"

IMAGE_FSTYPES += "tar.xz wic.xz wic.bmap"
WKS_FILE ?= "sdimage-2part.wks"
IMAGE_BOOT_FILES ?= "${SPL_BINARY} u-boot.${UBOOT_SUFFIX} ${UBOOT_EXTLINUX_BOOT_FILES} ipc/dra7-ipu1-fw.xem4;dra7-ipu1-fw.xem4"
do_image_wic[depends] += "virtual/bootloader:do_deploy"
do_image_wic[depends] += "ti-ipc-rtos:do_deploy"
```

## meta-ti-bsp/conf/machine/include/omapl138.inc
```bitbake
require conf/machine/include/ti-soc.inc
SOC_FAMILY:append = ":omapl138"

require conf/machine/include/arm/armv5/tune-arm926ejs.inc

KERNEL_IMAGETYPE = "zImage"

require conf/machine/include/ti-bsp.inc

EXTRA_IMAGEDEPENDS += "virtual/bootloader"

MACHINE_ESSENTIAL_EXTRA_RDEPENDS += "kernel-image-zimage"

MACHINE_FEATURES = "serial usbhost usbgadget alsa"
```
