## meta-ti-bsp/conf/machine/include/ti-extras.inc
```bitbake
# Add TI_EXTRAS to machine overrides so we get access to e.g. 'jailhouse'

TI_EXTRAS ??= ""
MACHINEOVERRIDES =. "${@ ':'.join('${TI_EXTRAS}'.strip().split()) + ':' if d.getVar('TI_EXTRAS') else ''}"

# Variable defaults for the various recipes that make use of TI Extras
UBOOT_TI_TEST_BUILDS_MAKE_OPTS ?= ""
```

## meta-ti-bsp/conf/machine/include/ti-falcon.inc
```bitbake
IMAGE_INSTALL:append = " u-boot-ti-staging-falcon"
KERNEL_CLASSES:remove = "kernel-fit-extra-artifacts"
MACHINE_ESSENTIAL_EXTRA_RDEPENDS:remove = "ti-kernel-fitimage"
KERNEL_CLASSES += "kernel-fitimage-legacyhs"
FIT_KERNEL_COMP_ALG = "none"
```

## meta-ti-bsp/conf/machine/include/ti-soc.inc
```bitbake
# This is a generic TI SOC family. It is a superset of all other SOCs
# and platforms defined in meta-ti to allow BSP-level overrides.
SOC_FAMILY = "ti-soc"
require conf/machine/include/soc-family.inc
require conf/machine/include/ti-extras.inc

# kernel, initrd load addresses for the fitImage in all TI platforms
UBOOT_ENTRYPOINT = "0x82000000"
UBOOT_LOADADDRESS = "0x82000000"
UBOOT_RD_LOADADDRESS = "0x84000000"
UBOOT_RD_ENTRYPOINT = "0x84000000"

# TI platforms all use devicetrees with overlays
MACHINE_ESSENTIAL_EXTRA_RDEPENDS += "kernel-devicetree"

# Tell the kernel class to install the DTBs in the same directory structure as
# the kernel
KERNEL_DTBDEST = "${KERNEL_IMAGEDEST}/dtb"
KERNEL_DTBVENDORED = "1"

# Also build a non-vendored list w/o dir structure
DEVICETREE_FILES = "${@' '.join([os.path.basename(f) for f in d.getVar("KERNEL_DEVICETREE").split()])}"

KERNEL_DEVICETREE_DTBMERGE ?= ""

# Dynamically build DTBs list based on prefix matching
CLASS_DEVICETREE_PREFIX = "${@ 'ti-devicetree-prefix' if d.getVar('KERNEL_DEVICETREE_PREFIX') else ''}"

KERNEL_CLASSES += "${CLASS_DEVICETREE_PREFIX}"
IMAGE_CLASSES += "${CLASS_DEVICETREE_PREFIX}"

BUILD_CORE_INITRAMFS_IMAGE = "ti-core-initramfs"
BUILD_CORE_INITRAMFS_IMAGE_FILE = "${BUILD_CORE_INITRAMFS_IMAGE}.cpio.xz"

BUILD_CORE_INITRAMFS_IMAGE_STEP ?= ""
BUILD_CORE_INITRAMFS_IMAGE_STEP:bsp-mainline = "${BUILD_CORE_INITRAMFS_IMAGE}:do_image_complete"
BUILD_CORE_INITRAMFS_IMAGE_STEP:bsp-next = "${BUILD_CORE_INITRAMFS_IMAGE}:do_image_complete"

do_image_wic[depends] += "${BUILD_CORE_INITRAMFS_IMAGE_STEP}"

TI_WKS_INITRAMFS ?= ""
TI_WKS_INITRAMFS:bsp-mainline = ",initrd=${BUILD_CORE_INITRAMFS_IMAGE_FILE}"
TI_WKS_INITRAMFS:bsp-next = ",initrd=${BUILD_CORE_INITRAMFS_IMAGE_FILE}"

IMAGE_BOOT_FILES:append:bsp-mainline = " ${BUILD_CORE_INITRAMFS_IMAGE_FILE}"
IMAGE_BOOT_FILES:append:bsp-next = " ${BUILD_CORE_INITRAMFS_IMAGE_FILE}"
```

## meta-ti-bsp/conf/machine/include/ti33x.inc
```bitbake
require conf/machine/include/ti-soc.inc
SOC_FAMILY:append = ":ti33x"

DEFAULTTUNE ?= "armv7athf-neon"
require conf/machine/include/arm/armv7a/tune-cortexa8.inc

require conf/machine/include/ti-bsp.inc

# Graphics providers and variables
require conf/machine/include/mesa-pvr.inc
PREFERRED_PROVIDER_virtual/gpudriver ?= "${BSP_SGX_DRIVER_PROVIDER}"
PVR_DISPLAY_CONTROLLER_ALIAS ?= "tilcdc"

KERNEL_IMAGETYPE = "zImage"

KERNEL_DEVICETREE_PREFIX = " \
    am335x \
    ti/omap/am335x \
"

KERNEL_DEVICETREE = " \
    ti/omap/am335x-baltos-ir2110.dtb \
    ti/omap/am335x-baltos-ir3220.dtb \
    ti/omap/am335x-baltos-ir5221.dtb \
    ti/omap/am335x-base0033.dtb \
    ti/omap/am335x-bone.dtb \
    ti/omap/am335x-boneblack-wireless.dtb \
    ti/omap/am335x-boneblack.dtb \
    ti/omap/am335x-boneblue.dtb \
    ti/omap/am335x-bonegreen-wireless.dtb \
    ti/omap/am335x-bonegreen.dtb \
    ti/omap/am335x-chiliboard.dtb \
    ti/omap/am335x-cm-t335.dtb \
    ti/omap/am335x-evm.dtb \
    ti/omap/am335x-evmsk.dtb \
    ti/omap/am335x-guardian.dtb \
    ti/omap/am335x-icev2.dtb \
    ti/omap/am335x-lxm.dtb \
    ti/omap/am335x-moxa-uc-2101.dtb \
    ti/omap/am335x-moxa-uc-8100-me-t.dtb \
    ti/omap/am335x-myirtech-myd.dtb \
    ti/omap/am335x-nano.dtb \
    ti/omap/am335x-netcan-plus-1xx.dtb \
    ti/omap/am335x-netcom-plus-2xx.dtb \
    ti/omap/am335x-netcom-plus-8xx.dtb \
    ti/omap/am335x-osd3358-sm-red.dtb \
    ti/omap/am335x-pdu001.dtb \
    ti/omap/am335x-pepper.dtb \
    ti/omap/am335x-phycore-rdk.dtb \
    ti/omap/am335x-pocketbeagle.dtb \
    ti/omap/am335x-regor-rdk.dtb \
    ti/omap/am335x-sancloud-bbe-extended-wifi.dtb \
    ti/omap/am335x-sancloud-bbe-lite.dtb \
    ti/omap/am335x-sancloud-bbe.dtb \
    ti/omap/am335x-sbc-t335.dtb \
    ti/omap/am335x-shc.dtb \
    ti/omap/am335x-sl50.dtb \
    ti/omap/am335x-wega-rdk.dtb \
"

UBOOT_ARCH = "arm"
UBOOT_MACHINE = "am335x_evm_config"

UBOOT_ENTRYPOINT = "0x80008000"
UBOOT_LOADADDRESS = "0x80008000"

# Generate an extlinux.conf file
UBOOT_EXTLINUX = "1"
UBOOT_EXTLINUX_ROOT = "root=PARTUUID=${uuid}"
UBOOT_EXTLINUX_KERNEL_ARGS = "rootwait rw earlycon"
UBOOT_EXTLINUX_BOOT_FILES = " \
    extlinux.conf;extlinux/extlinux.conf \
    ${KERNEL_IMAGETYPE} \
    ${DEVICETREE_FILES} \
"

SPL_BINARY = "MLO"
UBOOT_SUFFIX = "img"

# Use the expected value of the ubifs filesystem's volume name in the kernel
# and u-boot.
UBI_VOLNAME = "rootfs"

EXTRA_IMAGEDEPENDS += "virtual/bootloader"

MACHINE_ESSENTIAL_EXTRA_RDEPENDS += "kernel-image-zimage"

MACHINE_ESSENTIAL_EXTRA_RRECOMMENDS += "amx3-cm3 prueth-fw pruhsr-fw pruprp-fw"

# List common SoC features, may need to add touchscreen for specific machines
MACHINE_FEATURES = "apm usbgadget usbhost vfat ext2 alsa gpu"

IMAGE_FSTYPES += "tar.xz wic.xz wic.bmap"
WKS_FILE ?= "sdimage-2part.wks"
IMAGE_BOOT_FILES ?= "${SPL_BINARY} u-boot.${UBOOT_SUFFIX} ${UBOOT_EXTLINUX_BOOT_FILES}"
do_image_wic[depends] += "virtual/bootloader:do_deploy"
```

## meta-ti-bsp/conf/machine/include/ti43x.inc
```bitbake
require conf/machine/include/ti-soc.inc
SOC_FAMILY:append = ":ti43x"

DEFAULTTUNE ?= "armv7athf-neon"
require conf/machine/include/arm/armv7a/tune-cortexa9.inc

require conf/machine/include/ti-bsp.inc

# Graphics providers and variables
require conf/machine/include/mesa-pvr.inc
PREFERRED_PROVIDER_virtual/gpudriver ?= "${BSP_SGX_DRIVER_PROVIDER}"
PVR_DISPLAY_CONTROLLER_ALIAS ?= "omapdrm"

KERNEL_IMAGETYPE = "zImage"

KERNEL_DEVICETREE_PREFIX = " \
    am437x \
    am43x \
    ti/omap/am437x \
    ti/omap/am43x \
"

KERNEL_DEVICETREE = " \
    ti/omap/am437x-cm-t43.dtb \
    ti/omap/am437x-gp-evm.dtb \
    ti/omap/am437x-idk-evm.dtb \
    ti/omap/am437x-sbc-t43.dtb \
    ti/omap/am437x-sk-evm.dtb \
    ti/omap/am43x-epos-evm.dtb \
"

KERNEL_DEVICETREE += "${@oe.utils.conditional('ENABLE_TI_UIO_DEVICES', '1', 'am437x-idk-pru-excl-uio.dtb', '', d)}"

UBOOT_ARCH = "arm"
UBOOT_MACHINE = "am43xx_evm_config"

UBOOT_ENTRYPOINT = "0x80008000"
UBOOT_LOADADDRESS = "0x80008000"

# Generate an extlinux.conf file
UBOOT_EXTLINUX = "1"
UBOOT_EXTLINUX_ROOT = "root=PARTUUID=${uuid}"
UBOOT_EXTLINUX_BOOT_FILES = " \
    extlinux.conf;extlinux/extlinux.conf \
    ${KERNEL_IMAGETYPE} \
    ${DEVICETREE_FILES} \
"

SPL_BINARY = "MLO"
UBOOT_SUFFIX = "img"

# Use the expected value of the ubifs filesystem's volume name in the kernel
# and u-boot.
UBI_VOLNAME = "rootfs"

EXTRA_IMAGEDEPENDS += "virtual/bootloader"

MACHINE_ESSENTIAL_EXTRA_RDEPENDS += "kernel-image-zimage"

MACHINE_ESSENTIAL_EXTRA_RRECOMMENDS += "amx3-cm3 prueth-fw pruhsr-fw pruprp-fw"

# List common SoC features, may need to add touchscreen for specific machines
MACHINE_FEATURES = "apm usbgadget usbhost vfat ext2 screen alsa gpu"

IMAGE_FSTYPES += "tar.xz wic.xz wic.bmap"
WKS_FILE ?= "sdimage-2part.wks"
IMAGE_BOOT_FILES ?= "${SPL_BINARY} u-boot.${UBOOT_SUFFIX} ${UBOOT_EXTLINUX_BOOT_FILES}"
do_image_wic[depends] += "virtual/bootloader:do_deploy"
```

## meta-ti-bsp/conf/machine/j7-hs-evm.conf
```bitbake
#@TYPE: Machine
#@NAME: J7 HS EVM
#@DESCRIPTION: Machine configuration for the TI J7 HS EVM

require conf/machine/j7-evm.conf

UBOOT_MACHINE = "j721e_hs_evm_a72_defconfig"

UBOOT_ENTRYPOINT =       "0x80080000"
UBOOT_LOADADDRESS =      "0x80080000"
UBOOT_RD_LOADADDRESS =   "0x84000000"
UBOOT_RD_ENTRYPOINT =    "0x84000000"
UBOOT_DTB_LOADADDRESS =  "0x83000000"
UBOOT_DTBO_LOADADDRESS = "0x83080000"
UBOOT_DTBO_OFFSET =      "0x00010000"

SPL_BINARY = "tispl.bin_HS"
SPL_BINARYNAME = "tispl.bin"
UBOOT_BINARY = "u-boot.img_HS"
IMAGE_BOOT_FILES = "${UBOOT_BINARY}"

BBMULTICONFIG += "k3r5-sr1-1"

# Use default IMAGE_BOOT_FILES_LEGACY files
# Since default sysfw.itb on J7 is for SR1.1, add a version for SR1.0
IMAGE_BOOT_FILES += "sysfw-j721e-evm.itb"
do_image_wic[mcdepends] += "mc::k3r5-sr1-1:ti-sci-fw:do_deploy"
do_image_tar[mcdepends] += "mc::k3r5-sr1-1:ti-sci-fw:do_deploy"

TI_SECURE_DEV_PKG = "${TI_SECURE_DEV_PKG_K3}"
```

## meta-ti-bsp/conf/machine/j7200-evm-k3r5.conf
```bitbake
#@TYPE: Machine
#@NAME: J7200 EVM (R5F)
#@DESCRIPTION: Machine configuration for the TI J7200 EVM (R5F core)

require conf/machine/include/k3r5.inc

UBOOT_MACHINE = "j7200_evm_r5_defconfig"
```

## meta-ti-bsp/conf/machine/j7200-evm.conf
```bitbake
#@TYPE: Machine
#@NAME: J7200 EVM
#@DESCRIPTION: Machine configuration for the TI J7200 EVM

require conf/machine/include/j7200.inc

KERNEL_DEVICETREE_PREFIX = "ti/k3-j7200"

KERNEL_DEVICETREE_DTBMERGE = " \
    ti/k3-j7200-evm.dtb \
"

KERNEL_DEVICETREE = " \
    ti/k3-j7200-common-proc-board.dtb \
    ti/k3-j7200-evm-quad-port-eth-exp.dtbo \
"

UBOOT_MACHINE = "j7200_evm_a72_config"
```

## meta-ti-bsp/conf/machine/j7200-hs-evm-k3r5.conf
```bitbake
#@TYPE: Machine
#@NAME: J7200 HS EVM (R5F)
#@DESCRIPTION: Machine configuration for the TI J7200 HS EVM (R5F core)

require conf/machine/include/k3r5.inc

SYSFW_SOC = "j7200_sr2"
SYSFW_CONFIG = "evm"
SYSFW_SUFFIX = "hs"

UBOOT_MACHINE = "j7200_hs_evm_r5_defconfig"
```

## meta-ti-bsp/conf/machine/j7200-hs-evm.conf
```bitbake
#@TYPE: Machine
#@NAME: J7200 HS EVM
#@DESCRIPTION: Machine configuration for the TI J7200 HS EVM

require conf/machine/j7200-evm.conf

UBOOT_MACHINE = "j7200_evm_a72_defconfig"
```

## meta-ti-bsp/conf/machine/j721e-evm-k3r5.conf
```bitbake
#@TYPE: Machine
#@NAME: J721e EVM (R5F)
#@DESCRIPTION: Machine configuration for the TI J721e EVM (R5F core)

require conf/machine/include/k3r5.inc

UBOOT_MACHINE = "j721e_evm_r5_defconfig"
```

## meta-ti-bsp/conf/machine/j721e-evm.conf
```bitbake
#@TYPE: Machine
#@NAME: J721e EVM
#@DESCRIPTION: Machine configuration for the TI J721e EVM

require conf/machine/include/j721e.inc

KERNEL_DEVICETREE_PREFIX = " \
    ti/k3-j721e \
    ti/k3-fpdlink \
    ti/k3-j7200-evm-mcspi-loopback \
"

KERNEL_DEVICETREE_DTBMERGE = " \
    ti/k3-j721e-evm.dtb \
"

KERNEL_DEVICETREE = " \
    ti/k3-j721e-beagleboneai64.dtb \
    ti/k3-j721e-common-proc-board-infotainment.dtbo \
    ti/k3-j721e-common-proc-board.dtb \
    ti/k3-j721e-evm-gesi-exp-board.dtbo \
    ti/k3-j721e-evm-pcie0-ep.dtbo \
    ti/k3-j721e-evm-quad-port-eth-exp.dtbo \
    ti/k3-j721e-sk-csi2-dual-imx219.dtbo \
    ti/k3-j721e-sk.dtb \
"

UBOOT_MACHINE = "j721e_evm_a72_config"
```

## meta-ti-bsp/conf/machine/j721e-hs-evm-k3r5.conf
```bitbake
#@TYPE: Machine
#@NAME: J721e HS EVM (R5F)
#@DESCRIPTION: Machine configuration for the TI J721e HS EVM (R5F core)

require conf/machine/include/k3r5.inc

SYSFW_SOC = "j721e_sr1_1"
SYSFW_CONFIG = "evm"
SYSFW_SUFFIX = "hs"

UBOOT_MACHINE = "j721e_evm_r5_defconfig"
```

## meta-ti-bsp/conf/machine/j721e-hs-evm.conf
```bitbake
#@TYPE: Machine
#@NAME: J721e HS EVM
#@DESCRIPTION: Machine configuration for the TI J721e HS EVM

require conf/machine/j721e-evm.conf

UBOOT_MACHINE = "j721e_evm_a72_defconfig"
```

## meta-ti-bsp/conf/machine/j721e-sk-k3r5.conf
```bitbake
#@TYPE: Machine
#@NAME: J721e SK (R5F)
#@DESCRIPTION: Machine configuration for the TI J721e SK (R5F core)

require conf/machine/include/k3r5.inc

UBOOT_MACHINE = "j721e_sk_r5_defconfig"
```

## meta-ti-bsp/conf/machine/j721e-sk.conf
```bitbake
#@TYPE: Machine
#@NAME: J721e SK
#@DESCRIPTION: Machine configuration for the TI J721e SK

require conf/machine/include/j721e.inc

KERNEL_DEVICETREE_PREFIX = " \
    ti/k3-j721e-sk \
    ti/k3-fpdlink \
"

KERNEL_DEVICETREE = " \
    ti/k3-j721e-sk-csi2-dual-imx219.dtbo \
    ti/k3-j721e-sk.dtb \
"

UBOOT_MACHINE = "j721e_sk_a72_config"
```

## meta-ti-bsp/conf/machine/j721s2-evm-k3r5.conf
```bitbake
#@TYPE: Machine
#@NAME: J721S2 EVM (R5F)
#@DESCRIPTION: Machine configuration for the TI J721S2 EVM (R5F core)

require conf/machine/include/k3r5.inc

UBOOT_MACHINE = "j721s2_evm_r5_defconfig"
```

## meta-ti-bsp/conf/machine/j721s2-evm.conf
```bitbake
#@TYPE: Machine
#@NAME: J721S2 EVM
#@DESCRIPTION: Machine configuration for the TI J721S2 EVM

require conf/machine/include/j721s2.inc

TFA_K3_USART = "0x8"
OPTEE_K3_USART = "0x8"

KERNEL_DEVICETREE_PREFIX = " \
    ti/k3-j721s2 \
    ti/k3-fpdlink \
    ti/k3-j7200-evm-mcspi-loopback \
    ti/k3-am68-sk \
    ti/k3-v3link \
"

KERNEL_DEVICETREE_DTBMERGE = " \
    ti/k3-j721s2-evm.dtb \
"

KERNEL_DEVICETREE = " \
    ti/k3-am68-sk-base-board.dtb \
    ti/k3-j721s2-common-proc-board.dtb \
    ti/k3-j721s2-evm-gesi-exp-board.dtbo \
    ti/k3-j721s2-evm-pcie1-ep.dtbo \
"

UBOOT_MACHINE = "j721s2_evm_a72_defconfig"
```

## meta-ti-bsp/conf/machine/j721s2-hs-evm-k3r5.conf
```bitbake
#@TYPE: Machine
#@NAME: J721S2 HS EVM (R5F)
#@DESCRIPTION: Machine configuration for the TI J721S2 HS EVM (R5F core)

require conf/machine/include/k3r5.inc

SYSFW_SOC = "j721s2"
SYSFW_CONFIG = "evm"
SYSFW_SUFFIX = "hs"

UBOOT_MACHINE = "j721s2_hs_evm_r5_defconfig"
```

## meta-ti-bsp/conf/machine/j721s2-hs-evm.conf
```bitbake
#@TYPE: Machine
#@NAME: J721S2 HS EVM
#@DESCRIPTION: Machine configuration for the TI J721S2 HS EVM

require conf/machine/j721s2-evm.conf
```

## meta-ti-bsp/conf/machine/j722s-evm-k3r5.conf
```bitbake
#@TYPE: Machine
#@NAME: J722S EVM (R5F)
#@DESCRIPTION: Machine configuration for the TI J722S EVM (R5F core)

require conf/machine/include/k3r5.inc

UBOOT_MACHINE = "j722s_evm_r5_defconfig"
UBOOT_MACHINE:tie-test-builds = ""

UBOOT_CONFIG = "main"
UBOOT_CONFIG:prepend:tie-test-builds = "usbdfu "
UBOOT_CONFIG[main] = "j722s_evm_r5_defconfig"
UBOOT_CONFIG[usbdfu] = "j722s_evm_r5_defconfig"

UBOOT_CONFIG_FRAGMENTS[usbdfu] = "am62x_r5_usbdfu.config"
```

## meta-ti-bsp/conf/machine/j722s-evm.conf
```bitbake
#@TYPE: Machine
#@NAME: J722S EVM
#@DESCRIPTION: Machine configuration for the TI J722S EVM

require conf/machine/include/j722s.inc

KERNEL_DEVICETREE_PREFIX = " \
    ti/k3-j722s \
    ti/k3-fpdlink \
    ti/k3-am62x-sk-mcspi-loopback \
    ti/k3-v3link \
"

KERNEL_DEVICETREE = " \
    ti/k3-j722s-evm.dtb \
"

UBOOT_MACHINE = "j722s_evm_a53_defconfig"
```

## meta-ti-bsp/conf/machine/j742s2-evm-k3r5.conf
```bitbake
#@TYPE: Machine
#@NAME: J742S2 EVM (R5F)
#@DESCRIPTION: Machine configuration for the TI J742S2 EVM (R5F core)

require conf/machine/include/k3r5.inc

UBOOT_MACHINE = "j742s2_evm_r5_defconfig"
```

## meta-ti-bsp/conf/machine/j742s2-evm.conf
```bitbake
#@TYPE: Machine
#@NAME: J742S2 EVM
#@DESCRIPTION: Machine configuration for the TI J742S2 EVM

require conf/machine/include/j742s2.inc

TFA_K3_USART = "0x8"
OPTEE_K3_USART = "0x8"

KERNEL_DEVICETREE_PREFIX = " \
    ti/k3-j742s2 \
    ti/k3-j784s4 \
    ti/k3-fpdlink \
    ti/k3-j7200-evm-mcspi-loopback \
    ti/k3-j721s2-evm-csi2-ov5640 \
    ti/k3-j721s2-evm-fusion \
    ti/k3-v3link \
"

KERNEL_DEVICETREE = ""

UBOOT_MACHINE = "j742s2_evm_a72_defconfig"
```

## meta-ti-bsp/conf/machine/j784s4-evm-k3r5.conf
```bitbake
#@TYPE: Machine
#@NAME: J784S4 EVM (R5F)
#@DESCRIPTION: Machine configuration for the TI J784S4 EVM (R5F core)

require conf/machine/include/k3r5.inc

UBOOT_MACHINE = "j784s4_evm_r5_defconfig"
```
