## meta-ti-bsp/conf/machine/j784s4-evm.conf
```bitbake
#@TYPE: Machine
#@NAME: J784S4 EVM
#@DESCRIPTION: Machine configuration for the TI J784S4 EVM

require conf/machine/include/j784s4.inc

TFA_K3_USART = "0x8"
OPTEE_K3_USART = "0x8"

KERNEL_DEVICETREE_PREFIX = " \
    ti/k3-j784s4 \
    ti/k3-fpdlink \
    ti/k3-j7200-evm-mcspi-loopback \
    ti/k3-j721s2-evm-csi2-ov5640 \
    ti/k3-j721s2-evm-fusion \
    ti/k3-j721s2-evm-ub954 \
    ti/k3-am69-sk \
    ti/k3-v3link \
"

KERNEL_DEVICETREE = " \
    ti/k3-am69-sk.dtb \
    ti/k3-j784s4-evm-pcie0-pcie1-ep.dtbo \
    ti/k3-j784s4-evm-quad-port-eth-exp1.dtbo \
    ti/k3-j784s4-evm-usxgmii-exp1-exp2.dtbo \
    ti/k3-j784s4-evm.dtb \
"

UBOOT_MACHINE = "j784s4_evm_a72_defconfig"
```

## meta-ti-bsp/conf/machine/j784s4-hs-evm.conf
```bitbake
#@TYPE: Machine
#@NAME: J784S4 HS EVM
#@DESCRIPTION: Machine configuration for the TI J784S4 HS EVM

require conf/machine/j784s4-evm.conf
```

## meta-ti-bsp/conf/machine/omapl138-lcdk.conf
```bitbake
#@TYPE: Machine
#@NAME: OMAP-L138 LCDK
#@DESCRIPTION: Machine configuration for the TI OMAP-L138 LCDK board

require conf/machine/include/omapl138.inc

UBOOT_MACHINE = "omapl138_lcdk_config"
UBOOT_SUFFIX = "ais"
SPL_BINARY = ""

UBOOT_ENTRYPOINT = "0xc0008000"
UBOOT_LOADADDRESS = "0xc0008000"

IMAGE_FSTYPES += "tar.xz"

SERIAL_CONSOLES = "115200;ttyS2"

KERNEL_DEVICETREE_PREFIX = " \
    da850 \
    ti/davinci/da850 \
"

KERNEL_DEVICETREE = " \
    ti/davinci/da850-evm.dtb \
    ti/davinci/da850-lcdk.dtb \
"
```

## meta-ti-bsp/files/wic/sdimage-2part.wks
```
# short-description: Create SD card image with 2 partitions
# long-description: Creates a partitioned SD card image for TI platforms.
# Boot files are located in the first vfat partition with extra reserved space.

part --source bootimg-partition --fstype=vfat --label boot --active --align 1024 --use-uuid --fixed-size 128M
part / --source rootfs --fstype=ext4 --label root --align 1024 --use-uuid
```

## meta-ti-bsp/wic/sdimage-2part-efi.wks
```
# short-description: Create SD card image with 2 partitions and EFI support
# long-description: Creates a partitioned SD card image for TI platforms that
# supports EFI.  Boot files are located in the first vfat partition with extra
# reserved space.  We cannot use a GPT here.
bootloader --append="rootfstype=ext4 ro"
part /boot --source bootimg-efi --sourceparams="loader=grub-efi" --fstype=vfat --label boot --active --align 1024 --use-uuid --fixed-size 128M
part / --source rootfs --fstype=ext4 --label root --align 1024 --use-uuid
```

## meta-ti-extras/conf/layer.conf
```bitbake
# We have a conf and classes directory, append to BBPATH
BBPATH .= ":${LAYERDIR}"
METATIBASE := '${@os.path.normpath("${LAYERDIR}/")}'

# We have a recipes directory, add to BBFILES
BBFILES += "${LAYERDIR}/recipes*/*/*.bb ${LAYERDIR}/recipes*/*/*.bbappend"

BBFILE_COLLECTIONS += "meta-ti-extras"
BBFILE_PATTERN_meta-ti-extras := "^${LAYERDIR}/"
BBFILE_PRIORITY_meta-ti-extras = "6"

LAYERSERIES_COMPAT_meta-ti-extras = "whinlatter"

LICENSE_PATH += "${LAYERDIR}/licenses"

LAYERDEPENDS_meta-ti-extras = " \
    meta-ti-bsp \
"
```

## meta-ti-test/conf/layer.conf
```bitbake
# We have a conf and classes directory, append to BBPATH
BBPATH .= ":${LAYERDIR}"

# We have a recipes directory, add to BBFILES
BBFILES += "${LAYERDIR}/recipes*/*/*.bb ${LAYERDIR}/recipes*/*/*.bbappend"

BBFILE_COLLECTIONS += "meta-ti-test"
BBFILE_PATTERN_meta-ti-test := "^${LAYERDIR}/"
BBFILE_PRIORITY_meta-ti-test = "10"

LAYERSERIES_COMPAT_meta-ti-test = "whinlatter wrynose"

# Set a variable to get to the top of the metadata location
TITESTBASE := '${@os.path.normpath("${LAYERDIR}/")}'

LICENSE_PATH += "${LAYERDIR}/licenses"

LAYERDEPENDS_meta-ti-test = " \
    core \
    openembedded-layer \
    networking-layer \
    filesystems-layer \
    meta-python \
"

BBFILES_DYNAMIC += " \
"

# Codecs in ffmpeg with questionable patent status are not included by
# default.  As this entire layer is purely optional for testing purposes only
# and not meant to be shipped, add support for the ffmpeg commercial license.
LICENSE_FLAGS_ACCEPTED:append:ti-soc = " commercial_ffmpeg"
```
