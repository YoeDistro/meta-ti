## meta-ti-bsp/conf/machine/am64xx-evm.conf
```bitbake
#@TYPE: Machine
#@NAME: AM64xx EVM
#@DESCRIPTION: Machine configuration for the TI AM64xx EVM

require conf/machine/include/am64xx.inc

UBOOT_ECDSA_SIGN_CONFIG ?= "ecdsa"
UBOOT_ECDSA_SIGN_CONFIG:bsp-ti-6_6 = ""
UBOOT_ECDSA_SIGN_CONFIG:bsp-next = ""
UBOOT_ECDSA_SIGN_CONFIG:bsp-mainline = ""

ECDSA_BOOT_FILES ?= "tiboot3.bin-ecdsa tiboot3-*-evm.bin-ecdsa tispl.bin-ecdsa u-boot.img-ecdsa"
ECDSA_BOOT_FILES:bsp-ti-6_6 = ""
ECDSA_BOOT_FILES:bsp-next = ""
ECDSA_BOOT_FILES:bsp-mainline = ""

UBOOT_MACHINE = ""
UBOOT_CONFIG = "${UBOOT_ECDSA_SIGN_CONFIG} main"
UBOOT_CONFIG[main] = "am64x_evm_a53_defconfig"
UBOOT_CONFIG[ecdsa] = "am64x_evm_a53_defconfig"

UBOOT_CONFIG_MAKE_OPTS[ecdsa] = "${TI_SIGN_WITH_ECDSA_KEY}"

IMAGE_BOOT_FILES += "${ECDSA_BOOT_FILES}"
```

## meta-ti-bsp/conf/machine/am64xx-hs-evm-k3r5.conf
```bitbake
#@TYPE: Machine
#@NAME: AM64xx HS EVM (R5F)
#@DESCRIPTION: Machine configuration for the TI AM64xx HS EVM (R5F core)

require conf/machine/include/k3r5.inc

SYSFW_SOC = "am64x"
SYSFW_CONFIG = "evm"
SYSFW_SUFFIX = "hs"
SYSFW_SYMLINK = ""

UBOOT_MACHINE = "am64x_hs_evm_r5_defconfig"

TI_SECURE_DEV_PKG = "${TI_SECURE_DEV_PKG_K3}"
```

## meta-ti-bsp/conf/machine/am64xx-hs-evm.conf
```bitbake
#@TYPE: Machine
#@NAME: AM64xx HS EVM
#@DESCRIPTION: Machine configuration for the TI AM64xx HS EVM

require conf/machine/include/am64xx.inc

UBOOT_MACHINE = "am64x_evm_a53_defconfig"

UBOOT_ENTRYPOINT =       "0x80080000"
UBOOT_LOADADDRESS =      "0x80080000"
UBOOT_RD_LOADADDRESS =   "0x84000000"
UBOOT_RD_ENTRYPOINT =    "0x84000000"
UBOOT_DTB_LOADADDRESS =  "0x83000000"
UBOOT_DTBO_LOADADDRESS = "0x83080000"
UBOOT_DTBO_OFFSET =      "0x00010000"

SPL_BINARY = "tispl.bin_HS"
UBOOT_BINARY = "u-boot.img_HS"
UBOOT_SYMLINK = "u-boot.img"

# Since default tiboot3.bin on AM64x is for HS, add a version for GP
BBMULTICONFIG += "k3r5-gp"
IMAGE_BOOT_FILES += " tiboot3-am64x-gp-evm.bin"
do_image_wic[mcdepends] += "mc::k3r5-gp:ti-sci-fw:do_deploy"
do_image_tar[mcdepends] += "mc::k3r5-gp:ti-sci-fw:do_deploy"
```

## meta-ti-bsp/conf/machine/am65xx-evm-k3r5.conf
```bitbake
#@TYPE: Machine
#@NAME: AM65xx EVM (R5F)
#@DESCRIPTION: Machine configuration for the TI AM65xx EVM (R5F core)

require conf/machine/include/k3r5.inc

UBOOT_MACHINE = "am65x_evm_r5_defconfig"
UBOOT_MACHINE:tie-test-builds = ""

UBOOT_CONFIG = ""
UBOOT_CONFIG:prepend:tie-test-builds = "usbdfu main"
UBOOT_CONFIG[main] = "am62x_evm_r5_defconfig"
UBOOT_CONFIG[usbdfu] = "am65x_evm_r5_usbdfu_defconfig"
```

## meta-ti-bsp/conf/machine/am65xx-evm.conf
```bitbake
#@TYPE: Machine
#@NAME: AM65xx EVM
#@DESCRIPTION: Machine configuration for the TI AM65xx EVM

require conf/machine/include/am65xx.inc

UBOOT_MACHINE = "am65x_evm_a53_defconfig"

MACHINE_ESSENTIAL_EXTRA_RRECOMMENDS += "prueth-fw pruhsr-fw prusw-fw"
```

## meta-ti-bsp/conf/machine/am65xx-hs-evm-k3r5.conf
```bitbake
#@TYPE: Machine
#@NAME: AM65xx HS EVM (R5F)
#@DESCRIPTION: Machine configuration for the TI AM65xx HS EVM (R5F core)

require conf/machine/include/k3r5.inc

SYSFW_SOC = "am65x_sr2"
SYSFW_CONFIG = "evm"
SYSFW_SUFFIX = "hs"

UBOOT_MACHINE = "am65x_evm_r5_defconfig"
```

## meta-ti-bsp/conf/machine/am65xx-hs-evm.conf
```bitbake
#@TYPE: Machine
#@NAME: AM65xx HS EVM
#@DESCRIPTION: Machine configuration for the TI AM65xx HS EVM

require conf/machine/include/am65xx.inc

UBOOT_MACHINE = "am65x_evm_a53_defconfig"
```

## meta-ti-bsp/conf/machine/am68-sk-k3r5.conf
```bitbake
#@TYPE: Machine
#@NAME: AM68 SK (R5F)
#@DESCRIPTION: Machine configuration for the TI AM68 SK (R5F core)

require conf/machine/include/k3r5.inc

UBOOT_MACHINE = "am68_sk_r5_defconfig"
```

## meta-ti-bsp/conf/machine/am68-sk.conf
```bitbake
#@TYPE: Machine
#@NAME: AM68 SK
#@DESCRIPTION: Machine configuration for the TI AM68 SK

require conf/machine/include/am68.inc

TFA_K3_USART = "0x8"
OPTEE_K3_USART = "0x8"

KERNEL_DEVICETREE_PREFIX = " \
    ti/k3-am68-sk \
    ti/k3-fpdlink \
    ti/k3-v3link \
    ti/k3-j721e-sk-csi2-dual-imx219 \
    ti/k3-j721e-sk-fpdlink-fusion \
"

KERNEL_DEVICETREE = " \
    ti/k3-am68-sk-base-board.dtb \
    ti/k3-j721e-sk-csi2-dual-imx219.dtbo \
"

UBOOT_MACHINE = "am68_sk_a72_defconfig"
```

## meta-ti-bsp/conf/machine/am69-sk-k3r5.conf
```bitbake
#@TYPE: Machine
#@NAME: AM69 SK (R5F)
#@DESCRIPTION: Machine configuration for the TI AM69 SK (R5F core)

require conf/machine/include/k3r5.inc

UBOOT_MACHINE = "am69_sk_r5_defconfig"
```

## meta-ti-bsp/conf/machine/am69-sk.conf
```bitbake
#@TYPE: Machine
#@NAME: AM69 SK
#@DESCRIPTION: Machine configuration for the TI AM69 SK

require conf/machine/include/am69.inc

TFA_K3_USART = "0x8"
OPTEE_K3_USART = "0x8"

KERNEL_DEVICETREE_PREFIX = " \
    ti/k3-am69-sk \
    ti/k3-fpdlink \
    ti/k3-v3link \
    ti/k3-am68-sk-v3link-fusion \
    ti/k3-j721e-sk-csi2-dual-imx219 \
    ti/k3-j721e-sk-fpdlink-fusion \
"

KERNEL_DEVICETREE = " \
    ti/k3-am69-sk.dtb \
    ti/k3-j721e-sk-csi2-dual-imx219.dtbo \
"

UBOOT_MACHINE = "am69_sk_a72_defconfig"
```

## meta-ti-bsp/conf/machine/beagle-x15.conf
```bitbake
#@TYPE: Machine
#@NAME: BeagleBoard X15
#@DESCRIPTION: Machine configuration for the BeagleBoard X15

require conf/machine/include/am57xx.inc

PREFERRED_PROVIDER_virtual/kernel = "linux-bb.org"

KERNEL_DEVICETREE_PREFIX = "am57xx-beagle-x15"

KERNEL_DEVICETREE = " \
am57xx-beagle-x15.dtb \
am57xx-beagle-x15-revb1.dtb \
am57xx-beagle-x15-revc.dtb \
am57xx-idk-lcd-osd101t2045.dtbo \
am57xx-idk-lcd-osd101t2587.dtbo \
"

MACHINE_GUI_CLASS = "bigscreen"

SERIAL_CONSOLES = "115200;ttyS2"

UBOOT_MACHINE = "am57xx_evm_config"
```

## meta-ti-bsp/conf/machine/beaglebone-ai64-k3r5.conf
```bitbake
#@TYPE: Machine
#@NAME: BeagleBone AI-64 (R5F)
#@DESCRIPTION: Machine configuration for the BeagleBone AI-64 (R5F core)

require conf/machine/include/k3r5.inc

SYSFW_SOC = "j721e"
SYSFW_CONFIG = "evm"
SYSFW_SUFFIX = "gp"

SPL_BINARY = "spl/u-boot-spl.${UBOOT_SUFFIX}"
SPL_SYMLINK = "u-boot-r5spl.${UBOOT_SUFFIX}"
UBOOT_BINARY = "tiboot3.${UBOOT_SUFFIX}"
UBOOT_IMAGE = "tiboot3-${MAINMACHINE}-${PV}-${PR}.${UBOOT_SUFFIX}"
UBOOT_SYMLINK = "tiboot3-${MAINMACHINE}.${UBOOT_SUFFIX}"

UBOOT_MACHINE = "j721e_evm_r5_defconfig"


# UBOOT_CONFIG_FRAGMENTS holds the list of u-boot config fragments which has to be build
# along with the base defconfig mentioned in UBOOT_MACHINE. Refer u-boot-mergeconfig.inc
# under meta-ti-bsp/recipes-bsp/u-boot/ for more details.
UBOOT_CONFIG_FRAGMENTS = "j721e_beagleboneai64_r5.config"
```

## meta-ti-bsp/conf/machine/beaglebone-ai64.conf
```bitbake
#@TYPE: Machine
#@NAME: BeagleBone AI-64 (A72)
#@DESCRIPTION: Machine configuration for the BeagleBone AI-64 board (A72 core)

TI_PREFERRED_BSP ?= "bb_org"

require conf/machine/include/j721e.inc

IMAGE_SR1_1_HS_FS_FILES:bsp-bb_org = ""
IMAGE_SR2_HS_SE_FILES:bsp-bb_org = ""

UBOOT_MACHINE = "j721e_evm_a72_config"
UBOOT_MACHINE:bsp-ti-6_6 = "j721e_beagleboneai64_a72_defconfig"

UBOOT_FRAGMENTS:bsp-ti-6_1 = "j721e_beagleboneai64_a72.config"
UBOOT_FRAGMENTS:bsp-bb_org = "j721e_beagleboneai64_a72.config"

SPL_BINARY:bsp-ti-6_6 = "tispl.bin_unsigned"
SPL_BINARYNAME:bsp-ti-6_6 = "tispl.bin"

KERNEL_DEVICETREE_PREFIX = " \
    ti/k3-j721e \
"

KERNEL_DEVICETREE = " \
ti/k3-j721e-beagleboneai64.dtb \
ti/k3-j721e-common-proc-board.dtb \
ti/k3-j721e-evm-gesi-exp-board.dtbo \
ti/k3-j721e-evm-quad-port-eth-exp.dtbo \
ti/k3-j721e-sk.dtb \
"

KERNEL_DEVICETREE:append:bsp-bb_org = " \
ti/k3-j721e-beagleboneai64-dsi-rpi-7inch-panel.dtbo \
ti/k3-j721e-common-proc-board-infotainment.dtbo \
ti/k3-j721e-evm-csi2-ov5640.dtbo \
ti/k3-j721e-evm-fusion.dtbo \
ti/k3-j721e-evm-pcie0-ep.dtbo \
ti/k3-j721e-evm-virt-mac-client.dtbo \
ti/k3-j721e-sk-csi2-ov5640.dtbo \
ti/k3-j721e-sk-csi2-rpi-imx219.dtbo \
ti/k3-j721e-sk-fusion.dtbo \
ti/k3-j721e-sk-rpi-hdr-ehrpwm.dtbo \
"

MACHINE_GUI_CLASS = "bigscreen"
```

## meta-ti-bsp/conf/machine/beaglebone.conf
```bitbake
#@TYPE: Machine
#@NAME: BeagleBone machine
#@DESCRIPTION: Machine configuration for the http://beagleboard.org/bone board

require conf/machine/include/ti33x.inc

PREFERRED_PROVIDER_virtual/kernel = "linux-bb.org"

KERNEL_DEVICETREE_PREFIX = "am335x-bone"

KERNEL_DEVICETREE = " \
am335x-bone.dtb \
am335x-boneblack.dtb \
am335x-boneblack-pps.dtb \
am335x-boneblack-uboot.dtb \
am335x-boneblack-uboot-univ.dtb \
am335x-boneblack-wireless.dtb \
am335x-boneblue.dtb \
am335x-bonegreen.dtb \
am335x-bonegreen-gateway.dtb \
am335x-bonegreen-wireless.dtb \
am335x-bonegreen-wireless-uboot-univ.dtb \
am335x-pocketbeagle.dtb \
am335x-sancloud-bbe.dtb \
am335x-sancloud-bbe-extended-wifi.dtb \
am335x-sancloud-bbe-lite.dtb \
"

# Extra DT overlays/capes
KERNEL_DEVICETREE += " \
AM335X-PRU-UIO-00A0.dtbo \
BB-ADC-00A0.dtbo \
BB-BBBW-WL1835-00A0.dtbo \
BB-BBGG-WL1835-00A0.dtbo \
BB-BBGW-WL1835-00A0.dtbo \
BB-BONE-4D5R-01-00A1.dtbo \
BB-BONE-eMMC1-01-00A0.dtbo \
BB-BONE-LCD4-01-00A1.dtbo \
BB-BONE-NH7C-01-A0.dtbo \
BB-CAPE-DISP-CT4-00A0.dtbo \
BB-HDMI-TDA998x-00A0.dtbo \
BB-I2C1-MCP7940X-00A0.dtbo \
BB-I2C1-RTC-DS3231.dtbo \
BB-I2C1-RTC-PCF8563.dtbo \
BB-I2C2-BME680.dtbo \
BB-I2C2-MPU6050.dtbo \
BB-LCD-ADAFRUIT-24-SPI1-00A0.dtbo \
BB-NHDMI-TDA998x-00A0.dtbo \
BBORG_COMMS-00A2.dtbo \
BBORG_FAN-A000.dtbo \
BBORG_RELAY-00A2.dtbo \
BB-SPIDEV0-00A0.dtbo \
BB-SPIDEV1-00A0.dtbo \
BB-UART1-00A0.dtbo \
BB-UART2-00A0.dtbo \
BB-UART4-00A0.dtbo \
BB-W1-P9.12-00A0.dtbo \
BONE-ADC.dtbo \
M-BB-BBG-00A0.dtbo \
M-BB-BBGG-00A0.dtbo \
PB-MIKROBUS-0.dtbo \
PB-MIKROBUS-1.dtbo \
"

MACHINE_GUI_CLASS = "bigscreen"
MACHINE_FEATURES += "screen"

SERIAL_CONSOLES = "115200;ttyS0"
```

## meta-ti-bsp/conf/machine/beagleplay-k3r5.conf
```bitbake
#@TYPE: Machine
#@NAME: BeaglePlay (R5F)
#@DESCRIPTION: Machine configuration for the BeaglePlay (R5F core)

require conf/machine/include/k3r5.inc

SYSFW_SOC = "am62x"
SYSFW_CONFIG = "evm"
SYSFW_SUFFIX = "gp"

UBOOT_MACHINE = "am62x_evm_r5_defconfig"

# UBOOT_CONFIG_FRAGMENTS holds the list of u-boot config fragments which has to be build
# along with the base defconfig mentioned in UBOOT_MACHINE. Refer u-boot-mergeconfig.inc
# under meta-ti-bsp/recipes-bsp/u-boot/ for more details.
UBOOT_CONFIG_FRAGMENTS = "am625_beagleplay_r5.config"
```

## meta-ti-bsp/conf/machine/beagleplay-ti-k3r5.conf
```bitbake
#@TYPE: Machine
#@NAME: BeaglePlay (R5F)
#@DESCRIPTION: Machine configuration for the BeaglePlay (R5F core)

require conf/machine/include/k3r5.inc

UBOOT_MACHINE = "am62x_beagleplay_r5_defconfig"
```

## meta-ti-bsp/conf/machine/beagleplay.conf
```bitbake
#@TYPE: Machine
#@NAME: BeaglePlay (A53)
#@DESCRIPTION: Machine configuration for the BeaglePlay board (A53 core)

require conf/machine//include/beagle.inc
require conf/machine/include/k3.inc
SOC_FAMILY:append = ":am62xx"

MACHINE_FEATURES += "screen gpu"

SERIAL_CONSOLES = "115200;ttyS2"

require conf/machine/include/mesa-pvr.inc
PREFERRED_PROVIDER_virtual/gpudriver ?= "ti-img-rogue-driver"

TFA_BOARD = "lite"
TFA_K3_SYSTEM_SUSPEND = "1"

OPTEEMACHINE = "k3-am62x"

UBOOT_MACHINE = "am62x_evm_a53_defconfig"

# UBOOT_CONFIG_FRAGMENTS holds the list of u-boot config fragments which has to be build
# along with the base defconfig mentioned in UBOOT_MACHINE. Refer u-boot-mergeconfig.inc
# under meta-ti-bsp/recipes-bsp/u-boot/ for more details.
UBOOT_CONFIG_FRAGMENTS = "am625_beagleplay_a53.config"

PREFERRED_PROVIDER_virtual/bootloader = "u-boot-bb.org"
PREFERRED_PROVIDER_u-boot = "u-boot-bb.org"

KERNEL_DEVICETREE_PREFIX = " \
    ti/k3-am625 \
    ti/k3-am62x-sk \
"

KERNEL_DEVICETREE = " \
ti/k3-am625-beagleplay.dtb \
ti/k3-am625-sk.dtb \
ti/k3-am62x-sk-hdmi-audio.dtbo \
"

MACHINE_GUI_CLASS = "bigscreen"
```

## meta-ti-bsp/conf/machine/dra7xx-evm.conf
```bitbake
#@TYPE: Machine
#@NAME: DRA7xx EVM
#@DESCRIPTION: Machine configuration for the TI DRA7xx EVM

require conf/machine/include/dra7xx.inc

MACHINE_FEATURES += "touchscreen"

SERIAL_CONSOLES = "115200;ttyS0"

KERNEL_DEVICETREE_PREFIX = " \
    dra7 \
    ti/dra7 \
    ti/lcd \
    ti/omap/dra7 \
"

KERNEL_DEVICETREE = " \
    dra7-evm.dtb \
    dra71-evm.dtb \
    dra72-evm.dtb \
    dra72-evm-revc.dtb \
    dra76-evm.dtb \
"

UBOOT_MACHINE = "dra7xx_evm_config"

# UBI information.  Note that this is board and kernel specific.  Changes
# in your kernel port may require changes in these variables.  For more
# details about this board please see
# http://processors.wiki.ti.com/index.php/UBIFS_Support

# do ubiattach /dev/ubi_ctrl -m 7 -O 2048
# From dmesg:
# UBI: smallest flash I/O unit:    2048
# UBI: logical eraseblock size:    126976 bytes
# from ubiattach stdout:
# UBI device number 0, total 1988 LEBs
MKUBIFS_ARGS = "-F -m 2048 -e 126976 -c 8192"

# do ubiattach /dev/ubi_ctrl -m 7 -O 2048
# from dmesg:
# UBI: smallest flash I/O unit:    2048
# UBI: physical eraseblock size:   131072 bytes (128 KiB)
# UBI: sub-page size:              512
# UBI: VID header offset:          2048 (aligned 2048)
UBINIZE_ARGS = "-m 2048 -p 128KiB -s 512 -O 2048"
```

## meta-ti-bsp/conf/machine/dra7xx-hs-evm.conf
```bitbake
#@TYPE: Machine
#@NAME: DRA7xx HS EVM
#@DESCRIPTION: Machine configuration for the TI DRA7xx HS EVM

require conf/machine/dra7xx-evm.conf

UBOOT_MACHINE = "dra7xx_hs_evm_config"

OPTEEMACHINE = "ti-dra7xx"
OPTEEFLAVOR = "dra7xx"
OPTEEPAGER = "y"

EXTRA_IMAGEDEPENDS += "optee-os"

# FIT image for legacy secure devices
KERNEL_CLASSES += " kernel-fitimage-legacyhs"
KERNEL_IMAGETYPES += " fitImage"

# FIT image settings
FITIMAGE_HASH_ALGO = ""
FITIMAGE_PACK_TEE = "1"
FITIMAGE_DTB_BY_NAME = "1"
FITIMAGE_TEE_BY_NAME = "1"
FITIMAGE_CONF_BY_NAME = "1"
```

## meta-ti-bsp/conf/machine/include/am57xx.inc
```bitbake
require conf/machine/include/ti-soc.inc
SOC_FAMILY:append = ":am57xx"

DEFAULTTUNE ?= "armv7athf-neon"
require conf/machine/include/arm/armv7a/tune-cortexa15.inc

require conf/machine/include/ti-bsp.inc

# Graphics providers and variables
require conf/machine/include/mesa-pvr.inc
PREFERRED_PROVIDER_virtual/gpudriver ?= "${BSP_SGX_DRIVER_PROVIDER}"

KERNEL_IMAGETYPE = "zImage"
KERNEL_IMAGETYPES = "zImage uImage"
KERNEL_CLASSES += "kernel-uimage"

UBOOT_ARCH = "arm"
UBOOT_ENTRYPOINT = "0x80008000"
UBOOT_LOADADDRESS = "0x80008000"

# Generate an extlinux.conf file
UBOOT_EXTLINUX = "1"
UBOOT_EXTLINUX_ROOT = "root=PARTUUID=${uuid}"
UBOOT_EXTLINUX_BOOT_FILES = " \
    extlinux.conf;extlinux/extlinux.conf \
    ${KERNEL_IMAGETYPE} \
    ${DEVICETREE_FILES} \
"

SPL_BINARY = "MLO"
UBOOT_SUFFIX = "img"

EXTRA_IMAGEDEPENDS += "virtual/bootloader"

MACHINE_ESSENTIAL_EXTRA_RDEPENDS += "kernel-image-zimage"

MACHINE_ESSENTIAL_EXTRA_RRECOMMENDS += "vpdma-fw goodix-fw prueth-fw prusw-fw pruhsr-fw pruprp-fw"

# Use the expected value of the ubifs filesystem's volume name in the kernel
# and u-boot.
UBI_VOLNAME = "rootfs"

# List common SoC features, may need to add touchscreen for specific machines
MACHINE_FEATURES = "apm usbgadget usbhost vfat ext2 screen alsa mmip dsp gc320 pci"

IMAGE_FSTYPES += "tar.xz wic.xz wic.bmap"
WKS_FILE ?= "sdimage-2part.wks"
IMAGE_BOOT_FILES += "${SPL_BINARY} u-boot.${UBOOT_SUFFIX} ${UBOOT_EXTLINUX_BOOT_FILES} ipc/dra7-ipu1-fw.xem4;dra7-ipu1-fw.xem4"
do_image_wic[depends] += "virtual/bootloader:do_deploy"
do_image_wic[depends] += "ti-rtos-messageq-test-fw:do_deploy"
```

## meta-ti-bsp/conf/machine/include/am62axx.inc
```bitbake
require conf/machine/include/k3.inc
require conf/machine/include/mc_k3r5.inc

SOC_FAMILY:append = ":am62axx"

MACHINE_FEATURES += "screen touchscreen"

TFA_K3_SYSTEM_SUSPEND = "1"

TFA_BOARD = "lite"
OPTEEMACHINE = "k3-am62x"

MACHINE_ESSENTIAL_EXTRA_RRECOMMENDS += "cnm-wave-fw"

TI_CORE_INITRAMFS_KERNEL_MODULES = "kernel-module-tps6594-i2c kernel-module-tps6594-regulator kernel-module-tps6594-core"
TI_CORE_INITRAMFS_KERNEL_MODULES:bsp-ti-6_6 = ""
TI_CORE_INITRAMFS_KERNEL_MODULES:bsp-ti-6_12 = ""
```

## meta-ti-bsp/conf/machine/include/am62dxx.inc
```bitbake
require conf/machine/include/k3.inc
require conf/machine/include/mc_k3r5.inc

SOC_FAMILY:append = ":am62dxx"

TFA_BOARD = "lite"
OPTEEMACHINE = "k3-am62x"
```
