## meta-ti-bsp/conf/machine/include/am62lxx.inc
```bitbake
require conf/machine/include/k3.inc
SOC_FAMILY:append = ":am62lxx"

MACHINE_FEATURES += "screen"

SERIAL_CONSOLES = "115200;ttyS0"

TFA_BOARD = "am62lx"
TFA_K3_SYSTEM_SUSPEND = "1"
TFA_PLATFORM = "k3low"

OPTEEMACHINE = "k3-am62lx"
```

## meta-ti-bsp/conf/machine/include/am62pxx.inc
```bitbake
require conf/machine/include/k3.inc
require conf/machine/include/mc_k3r5.inc

SOC_FAMILY:append = ":am62pxx"

MACHINE_FEATURES += "screen"

require conf/machine/include/mesa-pvr.inc
PREFERRED_PROVIDER_virtual/gpudriver ?= "${BSP_ROGUE_DRIVER_PROVIDER}"

TFA_BOARD = "lite"
TFA_K3_SYSTEM_SUSPEND = "1"

OPTEEMACHINE = "k3-am62x"

MACHINE_ESSENTIAL_EXTRA_RRECOMMENDS += "cnm-wave-fw"

SERIAL_CONSOLES = "115200;ttyS2"

# Bitmap image tarball for early splashscreen
IMAGE_BOOT_FILES += "ti_logo_414x97_32bpp.bmp.gz"
```
