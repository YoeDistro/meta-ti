## wic/sdimage-3part.wks
```
# short-description: Create SD card image with 3 partitions
# long-description: Creates a partitioned SD card image for testing TI platforms.
# Boot files are located in the first vfat partition.
# Second ext4 partition is empty and is used for testing.

part /boot --source bootimg-partition --ondisk mmcblk0 --fstype=vfat --label boot --active --align 1024 --size 100M --use-uuid
part test --ondisk mmcblk0 --fstype=ext4 --label test --align 1024 --size 1G --use-uuid
part / --source rootfs --ondisk mmcblk0 --fstype=ext4 --label root --align 1024 --extra-space 500M --use-uuid
```
